/*
  Калькулятор с дробями для Waveshare ESP32-Touch-LCD-3.5
  (ESP32-D0WD-V3, 3.5" ST7796 320x480, ёмкостный тач FT6336)

  Возможности:
    • Точные вычисления с дробями: 1/3 + 1/6 = 1/2 (без ошибок округления)
    • Ввод дробей: выберите «Числитель» или «Знаменатель» над клавиатурой
    • Скобки, √x, x², xⁿ, ±, %, память MC / MR / M+ / M−
    • Результат дробью, смешанным числом или десятичной (с периодом: 1/3 = 0,(3))
      — переключается лампочкой в углу экрана или кнопкой PWR
    • Память и формат сохраняются при выключении
    • Подсветка гаснет через минуту простоя, касание будит экран

  Физические кнопки: BOOT = «=», PWR (коротко) = формат результата.

  Arduino IDE:
    Плата: "ESP32 Dev Module"
    Библиотека: "GFX Library for Arduino" (moononournation)
    Шрифт Inter встроен в скетч (лицензия SIL OFL 1.1).
*/

#ifndef HOST_SIM
#include <Arduino_GFX_Library.h>
#include <Wire.h>
#include <Preferences.h>
#endif
#include <math.h>
#include <stdint.h>
#include <stdio.h>
#include <stdlib.h>
#include <string.h>

// ===================== Константы =====================
#define MK565(r, g, b) ((uint16_t)((((r) & 0xF8) << 8) | (((g) & 0xFC) << 3) | ((b) >> 3)))

#define C_BG           MK565(0, 0, 0)
#define C_KEY          MK565(13, 13, 16)
#define C_KEY_DOWN     MK565(40, 31, 56)
#define C_BORDER       MK565(54, 50, 70)
#define C_PANEL        MK565(22, 23, 28)
#define C_PANEL_BORDER MK565(106, 52, 152)
#define C_DIGIT        MK565(244, 244, 247)
#define C_FUNC         MK565(169, 163, 217)
#define C_CLEAR        MK565(232, 41, 95)
#define C_EQ           MK565(123, 31, 162)
#define C_EQ_DOWN      MK565(152, 62, 192)
#define C_BULB         MK565(126, 59, 168)
#define C_DIM          MK565(138, 134, 160)
#define C_SEG_TEXT     MK565(154, 148, 196)
#define C_SEG_ON       MK565(42, 31, 61)
#define C_ACCENT       MK565(186, 140, 255)
#define C_ERR          MK565(255, 96, 116)
#define C_WHITE        MK565(255, 255, 255)

#define SCREEN_W 320
#define SCREEN_H 480
#define DISP_X 10
#define DISP_Y 10
#define DISP_W 300
#define DISP_H 118
#define SEG_X 10
#define SEG_Y 134
#define SEG_W 300
#define SEG_H 32
#define PAD_X 10
#define PAD_Y 172
#define PAD_W 300
#define KEY_H 46
#define ROW_PITCH 50
#define COL_GAP 6

#define MAIN_CAP 64
#define PART_CAP 24
#define FRAC_CAP 12

// Коды клавиш
enum KeyId : uint8_t {
  K_0, K_1, K_2, K_3, K_4, K_5, K_6, K_7, K_8, K_9,
  K_DOT, K_ADD, K_SUB, K_MUL, K_DIV, K_POW, K_SQR, K_PCT, K_LP, K_RP, K_SQRT, K_NEG, K_BS,
  K_C, K_EQ, K_MC, K_MR, K_MP, K_MM,
  K_SEG_MAIN, K_SEG_NUM, K_SEG_DEN, K_BULB, K_NONE = 255
};

enum : uint8_t { E_OK = 0, E_SYNTAX, E_DIV0, E_DOMAIN, E_OVER };
enum Target : uint8_t { TGT_MAIN, TGT_NUM, TGT_DEN };

// ===================== Типы =====================
// (все типы объявлены до первой функции — так требует генератор прототипов Arduino)
struct Glyph { uint16_t cp; uint8_t w, h; int8_t xo, yo; uint8_t adv; uint32_t off; };
struct AAFont { uint8_t* bits; const Glyph* g; uint16_t n; int8_t asc, desc; const char* b64; uint32_t nbytes; };

struct Surface {
  uint16_t* px = nullptr;
  int w = 0, h = 0, cap = 0;
  int cx0 = 0, cy0 = 0, cx1 = 0, cy1 = 0;  // область отсечения
};

// Элемент выражения: символ ('0'..'9', '.', '+', '-', '*', '/', '^', 's' = ², '%', '(', ')',
// 'r' = √, 'm' = унарный минус) или дробь ('F', f = номер дроби)
struct Item { char c; int8_t f; };
struct Part { Item it[PART_CAP]; uint8_t n; };
struct Frac { Part num, den; bool used; };
struct Field { Item* it; uint8_t* n; uint8_t cap; bool isMain; };

// Значение: точная дробь n/d или приближённое v
struct Val { bool exact; int64_t n, d; double v; bool pct; uint8_t err; };

struct Key { uint8_t id; int16_t x, y, w, h; };

struct TouchPt { int16_t x, y; };

struct Parser {
  const Item* it; int n; int p; uint8_t err;
  char peek() const { return p < n ? it[p].c : 0; }
  Val expr();
  Val term();
  Val unary();
  Val power();
  Val postfix();
  Val primary();
  Val number();
  Val fail(uint8_t e);
};

// ===================== Шрифты =====================
// ---- Сгенерировано genfonts.py: шрифт Inter (SIL OFL 1.1), запасной DejaVu Sans ----
// F_S: 14px, 172 глифов, 6739 байт
static const char F_S_B64[] PROGMEM =
  "vwvwvwvgrgrgrgRQAAnQrQnw+J4PeND2fQ5gA/EJoABeAMcACMAOUB////+hPpNvQgD0BuACT1OdML////8AbQDWAAmwD0AAuALx"
  "AAAAQAAAAA0AAAB9/pEAj8+vsA7A0J8Q/A0AAAn94gAAB9/6IAAA6P4BIQ0F9C+Q0H8wz7+/wAGe/pEAAA0AAAAAQAABv8EACbAG"
  "4tgAPyAIoJoA1wAG0tgH0AABv8EvMAAAAAC4AAAAAAbhLPoAAB9Amz9QAKoAtwxwBPEAmy9QHmAALfoACO+QAAT5f2AAfwDpAAT0"
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  "AAPP1QK/5gHti/r9e/RPMAj8AA6S+RTv9xX3CP/7GP/8AAJTAAJUAF7mBMDrf73QYgK7MF7mBMDrf5zgcgTuUA=="
  ;
static const Glyph F_S_GLYPHS[] PROGMEM = {
  {0x0020, 0, 0, 0, 0, 4, 0},
  {0x0021, 3, 11, 1, -11, 4, 0},
  {0x0022, 5, 4, 1, -11, 7, 33},
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  {0x2248, 8, 6, 1, -7, 9, 13430},
};
AAFont F_S = { nullptr, F_S_GLYPHS, 172, 14, 4, F_S_B64, 6739 };

// F_M: 21px, 172 глифов, 14476 байт
static const char F_M_B64[] PROGMEM =
  "H/cf9w/2D/YP9g/2D/UP9Q/1D/ULwwAAAAAL5E/6DOTvcf9N9g/z31D/LPQP8b9A7xrzDfAAAM8QBvcAAADvAAj1AAAB/AAL8gAA"
  "A/oADfAAB97/3d/90Az//////+AAC/IAX4AAAA3wAH9gAAAP0ACvMAAAL7AAzxAAj///////II3v7d3/3AAAnzAE+QAAAM8QBvcA"
  "AADuAAn0AAAB/AAL8gAAAAANcAAAAAANcAAAABnf/IEABP////4gHv1dmP/AX/INcF/xf/ANcAVRX/YNcAAADf/OcAAAAs///HAA"
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  "AAAAAAX/EAAAAABf8QAAAAAF/xAAAAAAX/EAAAAABf8V/wAAD/UAAL+l/wAAD/UAAL+l/wAAD/UAAL+l/wAAD/UAAL+l/wAAD/UA"
  "AL+l/wAAD/UAAL+l/wAAD/UAAL+l/wAAD/UAAL+l/wAAD/UAAL+l/wAAD/UAAL+l/wAAD/UAAL+l/wAAD/UAAL+l/wAAD/UAAL+l"
  "/wAAD/UAAL+l//////////+l//////////+l/wAAD/UAAL+gBf8AAA/1AAC/oAX/AAAP9QAAv6AF/wAAD/UAAL+gBf8AAA/1AAC/"
  "oAX/AAAP9QAAv6AF/wAAD/UAAL+gBf8AAA/1AAC/oAX/AAAP9QAAv6AF/wAAD/UAAL+gBf8AAA/1AAC/oAX/AAAP9QAAv6AF/wAA"
  "D/UAAL+gBf8AAA/1AAC/oAX///////////81////////////MAAAAAAAAAAC/yAAAAAAAAAAAv8gAAAAAAAAAAL/IAAAAAAAAAAA"
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  "9iX/cd///9It///8ABnf2AAAjv2AAE38QACaEv//+RT/B/sTz//3A1IABIlAADzrMACJEf//9gH/Bvwl/1f+BrUAX//3AAAABu6A"
  "AA=="
  ;
static const Glyph F_M_GLYPHS[] PROGMEM = {
  {0x0020, 0, 0, 0, 0, 6, 0},
  {0x0021, 4, 16, 1, -16, 6, 0},
  {0x0022, 7, 6, 2, -16, 10, 64},
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  {0x2248, 12, 9, 1, -10, 14, 28843},
};
AAFont F_M = { nullptr, F_M_GLYPHS, 172, 21, 6, F_M_B64, 14476 };

// F_F: 17px, 28 глифов, 1321 байт
static const char F_F_B64[] PROGMEM =
  "Be+xAAB/QAL9j5AAL5AAX1DNAAvhAAX1DNAG9AAAL9j5AfoAAABe+xC+EAAAAAAAX1AAAAAAAB+gGv5gAAAK8Qj53yAABfUAzQT2"
  "AAHrAA3QP2AAryAArzj0AE9gAAP/+wAAAAAAAVQAAI+gH/QG/gC/kA/0Av8QT/AF/gBv4AT/AC/yAO9QCfoAP/EAz2ADdR/yAK+Q"
  "BP8AD/UAr5AH/ABf4AT/AE/wBv4Aj8AL+AH/MG/QDPYAdwAAABAAAAB/cAAAB/cAAAB/cACMzv7Mi/////oAB/cAAAB/cAAAB/cA"
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  "AAv4AAABqRAGUu/+Q/yvRO//feABm3AAAAAHcb/sRPyf////bfEYrHAiAAAAAA=="
  ;
static const Glyph F_F_GLYPHS[] PROGMEM = {
  {0x0020, 0, 0, 0, 0, 5, 0},
  {0x0025, 15, 14, 1, -13, 17, 0},
  {0x0028, 5, 16, 1, -13, 7, 210},
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  {0x2248, 9, 9, 1, -9, 11, 2560},
};
AAFont F_F = { nullptr, F_F_GLYPHS, 28, 17, 5, F_F_B64, 1321 };

// F_L: 36px, 28 глифов, 5059 байт
static const char F_L_B64[] PROGMEM =
  "AAW+/HAAAAAAAAP/8gAACv///8EAAAAAAN/1AAAG//y//6AAAAAAn/oAAADv9gAv/yAAAABP/hAAAB//AAC/9AAAAB7/QAAABP/Q"
  "AAn/cAAACv+QAAAAT/0AAJ/3AAAF/9EAAAAB/+AAC/9AAAH/8wAAAAAO/2AD//IAAL/4AAAAAABv/8v/+gAAb/0AAAAAAACv///8"
  "EAAv/yAAAAAAAABb78cAAAz/cAAAAAAAAAAAAAAAB/+wAAAAAAAAAAAAAAAD//IAAAAAAAAAAAAAAADf9QAAAmh0AAAAAAAAAJ/6"
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  "AAAAAACv/+AAAAAAAADv//IAAAAAAAC///AAAAAAAAAt/0AAAAAAAAAAEAAAAAAAAAAAAAAAAABWZmZmZmZmZmHf//////////Lf"
  "//////////Lf//////////IAAAAAAAAAAAAAAAAAAAAAAAAAAAAAEAAAAAAAAAAs/kAAAAAAAAC///AAAAAAAADv//IAAAAAAACv"
  "/+AAAAAAAAAb/TAAAAAAAgAAAAAAIAAAAAACAAT/4wAAAF/+MAAABv/SD//9AAAB///AAAAv//sf//8AAAP///AAAE///Q7//AAA"
  "AO//sAAAH//6A8/CAAAAPfsQAAAE36Hf//////////Lf//////////Lf//////////J4iIiIiIiIiIEAAAAAAAAAAF//gAAAAAAA"
  "AAAK//MAAAAAAAAAAP/9AAAAAAAAAABf/4AAAAAAAAAACv/yAAAAAAAAAAH//AAAAAAAAAAAX/9wAAAAAAAAAAv/8QAAAAAAAAAB"
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  "r/////4G/+AAAI////9QJEQAAABe//5AAAAAAAAAA0IAAA=="
  ;
static const Glyph F_L_GLYPHS[] PROGMEM = {
  {0x0020, 0, 0, 0, 0, 10, 0},
  {0x0025, 29, 27, 3, -26, 36, 0},
  {0x0028, 10, 33, 3, -28, 14, 783},
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  {0x2248, 19, 16, 2, -18, 23, 9814},
};
AAFont F_L = { nullptr, F_L_GLYPHS, 28, 35, 9, F_L_B64, 5059 };

// F_K: 27px, 19 глифов, 2264 байт
static const char F_K_B64[] PROGMEM =
  "AEz+oQAAAAB/4QAF///+EAAAA/9AAA76Eu+AAAAN+QAAH/QAn8AAAI/hAAA/8gB/0AAD/0AAAB/0AJ/AAA35AAAADvoC74AAj+EA"
  "AAAF///+EAP/QAAAAABM/qEADfkAAAAAAAAAAACP0QAAAAAAAAAAA/8wAAAAAAAAAAAd+AACrdogAAAAAJ/QAC////IAAAAE/zAA"
  "v9It+gAAAB74AAD/YAf+AAAAn9AAAP9ABf8AAAT/MAAA/2AH/gAAHvcAAAC/wR37AACvwAAAAD////IABP8gAAAAA7/rIAAA7+AA"
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  "AAAAAAAAAAAAAAAAr///////8a////////FZmZmZmZmRAAAAAAAAAAAABckQAAAAAB//gAAAAAAv/5AAAAAACPwgAACv///////x"
  "r///////8WqqqqqqqqE="
  ;
static const Glyph F_K_GLYPHS[] PROGMEM = {
  {0x0025, 22, 20, 2, -20, 27, 0},
  {0x0028, 8, 25, 2, -21, 11, 440},
  {0x0029, 7, 25, 1, -21, 11, 640},
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  {0x2212, 14, 3, 2, -9, 18, 4486},
};
AAFont F_K = { nullptr, F_K_GLYPHS, 19, 27, 7, F_K_B64, 2264 };


// ===================== Глобальное состояние =====================
Item mainIt[MAIN_CAP];
uint8_t mainN = 0;
Frac fracs[FRAC_CAP];
Target target = TGT_MAIN;
int8_t curFrac = -1;

bool justEval = false;     // только что нажали «=»
Val lastRes;
bool hasRes = false;
uint8_t errCode = E_OK;    // ошибка последнего «=»
Val preview;
bool previewOk = false;
Val memVal;
bool memSet = false;
uint8_t fmtMode = 0;       // 0 — дробь, 1 — смешанная, 2 — десятичная
bool cursorOn = true;

Surface sDisp, sSeg, sKey;
Key keys[32];
int nKeys = 0;

static const char* const FMT_NAMES[] = { "дробь", "смешанная", "десятичная" };
static const char* const SEG_NAMES[] = { "Выражение", "Числитель", "Знаменатель" };

static const uint8_t LAYOUT[6][5] = {
  { K_C,    K_MC,  K_MR,  K_MP,  K_MM  },
  { K_SQRT, K_SQR, K_POW, K_NEG, K_PCT },
  { K_7,    K_8,   K_9,   K_LP,  K_DIV },
  { K_4,    K_5,   K_6,   K_RP,  K_MUL },
  { K_1,    K_2,   K_3,   K_BS,  K_SUB },
  { K_DOT,  K_0,   K_EQ,  K_EQ,  K_ADD },
};

void pushPixels(int x, int y, int w, int h, const uint16_t* px);  // вывод на экран (своя на плате и в симуляторе)

// ===================== Графика: смешивание и примитивы =====================
static inline uint16_t mix565(uint16_t a, uint16_t b, int t) {  // t: 0 → a, 255 → b
  int ar = a >> 11, ag = (a >> 5) & 63, ab = a & 31;
  int br = b >> 11, bg = (b >> 5) & 63, bb = b & 31;
  int r = ar + (br - ar) * t / 255;
  int g = ag + (bg - ag) * t / 255;
  int bl = ab + (bb - ab) * t / 255;
  return (uint16_t)((r << 11) | (g << 5) | bl);
}

static inline float clamp01(float v) { return v < 0 ? 0 : (v > 1 ? 1 : v); }

bool surfAlloc(Surface& s, int w, int h) {
  s.px = (uint16_t*)malloc((size_t)w * h * 2);
  if (!s.px) return false;
  s.cap = w * h;
  s.w = w; s.h = h;
  s.cx0 = 0; s.cy0 = 0; s.cx1 = w; s.cy1 = h;
  return true;
}

void surfSize(Surface& s, int w, int h) {  // переиспользует буфер под меньший размер
  s.w = w; s.h = h;
  s.cx0 = 0; s.cy0 = 0; s.cx1 = w; s.cy1 = h;
}

void surfClip(Surface& s, int x0, int y0, int x1, int y1) {
  s.cx0 = x0 < 0 ? 0 : x0;
  s.cy0 = y0 < 0 ? 0 : y0;
  s.cx1 = x1 > s.w ? s.w : x1;
  s.cy1 = y1 > s.h ? s.h : y1;
}

void surfNoClip(Surface& s) { s.cx0 = 0; s.cy0 = 0; s.cx1 = s.w; s.cy1 = s.h; }

static inline void blendPx(Surface& s, int x, int y, uint16_t c, int a) {
  if (a <= 0 || x < s.cx0 || x >= s.cx1 || y < s.cy0 || y >= s.cy1) return;
  uint16_t& p = s.px[y * s.w + x];
  p = a >= 255 ? c : mix565(p, c, a);
}

void surfFill(Surface& s, uint16_t c) {
  int n = s.w * s.h;
  for (int i = 0; i < n; i++) s.px[i] = c;
}

void fillRectS(Surface& s, int x, int y, int w, int h, uint16_t c) {
  for (int yy = y; yy < y + h; yy++)
    for (int xx = x; xx < x + w; xx++) blendPx(s, xx, yy, c, 255);
}

// Скруглённый прямоугольник со сглаживанием (SDF): заливка + рамка толщиной bw
void roundRectS(Surface& s, float x, float y, float w, float h, float r, uint16_t fillC, uint16_t borderC, float bw) {
  float hx = w * 0.5f, hy = h * 0.5f, cx = x + hx, cy = y + hy;
  int x0 = (int)floorf(x) - 1, x1 = (int)ceilf(x + w) + 1;
  int y0 = (int)floorf(y) - 1, y1 = (int)ceilf(y + h) + 1;
  for (int py = y0; py < y1; py++) {
    for (int px = x0; px < x1; px++) {
      float qx = fabsf(px + 0.5f - cx) - (hx - r);
      float qy = fabsf(py + 0.5f - cy) - (hy - r);
      float ox = qx > 0 ? qx : 0, oy = qy > 0 ? qy : 0;
      float d = sqrtf(ox * ox + oy * oy) + fminf(fmaxf(qx, qy), 0.0f) - r;
      float outer = clamp01(0.5f - d);
      if (outer <= 0) continue;
      if (bw > 0) {
        blendPx(s, px, py, borderC, (int)(outer * 255));
        float inner = clamp01(0.5f - (d + bw));
        if (inner > 0) blendPx(s, px, py, fillC, (int)(inner * 255));
      } else {
        blendPx(s, px, py, fillC, (int)(outer * 255));
      }
    }
  }
}

// Отрезок с круглыми концами (для иконок)
void capsuleS(Surface& s, float ax, float ay, float bx, float by, float r, uint16_t c) {
  int x0 = (int)floorf(fminf(ax, bx) - r - 1), x1 = (int)ceilf(fmaxf(ax, bx) + r + 1);
  int y0 = (int)floorf(fminf(ay, by) - r - 1), y1 = (int)ceilf(fmaxf(ay, by) + r + 1);
  float bax = bx - ax, bay = by - ay, bb = bax * bax + bay * bay;
  for (int py = y0; py < y1; py++)
    for (int px = x0; px < x1; px++) {
      float pax = px + 0.5f - ax, pay = py + 0.5f - ay;
      float t = bb > 0 ? clamp01((pax * bax + pay * bay) / bb) : 0;
      float dx = pax - bax * t, dy = pay - bay * t;
      float d = sqrtf(dx * dx + dy * dy) - r;
      blendPx(s, px, py, c, (int)(clamp01(0.5f - d) * 255));
    }
}

void ringS(Surface& s, float cx, float cy, float r, float th, uint16_t c) {
  int x0 = (int)(cx - r - th - 1), x1 = (int)(cx + r + th + 2);
  int y0 = (int)(cy - r - th - 1), y1 = (int)(cy + r + th + 2);
  for (int py = y0; py < y1; py++)
    for (int px = x0; px < x1; px++) {
      float dx = px + 0.5f - cx, dy = py + 0.5f - cy;
      float d = fabsf(sqrtf(dx * dx + dy * dy) - r) - th * 0.5f;
      blendPx(s, px, py, c, (int)(clamp01(0.5f - d) * 255));
    }
}

// Многоугольник со сглаживанием (4x4 субпикселя)
void polyS(Surface& s, const float* xs, const float* ys, int n, uint16_t c) {
  float minx = xs[0], maxx = xs[0], miny = ys[0], maxy = ys[0];
  for (int i = 1; i < n; i++) {
    minx = fminf(minx, xs[i]); maxx = fmaxf(maxx, xs[i]);
    miny = fminf(miny, ys[i]); maxy = fmaxf(maxy, ys[i]);
  }
  for (int py = (int)floorf(miny); py <= (int)ceilf(maxy); py++)
    for (int px = (int)floorf(minx); px <= (int)ceilf(maxx); px++) {
      int hits = 0;
      for (int sy = 0; sy < 4; sy++)
        for (int sx = 0; sx < 4; sx++) {
          float X = px + (sx + 0.5f) / 4, Y = py + (sy + 0.5f) / 4;
          bool in = false;
          for (int i = 0, j = n - 1; i < n; j = i++)
            if (((ys[i] > Y) != (ys[j] > Y)) && (X < (xs[j] - xs[i]) * (Y - ys[i]) / (ys[j] - ys[i]) + xs[i])) in = !in;
          hits += in;
        }
      blendPx(s, px, py, c, hits * 255 / 16);
    }
}

// ===================== Текст =====================
static int b64v(char c) {
  if (c >= 'A' && c <= 'Z') return c - 'A';
  if (c >= 'a' && c <= 'z') return c - 'a' + 26;
  if (c >= '0' && c <= '9') return c - '0' + 52;
  if (c == '+') return 62;
  if (c == '/') return 63;
  return -1;
}

bool decodeFont(AAFont& f) {
  f.bits = (uint8_t*)malloc(f.nbytes);
  if (!f.bits) return false;
  uint32_t o = 0, acc = 0;
  int bits = 0;
  for (const char* p = f.b64; *p && o < f.nbytes; p++) {
    int v = b64v(*p);
    if (v < 0) continue;
    acc = (acc << 6) | v;
    bits += 6;
    if (bits >= 8) { bits -= 8; f.bits[o++] = (acc >> bits) & 0xFF; }
  }
  return o == f.nbytes;
}

static uint32_t utf8Next(const char*& s) {
  uint8_t c = (uint8_t)*s++;
  if (c < 0x80) return c;
  if ((c & 0xE0) == 0xC0 && *s) return ((c & 0x1F) << 6) | (*s++ & 0x3F);
  if ((c & 0xF0) == 0xE0 && s[0] && s[1]) {
    uint32_t r = ((c & 0x0F) << 12) | ((s[0] & 0x3F) << 6) | (s[1] & 0x3F);
    s += 2;
    return r;
  }
  return '?';
}

const Glyph* findGlyph(const AAFont& f, uint32_t cp) {
  int lo = 0, hi = f.n - 1;
  while (lo <= hi) {
    int mid = (lo + hi) / 2;
    uint16_t c = f.g[mid].cp;
    if (c == cp) return &f.g[mid];
    if (c < cp) lo = mid + 1; else hi = mid - 1;
  }
  return nullptr;
}

int textW(const AAFont& f, const char* s) {
  int w = 0;
  while (*s) {
    const Glyph* g = findGlyph(f, utf8Next(s));
    w += g ? g->adv : f.asc / 3;
  }
  return w;
}

int capH(const AAFont& f) {
  const Glyph* g = findGlyph(f, '0');
  return g ? g->h : f.asc * 7 / 10;
}

// Рисует строку от x по базовой линии base; возвращает x конца строки
int drawText(Surface& s, const AAFont& f, int x, int base, const char* str, uint16_t col) {
  while (*str) {
    const Glyph* g = findGlyph(f, utf8Next(str));
    if (!g) { x += f.asc / 3; continue; }
    int gx = x + g->xo, gy = base + g->yo;
    for (int yy = 0; yy < g->h; yy++)
      for (int xx = 0; xx < g->w; xx++) {
        uint32_t idx = g->off + yy * g->w + xx;
        uint8_t b = f.bits[idx >> 1];
        int a = (idx & 1) ? (b & 15) : (b >> 4);
        if (a) blendPx(s, gx + xx, gy + yy, col, a * 17);
      }
    x += g->adv;
  }
  return x;
}

void drawTextCenter(Surface& s, const AAFont& f, int cx, int cy, const char* str, uint16_t col) {
  drawText(s, f, cx - textW(f, str) / 2, cy + capH(f) / 2, str, col);
}

// ===================== Арифметика: точные дроби с запасным double =====================
static int64_t gcd64(int64_t a, int64_t b) {
  if (a < 0) a = -a;
  if (b < 0) b = -b;
  while (b) { int64_t t = a % b; a = b; b = t; }
  return a;
}

static Val vErr(uint8_t e) { Val r; memset(&r, 0, sizeof r); r.err = e; return r; }

static Val vReal(double x) {
  Val r; memset(&r, 0, sizeof r);
  r.v = x;
  if (!isfinite(x)) r.err = E_OVER;
  return r;
}

static Val vExact(int64_t n, int64_t d) {
  if (d == 0) return vErr(E_DIV0);
  if (n == INT64_MIN || d == INT64_MIN) return vReal((double)n / (double)d);
  if (d < 0) { n = -n; d = -d; }
  int64_t g = gcd64(n, d);
  if (g > 1) { n /= g; d /= g; }
  Val r; memset(&r, 0, sizeof r);
  r.exact = true; r.n = n; r.d = d; r.v = (double)n / (double)d;
  return r;
}

static Val vNeg(const Val& a) {
  if (a.err) return a;
  if (a.exact) return vExact(-a.n, a.d);
  return vReal(-a.v);
}

static Val vAdd(const Val& a, const Val& b) {
  if (a.err) return a;
  if (b.err) return b;
  if (a.exact && b.exact) {
    int64_t g = gcd64(a.d, b.d), t1, t2, n, d;
    if (!__builtin_mul_overflow(a.n, b.d / g, &t1) && !__builtin_mul_overflow(b.n, a.d / g, &t2) &&
        !__builtin_add_overflow(t1, t2, &n) && !__builtin_mul_overflow(a.d, b.d / g, &d))
      return vExact(n, d);
  }
  return vReal(a.v + b.v);
}

static Val vSub(const Val& a, const Val& b) { return vAdd(a, vNeg(b)); }

static Val vMul(const Val& a, const Val& b) {
  if (a.err) return a;
  if (b.err) return b;
  if (a.exact && b.exact) {
    int64_t g1 = gcd64(a.n, b.d), g2 = gcd64(b.n, a.d), n, d;
    if (g1 == 0) g1 = 1;
    if (g2 == 0) g2 = 1;
    if (!__builtin_mul_overflow(a.n / g1, b.n / g2, &n) && !__builtin_mul_overflow(a.d / g2, b.d / g1, &d))
      return vExact(n, d);
  }
  return vReal(a.v * b.v);
}

static Val vInv(const Val& a) {
  if (a.err) return a;
  if (a.exact) {
    if (a.n == 0) return vErr(E_DIV0);
    return vExact(a.d, a.n);
  }
  if (a.v == 0) return vErr(E_DIV0);
  return vReal(1.0 / a.v);
}

static Val vDiv(const Val& a, const Val& b) {
  if (a.err) return a;
  return vMul(a, vInv(b));
}

static Val vPow(const Val& b, const Val& e) {
  if (b.err) return b;
  if (e.err) return e;
  if (b.exact && e.exact && e.d == 1 && e.n >= -64 && e.n <= 64) {
    int64_t k = e.n < 0 ? -e.n : e.n;
    Val r = vExact(1, 1), base = b;
    while (k) {
      if (k & 1) r = vMul(r, base);
      k >>= 1;
      if (k) base = vMul(base, base);
      if (r.err) return r;
    }
    return e.n < 0 ? vInv(r) : r;
  }
  double bv = b.v, ev = e.v;
  if (bv == 0 && ev < 0) return vErr(E_DIV0);
  if (bv < 0) {
    if (e.exact && (e.d & 1)) {  // нечётный корень из отрицательного: (−8)^(1/3) = −2
      double m = pow(-bv, ev);
      return vReal((e.n & 1) ? -m : m);
    }
    if (floor(ev) != ev) return vErr(E_DOMAIN);
  }
  return vReal(pow(bv, ev));
}

static int64_t isqrt64(int64_t x) {
  int64_t r = (int64_t)sqrt((double)x);
  while (r > 0 && r * r > x) r--;
  while ((r + 1) * (r + 1) <= x) r++;
  return r;
}

static Val vSqrt(const Val& a) {
  if (a.err) return a;
  if (a.v < 0) return vErr(E_DOMAIN);
  if (a.exact && a.n <= 4000000000000000000LL && a.d <= 4000000000000000000LL) {
    int64_t sn = isqrt64(a.n), sd = isqrt64(a.d);
    if (sn * sn == a.n && sd * sd == a.d) return vExact(sn, sd);
  }
  return vReal(sqrt(a.v));
}

// ===================== Разбор выражения =====================
static bool isDigitC(char c) { return c >= '0' && c <= '9'; }
static bool isBinOp(char c) { return c == '+' || c == '-' || c == '*' || c == '/' || c == '^'; }
static bool isOperandEnd(char c) { return isDigitC(c) || c == '.' || c == ')' || c == 's' || c == '%' || c == 'F'; }
static bool startsOperand(char c) { return isDigitC(c) || c == '.' || c == '(' || c == 'r' || c == 'F'; }

Val evalItems(const Item* it, int n);

Val Parser::fail(uint8_t e) {
  if (!err) err = e;
  return vErr(e);
}

Val Parser::expr() {
  Val a = term();
  while (!err) {
    char c = peek();
    if (c != '+' && c != '-') break;
    p++;
    Val b = term();
    if (err) break;
    if (b.pct) b = vMul(a, b);  // 200 + 10% = 220
    a = (c == '+') ? vAdd(a, b) : vSub(a, b);
    a.pct = false;
    if (a.err) fail(a.err);
  }
  return a;
}

Val Parser::term() {
  Val a = unary();
  while (!err) {
    char c = peek();
    if (c == '*' || c == '/') {
      p++;
      Val b = unary();
      if (err) break;
      a = (c == '*') ? vMul(a, b) : vDiv(a, b);
    } else if (startsOperand(c)) {  // неявное умножение: 2(3+4), 3√2, 2·дробь
      Val b = unary();
      if (err) break;
      a = vMul(a, b);
    } else {
      break;
    }
    a.pct = false;
    if (a.err) fail(a.err);
  }
  return a;
}

Val Parser::unary() {
  if (peek() == 'm') {
    p++;
    Val a = unary();
    bool pct = a.pct;
    a = vNeg(a);
    a.pct = pct;
    return a;
  }
  return power();
}

Val Parser::power() {
  Val a = postfix();
  if (!err && peek() == '^') {
    p++;
    Val e = unary();
    if (err) return a;
    a = vPow(a, e);
    a.pct = false;
    if (a.err) fail(a.err);
  }
  return a;
}

Val Parser::postfix() {
  Val a = primary();
  while (!err) {
    char c = peek();
    if (c == 's') { p++; a = vMul(a, a); a.pct = false; }
    else if (c == '%') { p++; a = vDiv(a, vExact(100, 1)); a.pct = true; }
    else break;
    if (a.err) fail(a.err);
  }
  return a;
}

Val Parser::primary() {
  char c = peek();
  if (isDigitC(c) || c == '.') return number();
  if (c == '(') {
    p++;
    Val a = expr();
    if (err) return a;
    if (peek() == ')') p++;
    else if (p < n) return fail(E_SYNTAX);  // незакрытую скобку в конце закрываем сами
    a.pct = false;
    return a;
  }
  if (c == 'r') {
    p++;
    Val a = primary();
    if (err) return a;
    a = vSqrt(a);
    if (a.err) fail(a.err);
    return a;
  }
  if (c == 'F') {
    Frac& F = fracs[it[p].f];
    p++;
    if (!F.num.n || !F.den.n) return fail(E_SYNTAX);
    Val a = evalItems(F.num.it, F.num.n);
    if (a.err) return fail(a.err);
    Val b = evalItems(F.den.it, F.den.n);
    if (b.err) return fail(b.err);
    a = vDiv(a, b);
    if (a.err) fail(a.err);
    a.pct = false;
    return a;
  }
  return fail(E_SYNTAX);
}

Val Parser::number() {
  int64_t num = 0, den = 1;
  bool dot = false, ovf = false;
  int digits = 0, bl = 0;
  char buf[40];
  while (p < n) {
    char c = it[p].c;
    if (c == '.') {
      if (dot) return fail(E_SYNTAX);
      dot = true;
    } else if (isDigitC(c)) {
      digits++;
      if (!ovf && (__builtin_mul_overflow(num, (int64_t)10, &num) || __builtin_add_overflow(num, (int64_t)(c - '0'), &num))) ovf = true;
      if (!ovf && dot && __builtin_mul_overflow(den, (int64_t)10, &den)) ovf = true;
    } else {
      break;
    }
    if (bl < 38) buf[bl++] = c;
    p++;
  }
  if (!digits) return fail(E_SYNTAX);
  buf[bl] = 0;
  if (ovf) return vReal(strtod(buf, nullptr));
  return vExact(num, den);
}

Val evalItems(const Item* it, int n) {
  if (n <= 0) return vErr(E_SYNTAX);
  Parser P;
  P.it = it; P.n = n; P.p = 0; P.err = 0;
  Val v = P.expr();
  if (!P.err && P.p != n) P.err = E_SYNTAX;
  if (P.err) return vErr(P.err);
  return v;
}

Val evalMain() { return evalItems(mainIt, mainN); }

// ===================== Форматирование чисел =====================
// Заменяет ASCII-минус на «−», точку на запятую, e на E
void prettyNum(const char* in, char* out, int cap) {
  int o = 0;
  for (const char* p = in; *p && o < cap - 4; p++) {
    char c = *p;
    if (c == '-') { out[o++] = (char)0xE2; out[o++] = (char)0x88; out[o++] = (char)0x92; }
    else if (c == '.') out[o++] = ',';
    else if (c == 'e') out[o++] = 'E';
    else if (c == '+') continue;
    else out[o++] = c;
  }
  out[o] = 0;
}

void fmtReal(double v, char* out, int cap) {
  char b[40];
  if (v == 0) { snprintf(out, cap, "0"); return; }
  snprintf(b, sizeof b, "%.12g", v);
  // убираем ведущие нули порядка: 1e-07 → 1e-7
  char* e = strchr(b, 'e');
  if (e) {
    char* q = e + 1;
    if (*q == '+' || *q == '-') q++;
    char* z = q;
    while (*z == '0' && z[1]) z++;
    if (z != q) memmove(q, z, strlen(z) + 1);
  }
  prettyNum(b, out, cap);
}

// Точная дробь десятичной записью, период в скобках: 1/3 → 0,(3), 1/6 → 0,1(6)
void fmtDecimalExact(int64_t n, int64_t d, char* out, int cap) {
  bool neg = n < 0;
  uint64_t un = neg ? (uint64_t)(-n) : (uint64_t)n, ud = (uint64_t)d;
  uint64_t ip = un / ud, rem = un % ud;
  if (ip >= 1000000000000ULL || ud > 100000000000000000ULL) { fmtReal((double)n / d, out, cap); return; }
  char b[64];
  int o = snprintf(b, sizeof b, "%s%llu", neg ? "-" : "", (unsigned long long)ip);
  if (rem) {
    uint64_t seen[16];
    int pos[16], cnt = 0;
    b[o++] = '.';
    bool done = false;
    for (int k = 0; k < 14 && rem; k++) {
      for (int j = 0; j < cnt; j++)
        if (seen[j] == rem) {  // нашли период
          memmove(b + pos[j] + 1, b + pos[j], o - pos[j]);
          b[pos[j]] = '(';
          o++;
          b[o++] = ')';
          done = true;
          break;
        }
      if (done) break;
      seen[cnt] = rem; pos[cnt] = o; cnt++;
      rem *= 10;
      b[o++] = '0' + (char)(rem / ud);
      rem %= ud;
    }
    if (!done && rem) { fmtReal((double)n / d, out, cap); return; }
  }
  b[o] = 0;
  prettyNum(b, out, cap);
}

static const char* errText(uint8_t e) {
  switch (e) {
    case E_DIV0: return "Деление на ноль";
    case E_DOMAIN: return "Нет решения";
    case E_OVER: return "Слишком большое";
    default: return "Ошибка в выражении";
  }
}

// ===================== Редактирование выражения =====================
Field activeField() {
  if (target == TGT_MAIN || curFrac < 0) return { mainIt, &mainN, MAIN_CAP, true };
  Part& p = (target == TGT_NUM) ? fracs[curFrac].num : fracs[curFrac].den;
  return { p.it, &p.n, PART_CAP, false };
}

static char lastC(const Field& f) { return *f.n ? f.it[*f.n - 1].c : 0; }

static bool pushC(Field& f, char c) {
  if (*f.n >= f.cap) return false;
  f.it[(*f.n)++] = { c, -1 };
  return true;
}

int8_t allocFrac() {
  for (int i = 0; i < FRAC_CAP; i++)
    if (!fracs[i].used) {
      fracs[i].used = true;
      fracs[i].num.n = 0;
      fracs[i].den.n = 0;
      return (int8_t)i;
    }
  return -1;
}

void clearAll() {
  mainN = 0;
  for (int i = 0; i < FRAC_CAP; i++) fracs[i].used = false;
  target = TGT_MAIN;
  curFrac = -1;
  justEval = false;
}

bool trailingHasDot(const Field& f) {
  for (int i = *f.n - 1; i >= 0; i--) {
    char c = f.it[i].c;
    if (c == '.') return true;
    if (!isDigitC(c)) return false;
  }
  return false;
}

int openParens(const Field& f) {
  int d = 0;
  for (int i = 0; i < *f.n; i++) {
    if (f.it[i].c == '(') d++;
    else if (f.it[i].c == ')') d--;
  }
  return d;
}

// Начало операнда, который заканчивается перед end (−1, если операнда нет)
int operandStart(const Field& f, int end) {
  int i = end - 1;
  while (i >= 0 && (f.it[i].c == 's' || f.it[i].c == '%')) i--;
  if (i < 0) return -1;
  char c = f.it[i].c;
  int start;
  if (isDigitC(c) || c == '.') {
    start = i;
    while (start > 0 && (isDigitC(f.it[start - 1].c) || f.it[start - 1].c == '.')) start--;
  } else if (c == 'F') {
    start = i;
  } else if (c == ')') {
    int depth = 0;
    start = -1;
    for (int j = i; j >= 0; j--) {
      if (f.it[j].c == ')') depth++;
      else if (f.it[j].c == '(' && --depth == 0) { start = j; break; }
    }
    if (start < 0) return -1;
  } else {
    return -1;
  }
  while (start > 0 && f.it[start - 1].c == 'r') start--;
  return start;
}

void toggleSign(Field& f) {
  int n = *f.n;
  if (n && f.it[n - 1].c == 'm') { (*f.n)--; return; }
  int st = operandStart(f, n);
  if (st < 0) { pushC(f, 'm'); return; }  // после оператора — начинаем отрицательное число
  if (st > 0 && f.it[st - 1].c == 'm') {
    memmove(&f.it[st - 1], &f.it[st], (n - st) * sizeof(Item));
    (*f.n)--;
  } else if (n < f.cap) {
    memmove(&f.it[st + 1], &f.it[st], (n - st) * sizeof(Item));
    f.it[st] = { 'm', -1 };
    (*f.n)++;
  }
}

void backspace(Field& f) {
  if (f.isMain) {
    if (!mainN) return;
    Item last = mainIt[mainN - 1];
    if (last.c == 'F') {
      Frac& F = fracs[last.f];
      if (!F.num.n && !F.den.n) { F.used = false; mainN--; }
      else { curFrac = last.f; target = TGT_DEN; }  // заходим в дробь, чтобы стирать её по символу
      return;
    }
    mainN--;
    return;
  }
  if (*f.n) { (*f.n)--; return; }
  if (target == TGT_DEN) { target = TGT_NUM; return; }
  Frac& F = fracs[curFrac];
  if (!F.den.n && mainN && mainIt[mainN - 1].c == 'F' && mainIt[mainN - 1].f == curFrac) {
    F.used = false;
    mainN--;
  }
  target = TGT_MAIN;
  curFrac = -1;
}

bool appendDigits(Field& f, int64_t x) {
  char b[24];
  snprintf(b, sizeof b, "%lld", (long long)x);
  for (char* q = b; *q; q++)
    if (!pushC(f, *q)) return false;
  return true;
}

// Вставляет значение (ответ или память) в поле: дробью, если можно
void appendValue(Field& f, const Val& v) {
  if (isOperandEnd(lastC(f))) pushC(f, '*');
  if (v.exact) {
    int64_t n = v.n < 0 ? -v.n : v.n;
    if (v.n < 0) pushC(f, 'm');
    if (v.d == 1) { appendDigits(f, n); return; }
    if (f.isMain && mainN < MAIN_CAP) {
      int8_t fi = allocFrac();
      if (fi >= 0) {
        Field nf = { fracs[fi].num.it, &fracs[fi].num.n, PART_CAP, false };
        Field df = { fracs[fi].den.it, &fracs[fi].den.n, PART_CAP, false };
        appendDigits(nf, n);
        appendDigits(df, v.d);
        mainIt[mainN++] = { 'F', fi };
        return;
      }
    }
    pushC(f, '(');
    appendDigits(f, n);
    pushC(f, '/');
    appendDigits(f, v.d);
    pushC(f, ')');
    return;
  }
  double x = v.v;
  if (x < 0) { pushC(f, 'm'); x = -x; }
  char b[32];
  snprintf(b, sizeof b, "%.10g", x);
  char* e = strchr(b, 'e');
  for (char* q = b; *q && q != e; q++) pushC(f, *q);
  if (e) {  // 1.5e20 → 1.5×10^20
    int ex = atoi(e + 1);
    pushC(f, '*'); pushC(f, '1'); pushC(f, '0'); pushC(f, '^');
    if (ex < 0) { pushC(f, 'm'); ex = -ex; }
    appendDigits(f, ex);
  }
}

void loadAns() {
  clearAll();
  Field f = activeField();
  appendValue(f, lastRes);
}

void selectTarget(Target t) {
  if (t == TGT_MAIN) { target = TGT_MAIN; return; }
  if (justEval) clearAll();
  if (target == TGT_MAIN) {
    if (mainN && mainIt[mainN - 1].c == 'F') {
      curFrac = mainIt[mainN - 1].f;
    } else {
      if (mainN >= MAIN_CAP) return;
      int8_t f = allocFrac();
      if (f < 0) return;
      mainIt[mainN++] = { 'F', f };
      curFrac = f;
    }
  }
  target = t;
}

static char keyChar(uint8_t k) {
  if (k <= K_9) return '0' + k;
  switch (k) {
    case K_DOT: return '.';
    case K_ADD: return '+';
    case K_SUB: return '-';
    case K_MUL: return '*';
    case K_DIV: return '/';
    case K_POW: return '^';
    case K_SQR: return 's';
    case K_PCT: return '%';
    case K_LP: return '(';
    case K_RP: return ')';
    case K_SQRT: return 'r';
    case K_NEG: return 'n';
    case K_BS: return 'b';
  }
  return 0;
}

void editKey(uint8_t k) {
  char c = keyChar(k);
  if (!c) return;
  if (justEval) {
    if (c == 'b') { justEval = false; return; }
    if (isBinOp(c) || c == 's' || c == '%') {
      loadAns();
    } else if (c == 'r') {  // √ от ответа
      clearAll();
      Field f = activeField();
      pushC(f, 'r'); pushC(f, '(');
      appendValue(f, lastRes);
      pushC(f, ')');
      return;
    } else if (c == 'n') {  // ± меняет знак ответа
      lastRes = vNeg(lastRes);
      loadAns();
      justEval = true;
      return;
    } else {
      clearAll();  // цифра, запятая или скобка — новое выражение
    }
    justEval = false;
  }
  Field f = activeField();
  char last = lastC(f);
  if (isDigitC(c)) { pushC(f, c); return; }
  switch (c) {
    case '.':
      if (trailingHasDot(f)) return;
      if (!isDigitC(last)) pushC(f, '0');
      pushC(f, '.');
      return;
    case '+': case '-': case '*': case '/': case '^':
      if (!last || last == '(' || last == 'r') { if (c == '-') pushC(f, 'm'); return; }
      if (last == 'm') return;
      if (isBinOp(last)) {
        if (c == '-' && last != '+' && last != '-') pushC(f, 'm');  // 5 × −3
        else f.it[*f.n - 1].c = c;                                  // замена оператора
        return;
      }
      pushC(f, c);
      return;
    case 's': case '%':
      if (isOperandEnd(last)) pushC(f, c);
      return;
    case '(': pushC(f, '('); return;
    case ')': if (openParens(f) > 0 && isOperandEnd(last)) pushC(f, ')'); return;
    case 'r': pushC(f, 'r'); return;
    case 'n': toggleSign(f); return;
    case 'b': backspace(f); return;
  }
}

bool exprHasOps() {
  for (int i = 0; i < mainN; i++) {
    char c = mainIt[i].c;
    if (!isDigitC(c) && c != '.') return true;
  }
  return false;
}

void updatePreview() {
  previewOk = false;
  if (justEval || !mainN || !exprHasOps()) return;
  preview = evalMain();
  previewOk = !preview.err;
}

void saveState();

void doEquals() {
  if (justEval || !mainN) return;
  Val v = evalMain();
  target = TGT_MAIN;
  curFrac = -1;
  if (v.err) { errCode = v.err; return; }  // выражение остаётся, чтобы его исправить
  lastRes = v;
  hasRes = true;
  justEval = true;
}

void onKey(uint8_t k) {
  errCode = E_OK;
  switch (k) {
    case K_C: clearAll(); hasRes = false; break;
    case K_EQ: doEquals(); break;
    case K_MC: memSet = false; memVal = vExact(0, 1); saveState(); break;
    case K_MR:
      if (memSet) {
        if (justEval) clearAll();
        Field f = activeField();
        appendValue(f, memVal);
      }
      break;
    case K_MP: case K_MM: {
      Val v = justEval ? lastRes : evalMain();
      if (v.err) { errCode = v.err; break; }
      if (k == K_MM) v = vNeg(v);
      memVal = memSet ? vAdd(memVal, v) : v;
      memSet = !memVal.err;
      saveState();
      break;
    }
    case K_SEG_MAIN: selectTarget(TGT_MAIN); break;
    case K_SEG_NUM: selectTarget(TGT_NUM); break;
    case K_SEG_DEN: selectTarget(TGT_DEN); break;
    case K_BULB: fmtMode = (fmtMode + 1) % 3; saveState(); break;
    default: editKey(k); break;
  }
  updatePreview();
}

// ===================== Отрисовка выражения =====================
static const char* itemStr(char c, char* tmp) {
  switch (c) {
    case '.': return ",";
    case '-': case 'm': return "−";
    case '*': return "×";
    case '/': return "÷";
    case 'r': return "√";
    case 's': return "²";
  }
  tmp[0] = c; tmp[1] = 0;
  return tmp;
}

static int opPad(char c, const AAFont& f) { return isBinOp(c) ? (&f == &F_M ? 3 : 2) : 0; }

// Строка части дроби (или главная строка без дробей): ширина и, если s != nullptr, отрисовка
int drawPlain(Surface* s, const Item* it, int n, const AAFont& f, int x, int base, uint16_t col) {
  char tmp[2];
  int x0 = x;
  for (int i = 0; i < n; i++) {
    char c = it[i].c;
    const char* str = itemStr(c, tmp);
    int pad = opPad(c, f);
    x += pad;
    if (s) drawText(*s, f, x, base, str, col);
    x += textW(f, str) + pad;
  }
  return x - x0;
}

// Геометрия строки выражения внутри экрана
#define EXP_BASE 57       // базовая линия основного текста
#define EXP_BAR 50        // линия дроби
#define EXP_RIGHT 288
#define EXP_LEFT 12

int partW(const Part& p) { return p.n ? drawPlain(nullptr, p.it, p.n, F_F, 0, 0, 0) : 11; }

void drawPlaceholder(Surface& s, int x, int base, uint16_t col) {
  roundRectS(s, x + 0.5f, base - 13 + 0.5f, 10, 14, 2.5f, C_PANEL, col, 1.2f);
}

void drawCursor(Surface& s, int x, int top, int bottom) {
  if (cursorOn) fillRectS(s, x, top, 2, bottom - top, C_ACCENT);
}

// Главная строка с дробями. s == nullptr — только измерить ширину
int drawMainLine(Surface* s, int x) {
  char tmp[2];
  int x0 = x;
  int capM = capH(F_M), capF = capH(F_F);
  for (int i = 0; i < mainN; i++) {
    char c = mainIt[i].c;
    if (c == 'F') {
      int fi = mainIt[i].f;
      Frac& F = fracs[fi];
      int wn = partW(F.num), wd = partW(F.den);
      int fw = (wn > wd ? wn : wd) + 8;
      x += 2;
      if (s) {
        bool editing = (target != TGT_MAIN && curFrac == fi);
        uint16_t barC = editing ? C_ACCENT : C_DIGIT;
        fillRectS(*s, x, EXP_BAR, fw, 2, barC);
        int nb = EXP_BAR - 4, db = EXP_BAR + 5 + capF;
        int nx = x + (fw - wn) / 2, dx = x + (fw - wd) / 2;
        bool numA = editing && target == TGT_NUM, denA = editing && target == TGT_DEN;
        if (F.num.n) drawPlain(s, F.num.it, F.num.n, F_F, nx, nb, C_DIGIT);
        else drawPlaceholder(*s, nx, nb, numA ? C_ACCENT : C_DIM);
        if (F.den.n) drawPlain(s, F.den.it, F.den.n, F_F, dx, db, C_DIGIT);
        else drawPlaceholder(*s, dx, db, denA ? C_ACCENT : C_DIM);
        if (numA) drawCursor(*s, F.num.n ? nx + wn + 1 : nx + 12, nb - capF - 1, nb + 2);
        if (denA) drawCursor(*s, F.den.n ? dx + wd + 1 : dx + 12, db - capF - 1, db + 2);
      }
      x += fw + 2;
    } else {
      const char* str = itemStr(c, tmp);
      int pad = opPad(c, F_M);
      x += pad;
      if (s) drawText(*s, F_M, x, EXP_BASE, str, C_DIGIT);
      x += textW(F_M, str) + pad;
    }
  }
  if (s && target == TGT_MAIN && !justEval) drawCursor(*s, x + 1, EXP_BASE - capM - 2, EXP_BASE + 3);
  return x - x0 + 4;
}

// ===================== Отрисовка результата =====================
// Рисует значение, выровненное по правому краю right. big — крупный шрифт итогового ответа
void drawValue(Surface& s, const Val& v, int right, bool big, uint16_t col) {
  const AAFont& fn = big ? F_L : F_M;
  int base = big ? 110 : 108;
  char sign[4] = "", whole[32] = "", num[24] = "", den[24] = "", dec[64] = "";
  bool frac = false;
  if (v.exact && v.d != 1 && fmtMode != 2) {
    int64_t an = v.n < 0 ? -v.n : v.n;
    if (v.n < 0) strcpy(sign, "−");
    if (fmtMode == 1 && an > v.d) {
      snprintf(whole, sizeof whole, "%lld", (long long)(an / v.d));
      an %= v.d;
    }
    snprintf(num, sizeof num, "%lld", (long long)an);
    snprintf(den, sizeof den, "%lld", (long long)v.d);
    frac = true;
  } else if (v.exact) {
    fmtDecimalExact(v.n, v.d, dec, sizeof dec);
  } else {
    fmtReal(v.v, dec, sizeof dec);
  }

  if (!frac) {
    const AAFont* f = &fn;
    if (textW(*f, dec) > right - EXP_LEFT) f = &F_M;  // длинное число — шрифт помельче
    drawText(s, *f, right - textW(*f, dec), base, dec, col);
    return;
  }
  int capF = capH(F_F);
  int wn = textW(F_F, num), wd = textW(F_F, den);
  int fw = (wn > wd ? wn : wd) + 6;
  int bar = big ? 95 : 94;
  int x = right - fw;
  fillRectS(s, x, bar, fw, 2, col);
  drawText(s, F_F, x + (fw - wn) / 2, bar - 4, num, col);
  drawText(s, F_F, x + (fw - wd) / 2, bar + 5 + capF, den, col);
  x -= 4;
  if (whole[0]) { x -= textW(fn, whole); drawText(s, fn, x, base, whole, col); x -= 2; }
  if (sign[0]) { x -= textW(fn, sign); drawText(s, fn, x, base, sign, col); }
}

void drawBulb(Surface& s, float cx, float cy, uint16_t c) {
  ringS(s, cx, cy - 2, 6.2f, 1.8f, c);
  capsuleS(s, cx - 2.6f, cy + 6.5f, cx + 2.6f, cy + 6.5f, 0.95f, c);
  capsuleS(s, cx - 1.6f, cy + 9.3f, cx + 1.6f, cy + 9.3f, 0.95f, c);
}

void renderDisplay() {
  Surface& s = sDisp;
  surfNoClip(s);
  surfFill(s, C_BG);
  roundRectS(s, 0.5f, 0.5f, DISP_W - 1, DISP_H - 1, 16, C_PANEL, C_PANEL_BORDER, 2.0f);

  int x = 16;
  if (memSet) x = drawText(s, F_S, x, 22, "M", C_ACCENT) + 8;
  drawText(s, F_S, x, 22, FMT_NAMES[fmtMode], C_DIM);
  drawBulb(s, 279, 17, fmtMode ? C_ACCENT : C_BULB);

  surfClip(s, EXP_LEFT, 26, EXP_RIGHT + 2, 76);
  int w = drawMainLine(nullptr, 0);
  drawMainLine(&s, EXP_RIGHT - w);

  surfClip(s, EXP_LEFT, 74, EXP_RIGHT + 2, DISP_H - 3);
  if (errCode) {
    const char* m = errText(errCode);
    drawText(s, F_M, EXP_RIGHT - textW(F_M, m), 106, m, C_ERR);
  } else if (justEval) {
    drawValue(s, lastRes, EXP_RIGHT, true, C_WHITE);
  } else if (previewOk) {
    drawValue(s, preview, EXP_RIGHT, false, C_DIM);
  }
  surfNoClip(s);
  pushPixels(DISP_X, DISP_Y, s.w, s.h, s.px);
}

void renderSegments() {
  Surface& s = sSeg;
  surfFill(s, C_BG);
  int segW = (SEG_W - 2 * 6) / 3;
  for (int i = 0; i < 3; i++) {
    int x = i * (segW + 6);
    bool on = (int)target == i;
    roundRectS(s, x + 0.5f, 0.5f, segW - 1, SEG_H - 1, 10, on ? C_SEG_ON : C_KEY, on ? C_EQ : C_BORDER, 1.5f);
    drawTextCenter(s, F_S, x + segW / 2, SEG_H / 2 - 1, SEG_NAMES[i], on ? C_WHITE : C_SEG_TEXT);
  }
  pushPixels(SEG_X, SEG_Y, s.w, s.h, s.px);
}

// ===================== Клавиатура =====================
static const char* keyLabel(uint8_t id) {
  static const char* const L[] = {
    "0", "1", "2", "3", "4", "5", "6", "7", "8", "9",
    ",", "+", "−", "×", "÷", "xⁿ", "x²", "%", "(", ")", "√x", "±", "",
    "C", "=", "MC", "MR", "M+", "M−",
  };
  return id <= K_MM ? L[id] : "";
}

void buildLayout() {
  float colW = (PAD_W - 4 * COL_GAP) / 5.0f;
  nKeys = 0;
  for (int r = 0; r < 6; r++)
    for (int c = 0; c < 5; c++) {
      uint8_t id = LAYOUT[r][c];
      if (c > 0 && LAYOUT[r][c - 1] == id) continue;  // продолжение широкой клавиши
      int span = 1;
      while (c + span < 5 && LAYOUT[r][c + span] == id) span++;
      int x0 = PAD_X + (int)roundf(c * (colW + COL_GAP));
      int x1 = PAD_X + (int)roundf((c + span) * (colW + COL_GAP) - COL_GAP);
      keys[nKeys++] = { id, (int16_t)x0, (int16_t)(PAD_Y + r * ROW_PITCH), (int16_t)(x1 - x0), (int16_t)KEY_H };
    }
}

void renderKey(const Key& k, bool down) {
  Surface& s = sKey;
  surfSize(s, k.w, k.h);
  surfFill(s, C_BG);
  uint16_t fill = down ? C_KEY_DOWN : C_KEY, border = down ? C_EQ : C_BORDER;
  if (k.id == K_EQ) { fill = down ? C_EQ_DOWN : C_EQ; border = fill; }
  roundRectS(s, 0.5f, 0.5f, k.w - 1, k.h - 1, 11, fill, border, 1.6f);

  float cx = k.w / 2.0f, cy = k.h / 2.0f;
  if (k.id == K_BS) {  // значок «стереть»
    float xs[] = { cx - 13, cx - 5.5f, cx + 12, cx + 12, cx - 5.5f };
    float ys[] = { cy, cy - 9, cy - 9, cy + 9, cy + 9 };
    polyS(s, xs, ys, 5, C_FUNC);
    capsuleS(s, cx - 1.5f, cy - 4, cx + 6.5f, cy + 4, 1.4f, fill);
    capsuleS(s, cx + 6.5f, cy - 4, cx - 1.5f, cy + 4, 1.4f, fill);
  } else {
    uint8_t id = k.id;
    const char* lab = keyLabel(id);
    bool digit = id <= K_9 || id == K_DOT;
    bool bigFont = digit || id == K_ADD || id == K_SUB || id == K_MUL || id == K_DIV || id == K_LP || id == K_RP || id == K_EQ;
    uint16_t col = digit ? C_DIGIT : (id == K_C ? C_CLEAR : (id == K_EQ ? C_WHITE : C_FUNC));
    drawTextCenter(s, bigFont ? F_K : F_M, (int)cx, (int)cy, lab, col);
  }
  pushPixels(k.x, k.y, s.w, s.h, s.px);
}

void renderAll() {
  static uint16_t row[SCREEN_W];
  for (int i = 0; i < SCREEN_W; i++) row[i] = C_BG;
  for (int y = 0; y < SCREEN_H; y++) pushPixels(0, y, SCREEN_W, 1, row);
  for (int i = 0; i < nKeys; i++) renderKey(keys[i], false);
  renderSegments();
  renderDisplay();
}

// Что под пальцем: индекс в keys[] (≥0) или код зоны (K_SEG_*, K_BULB) со знаком минус
int hitTest(int x, int y) {
  for (int i = 0; i < nKeys; i++) {
    const Key& k = keys[i];
    if (x >= k.x - 3 && x < k.x + k.w + 3 && y >= k.y - 3 && y < k.y + k.h + 3) return i;
  }
  if (y >= SEG_Y - 3 && y < SEG_Y + SEG_H + 3) {
    int i = (x - SEG_X) * 3 / SEG_W;
    if (i >= 0 && i < 3) return -(K_SEG_MAIN + i) - 1;
  }
  if (y >= DISP_Y && y < DISP_Y + 40 && x >= DISP_X + DISP_W - 60) return -K_BULB - 1;
  return -1000;
}

// ===================== Сохранение памяти и формата =====================
#ifndef HOST_SIM
Preferences prefs;
void saveState() {
  prefs.begin("calc", false);
  prefs.putBool("ms", memSet);
  prefs.putBytes("mv", &memVal, sizeof(Val));
  prefs.putUChar("fmt", fmtMode);
  prefs.end();
}
void loadState() {
  prefs.begin("calc", true);
  memSet = prefs.getBool("ms", false);
  if (prefs.getBytes("mv", &memVal, sizeof(Val)) != sizeof(Val)) memSet = false;
  fmtMode = prefs.getUChar("fmt", 0) % 3;
  prefs.end();
}
#else
void saveState() {}
void loadState() {}
#endif

bool uiInit() {
  if (!decodeFont(F_S) || !decodeFont(F_M) || !decodeFont(F_F) || !decodeFont(F_L) || !decodeFont(F_K)) return false;
  if (!surfAlloc(sDisp, DISP_W, DISP_H) || !surfAlloc(sSeg, SEG_W, SEG_H) || !surfAlloc(sKey, 140, KEY_H)) return false;
  memVal = vExact(0, 1);
  buildLayout();
  loadState();
  return true;
}

// ===================== Железо =====================
#ifndef HOST_SIM
#define PIN_SDA 21
#define PIN_SCL 22
#define PIN_BL 25
#define PIN_BOOT 0
#define PIN_PWR 36
#define TCA9554_ADDR 0x20
#define FT6336_ADDR 0x38
#define BL_ON 230
#define BL_DIM 18
#define DIM_AFTER_MS 60000UL

Arduino_DataBus* bus = new Arduino_ESP32SPI(27 /* DC */, 5 /* CS */, 18 /* SCK */, 23 /* MOSI */, 19 /* MISO */);
Arduino_GFX* gfx = new Arduino_ST7796(bus, GFX_NOT_DEFINED, 0 /* портрет */, true /* IPS */);

void pushPixels(int x, int y, int w, int h, const uint16_t* px) {
  gfx->draw16bitRGBBitmap(x, y, (uint16_t*)px, w, h);
}

void tcaWrite(uint8_t reg, uint8_t val) {
  Wire.beginTransmission(TCA9554_ADDR);
  Wire.write(reg);
  Wire.write(val);
  Wire.endTransmission();
}

void resetPanelAndTouch() {
  tcaWrite(0x01, 0xFF);
  tcaWrite(0x03, 0b11111100);  // P0 — сброс LCD, P1 — сброс тача
  tcaWrite(0x01, 0b11111100);
  delay(10);
  tcaWrite(0x01, 0xFF);
  delay(200);
}

bool readTouch(TouchPt& t) {
  Wire.beginTransmission(FT6336_ADDR);
  Wire.write(0x02);
  if (Wire.endTransmission(false) != 0) return false;
  if (Wire.requestFrom((uint8_t)FT6336_ADDR, (uint8_t)5) != 5) return false;
  uint8_t d[5];
  for (int i = 0; i < 5; i++) d[i] = Wire.read();
  uint8_t n = d[0] & 0x0F;
  if (n == 0 || n > 2) return false;
  t.x = ((d[1] & 0x0F) << 8) | d[2];
  t.y = ((d[3] & 0x0F) << 8) | d[4];
  if (t.x >= SCREEN_W) t.x = SCREEN_W - 1;
  if (t.y >= SCREEN_H) t.y = SCREEN_H - 1;
  return true;
}

int downIdx = -1000;            // что нажато сейчас
bool touching = false, dimmed = false, wakeTouch = false;
int releaseCount = 0;
uint32_t lastActivity = 0, nextRepeat = 0, lastBlink = 0;

void pressAction(int hit) {
  if (hit >= 0) {
    renderKey(keys[hit], true);
    onKey(keys[hit].id);
  } else if (hit != -1000) {
    onKey((uint8_t)(-hit - 1));
    renderSegments();
  }
  cursorOn = true;
  lastBlink = millis();
  renderDisplay();
  if (hit < 0) renderSegments();
}

void setup() {
  Serial.begin(115200);
  pinMode(PIN_BOOT, INPUT_PULLUP);
  pinMode(PIN_PWR, INPUT);
  Wire.begin(PIN_SDA, PIN_SCL);
  Wire.setClock(400000);
  resetPanelAndTouch();
  if (!gfx->begin()) Serial.println("gfx->begin() failed!");
  gfx->fillScreen(C_BG);
  if (!uiInit()) {
    Serial.println("Out of memory");
    while (true) delay(1000);
  }
  renderAll();
  analogWrite(PIN_BL, BL_ON);
  lastActivity = millis();
}

void loop() {
  uint32_t now = millis();

  // Физические кнопки
  static bool lastBoot = digitalRead(PIN_BOOT), lastPwr = digitalRead(PIN_PWR);
  bool boot = digitalRead(PIN_BOOT), pwr = digitalRead(PIN_PWR);
  if (lastBoot && !boot) { onKey(K_EQ); renderDisplay(); renderSegments(); lastActivity = now; }
  if (!lastPwr && pwr) { onKey(K_BULB); renderDisplay(); lastActivity = now; }
  lastBoot = boot;
  lastPwr = pwr;

  // Тач
  TouchPt t;
  bool down = readTouch(t);
  if (down) {
    releaseCount = 0;
    if (!touching) {
      touching = true;
      lastActivity = now;
      if (dimmed) {  // первое касание только будит экран
        dimmed = false;
        wakeTouch = true;
        analogWrite(PIN_BL, BL_ON);
      } else {
        downIdx = hitTest(t.x, t.y);
        pressAction(downIdx);
        nextRepeat = now + 450;
      }
    } else if (downIdx >= 0 && keys[downIdx].id == K_BS && now >= nextRepeat) {
      onKey(K_BS);  // удержание «стереть» — стирает дальше
      renderDisplay();
      renderSegments();
      nextRepeat = now + 110;
      lastActivity = now;
    }
  } else if (touching && ++releaseCount >= 2) {
    touching = false;
    wakeTouch = false;
    if (downIdx >= 0) renderKey(keys[downIdx], false);
    downIdx = -1000;
  }

  // Мигание курсора
  if (now - lastBlink >= 530) {
    lastBlink = now;
    cursorOn = !cursorOn;
    if (!justEval && !dimmed) renderDisplay();
  }

  // Подсветка гаснет при простое
  if (!dimmed && now - lastActivity > DIM_AFTER_MS) {
    dimmed = true;
    analogWrite(PIN_BL, BL_DIM);
  }
  delay(8);
}
#endif
