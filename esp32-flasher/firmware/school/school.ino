/*
  Школьный набор для Waveshare ESP32-Touch-LCD-3.5
  (ESP32-D0WD-V3, 3.5" ST7796 320x480, ёмкостный тач FT6336, microSD, динамик)

  Вкладки внизу экрана:
    • Калькулятор — точные дроби, скобки, степени, корни, память (как отдельная прошивка)
    • Игры для двоих — шахматы (все правила), русские шашки, крестики-нолики, «4 в ряд»
    • Справочник — формулы по алгебре, геометрии, тригонометрии, физике, химии,
      таблица умножения, подсказки по русскому языку; «Мои файлы» открывают
      свои TXT, HTML, JPG и PNG с SD-карты. HTML показывается как в браузере:
      стили, картинки, таблицы, ссылки между страницами (без JavaScript)
    • Настройки — яркость, затемнение, цвет оформления, щелчок, поворот экрана, Wi-Fi, сведения о плате
  Экран телефона: включите Wi-Fi в настройках, и приложение ESP32 Flasher сможет показывать
  на плате открытые в нём страницы (вкладка «Плата по Wi-Fi» → «Экран на плату»).
  Нажатия на экране платы передаются обратно в браузер телефона, свайп за край
  снимка листает страницу на телефоне, двойное касание — увеличение.

  Кнопки на плате: BOOT — «=» в калькуляторе, в других вкладках «назад»;
  PWR — формат результата калькулятора.

  Arduino IDE: плата "ESP32 Dev Module", PSRAM "Enabled",
  Partition Scheme "Huge APP (3MB No OTA/1MB SPIFFS)".
  Библиотеки: "GFX Library for Arduino", "JPEGDEC", "PNGdec".
  Рядом со скетчем должны лежать htmlengine.h и hv_fonts.h (движок HTML-страниц).
  Шрифты Inter (SIL OFL 1.1) и DejaVu Sans (свободная лицензия) встроены в скетч.
*/
#include "htmlengine.h"

#ifndef HOST_SIM
#include <Arduino_GFX_Library.h>
#include <Wire.h>
#include <SPI.h>
#include <SD.h>
#include <ESP_I2S.h>
#include <Preferences.h>
#include <WiFi.h>
#include <WebServer.h>
#include <ESPmDNS.h>
#endif
#include <JPEGDEC.h>
#include <math.h>
#include <stdint.h>
#include <stdio.h>
#include <stdlib.h>
#include <string.h>
#include <string>
#include <vector>
#include <algorithm>

// ===================== Константы =====================
#define MK565(r, g, b) ((uint16_t)((((r) & 0xF8) << 8) | (((g) & 0xFC) << 3) | ((b) >> 3)))

#define C_BG           MK565(0, 0, 0)
#define C_KEY          MK565(13, 13, 16)
#define C_KEY_DOWN th_C_KEY_DOWN
#define C_BORDER       MK565(54, 50, 70)
#define C_PANEL        MK565(22, 23, 28)
#define C_PANEL_BORDER th_C_PANEL_BORDER
#define C_DIGIT        MK565(244, 244, 247)
#define C_FUNC th_C_FUNC
#define C_CLEAR        MK565(232, 41, 95)
#define C_EQ th_C_EQ
#define C_EQ_DOWN th_C_EQ_DOWN
#define C_BULB th_C_BULB
#define C_DIM          MK565(138, 134, 160)
#define C_SEG_TEXT th_C_SEG_TEXT
#define C_SEG_ON th_C_SEG_ON
#define C_ACCENT th_C_ACCENT
#define C_ERR          MK565(255, 96, 116)
#define C_WHITE        MK565(255, 255, 255)

#define SCREEN_W 320
#define SCREEN_H 480
#define TAB_Y 428                  // нижняя панель вкладок
#define TAB_H 52
#define DISP_X 10
#define DISP_Y 8
#define DISP_W 300
#define DISP_H 118
#define SEG_X 10
#define SEG_Y 130
#define SEG_W 300
#define SEG_H 30
#define PAD_X 10
#define PAD_Y 166
#define PAD_W 300
#define KEY_H 39
#define ROW_PITCH 43
#define COL_GAP 6

#define MAIN_CAP 64
#define PART_CAP 24
#define FRAC_CAP 12

// Коды клавиш
enum KeyId : uint8_t {
  K_0, K_1, K_2, K_3, K_4, K_5, K_6, K_7, K_8, K_9,
  K_DOT, K_ADD, K_SUB, K_MUL, K_DIV, K_POW, K_SQR, K_PCT, K_LP, K_RP, K_SQRT, K_NEG, K_BS,
  K_C, K_EQ, K_MC, K_MR, K_MP, K_MM,
  K_SEG_MAIN, K_SEG_NUM, K_SEG_DEN, K_BULB, K_NONE = 255
};

enum : uint8_t { E_OK = 0, E_SYNTAX, E_DIV0, E_DOMAIN, E_OVER };
enum Target : uint8_t { TGT_MAIN, TGT_NUM, TGT_DEN };

// ===================== Типы =====================
// (все типы объявлены до первой функции — так требует генератор прототипов Arduino)
struct Glyph { uint16_t cp; uint8_t w, h; int8_t xo, yo; uint8_t adv; uint32_t off; };
struct AAFont { uint8_t* bits; const Glyph* g; uint16_t n; int8_t asc, desc; const char* b64; uint32_t nbytes; };

struct Surface {
  uint16_t* px = nullptr;
  int w = 0, h = 0, cap = 0;
  int cx0 = 0, cy0 = 0, cx1 = 0, cy1 = 0;  // область отсечения
};

// Элемент выражения: символ ('0'..'9', '.', '+', '-', '*', '/', '^', 's' = ², '%', '(', ')',
// 'r' = √, 'm' = унарный минус) или дробь ('F', f = номер дроби)
struct Item { char c; int8_t f; };
struct Part { Item it[PART_CAP]; uint8_t n; };
struct Frac { Part num, den; bool used; };
struct Field { Item* it; uint8_t* n; uint8_t cap; bool isMain; };

// Значение: точная дробь n/d или приближённое v
struct Val { bool exact; int64_t n, d; double v; bool pct; uint8_t err; };

struct Key { uint8_t id; int16_t x, y, w, h; };

struct TouchPt { int16_t x, y; };

struct Parser {
  const Item* it; int n; int p; uint8_t err;
  char peek() const { return p < n ? it[p].c : 0; }
  Val expr();
  Val term();
  Val unary();
  Val power();
  Val postfix();
  Val primary();
  Val number();
  Val fail(uint8_t e);
};

// ---- Сгенерировано genfonts.py: шрифт Inter (SIL OFL 1.1), запасной DejaVu Sans ----
// F_S: 14px, 172 глифов, 6739 байт
static const char F_S_B64[] PROGMEM =
  "vwvwvwvgrgrgrgRQAAnQrQnw+J4PeND2fQ5gA/EJoABeAMcACMAOUB////+hPpNvQgD0BuACT1OdML////8AbQDWAAmwD0AAuALx"
  "AAAAQAAAAA0AAAB9/pEAj8+vsA7A0J8Q/A0AAAn94gAAB9/6IAAA6P4BIQ0F9C+Q0H8wz7+/wAGe/pEAAA0AAAAAQAABv8EACbAG"
  "4tgAPyAIoJoA1wAG0tgH0AABv8EvMAAAAAC4AAAAAAbhLPoAAB9Amz9QAKoAtwxwBPEAmy9QHmAALfoACO+QAAT5f2AAfwDpAAT0"
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  "AAPP1QK/5gHti/r9e/RPMAj8AA6S+RTv9xX3CP/7GP/8AAJTAAJUAF7mBMDrf73QYgK7MF7mBMDrf5zgcgTuUA=="
  ;
static const Glyph F_S_GLYPHS[] PROGMEM = {
  {0x0020, 0, 0, 0, 0, 4, 0},
  {0x0021, 3, 11, 1, -11, 4, 0},
  {0x0022, 5, 4, 1, -11, 7, 33},
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  {0x2248, 8, 6, 1, -7, 9, 13430},
};
AAFont F_S = { nullptr, F_S_GLYPHS, 172, 14, 4, F_S_B64, 6739 };

// F_M: 21px, 172 глифов, 14476 байт
static const char F_M_B64[] PROGMEM =
  "H/cf9w/2D/YP9g/2D/UP9Q/1D/ULwwAAAAAL5E/6DOTvcf9N9g/z31D/LPQP8b9A7xrzDfAAAM8QBvcAAADvAAj1AAAB/AAL8gAA"
  "A/oADfAAB97/3d/90Az//////+AAC/IAX4AAAA3wAH9gAAAP0ACvMAAAL7AAzxAAj///////II3v7d3/3AAAnzAE+QAAAM8QBvcA"
  "AADuAAn0AAAB/AAL8gAAAAANcAAAAAANcAAAABnf/IEABP////4gHv1dmP/AX/INcF/xf/ANcAVRX/YNcAAADf/OcAAAAs///HAA"
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  "AAAAAAX/EAAAAABf8QAAAAAF/xAAAAAAX/EAAAAABf8V/wAAD/UAAL+l/wAAD/UAAL+l/wAAD/UAAL+l/wAAD/UAAL+l/wAAD/UA"
  "AL+l/wAAD/UAAL+l/wAAD/UAAL+l/wAAD/UAAL+l/wAAD/UAAL+l/wAAD/UAAL+l/wAAD/UAAL+l/wAAD/UAAL+l/wAAD/UAAL+l"
  "/wAAD/UAAL+l//////////+l//////////+l/wAAD/UAAL+gBf8AAA/1AAC/oAX/AAAP9QAAv6AF/wAAD/UAAL+gBf8AAA/1AAC/"
  "oAX/AAAP9QAAv6AF/wAAD/UAAL+gBf8AAA/1AAC/oAX/AAAP9QAAv6AF/wAAD/UAAL+gBf8AAA/1AAC/oAX/AAAP9QAAv6AF/wAA"
  "D/UAAL+gBf8AAA/1AAC/oAX///////////81////////////MAAAAAAAAAAC/yAAAAAAAAAAAv8gAAAAAAAAAAL/IAAAAAAAAAAA"
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  "9iX/cd///9It///8ABnf2AAAjv2AAE38QACaEv//+RT/B/sTz//3A1IABIlAADzrMACJEf//9gH/Bvwl/1f+BrUAX//3AAAABu6A"
  "AA=="
  ;
static const Glyph F_M_GLYPHS[] PROGMEM = {
  {0x0020, 0, 0, 0, 0, 6, 0},
  {0x0021, 4, 16, 1, -16, 6, 0},
  {0x0022, 7, 6, 2, -16, 10, 64},
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  {0x2248, 12, 9, 1, -10, 14, 28843},
};
AAFont F_M = { nullptr, F_M_GLYPHS, 172, 21, 6, F_M_B64, 14476 };

// F_F: 17px, 28 глифов, 1321 байт
static const char F_F_B64[] PROGMEM =
  "Be+xAAB/QAL9j5AAL5AAX1DNAAvhAAX1DNAG9AAAL9j5AfoAAABe+xC+EAAAAAAAX1AAAAAAAB+gGv5gAAAK8Qj53yAABfUAzQT2"
  "AAHrAA3QP2AAryAArzj0AE9gAAP/+wAAAAAAAVQAAI+gH/QG/gC/kA/0Av8QT/AF/gBv4AT/AC/yAO9QCfoAP/EAz2ADdR/yAK+Q"
  "BP8AD/UAr5AH/ABf4AT/AE/wBv4Aj8AL+AH/MG/QDPYAdwAAABAAAAB/cAAAB/cAAAB/cACMzv7Mi/////oAB/cAAAB/cAAAB/cA"
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  "AAv4AAABqRAGUu/+Q/yvRO//feABm3AAAAAHcb/sRPyf////bfEYrHAiAAAAAA=="
  ;
static const Glyph F_F_GLYPHS[] PROGMEM = {
  {0x0020, 0, 0, 0, 0, 5, 0},
  {0x0025, 15, 14, 1, -13, 17, 0},
  {0x0028, 5, 16, 1, -13, 7, 210},
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  {0x2248, 9, 9, 1, -9, 11, 2560},
};
AAFont F_F = { nullptr, F_F_GLYPHS, 28, 17, 5, F_F_B64, 1321 };

// F_L: 36px, 28 глифов, 5059 байт
static const char F_L_B64[] PROGMEM =
  "AAW+/HAAAAAAAAP/8gAACv///8EAAAAAAN/1AAAG//y//6AAAAAAn/oAAADv9gAv/yAAAABP/hAAAB//AAC/9AAAAB7/QAAABP/Q"
  "AAn/cAAACv+QAAAAT/0AAJ/3AAAF/9EAAAAB/+AAC/9AAAH/8wAAAAAO/2AD//IAAL/4AAAAAABv/8v/+gAAb/0AAAAAAACv///8"
  "EAAv/yAAAAAAAABb78cAAAz/cAAAAAAAAAAAAAAAB/+wAAAAAAAAAAAAAAAD//IAAAAAAAAAAAAAAADf9QAAAmh0AAAAAAAAAJ/6"
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  "AAAAAACv/+AAAAAAAADv//IAAAAAAAC///AAAAAAAAAt/0AAAAAAAAAAEAAAAAAAAAAAAAAAAABWZmZmZmZmZmHf//////////Lf"
  "//////////Lf//////////IAAAAAAAAAAAAAAAAAAAAAAAAAAAAAEAAAAAAAAAAs/kAAAAAAAAC///AAAAAAAADv//IAAAAAAACv"
  "/+AAAAAAAAAb/TAAAAAAAgAAAAAAIAAAAAACAAT/4wAAAF/+MAAABv/SD//9AAAB///AAAAv//sf//8AAAP///AAAE///Q7//AAA"
  "AO//sAAAH//6A8/CAAAAPfsQAAAE36Hf//////////Lf//////////Lf//////////J4iIiIiIiIiIEAAAAAAAAAAF//gAAAAAAA"
  "AAAK//MAAAAAAAAAAP/9AAAAAAAAAABf/4AAAAAAAAAACv/yAAAAAAAAAAH//AAAAAAAAAAAX/9wAAAAAAAAAAv/8QAAAAAAAAAB"
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  "r/////4G/+AAAI////9QJEQAAABe//5AAAAAAAAAA0IAAA=="
  ;
static const Glyph F_L_GLYPHS[] PROGMEM = {
  {0x0020, 0, 0, 0, 0, 10, 0},
  {0x0025, 29, 27, 3, -26, 36, 0},
  {0x0028, 10, 33, 3, -28, 14, 783},
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  {0x2248, 19, 16, 2, -18, 23, 9814},
};
AAFont F_L = { nullptr, F_L_GLYPHS, 28, 35, 9, F_L_B64, 5059 };

// F_K: 27px, 19 глифов, 2264 байт
static const char F_K_B64[] PROGMEM =
  "AEz+oQAAAAB/4QAF///+EAAAA/9AAA76Eu+AAAAN+QAAH/QAn8AAAI/hAAA/8gB/0AAD/0AAAB/0AJ/AAA35AAAADvoC74AAj+EA"
  "AAAF///+EAP/QAAAAABM/qEADfkAAAAAAAAAAACP0QAAAAAAAAAAA/8wAAAAAAAAAAAd+AACrdogAAAAAJ/QAC////IAAAAE/zAA"
  "v9It+gAAAB74AAD/YAf+AAAAn9AAAP9ABf8AAAT/MAAA/2AH/gAAHvcAAAC/wR37AACvwAAAAD////IABP8gAAAAA7/rIAAA7+AA"
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  "AAAAAAAAAAAAAAAAr///////8a////////FZmZmZmZmRAAAAAAAAAAAABckQAAAAAB//gAAAAAAv/5AAAAAACPwgAACv///////x"
  "r///////8WqqqqqqqqE="
  ;
static const Glyph F_K_GLYPHS[] PROGMEM = {
  {0x0025, 22, 20, 2, -20, 27, 0},
  {0x0028, 8, 25, 2, -21, 11, 440},
  {0x0029, 7, 25, 1, -21, 11, 640},
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  {0x2212, 14, 3, 2, -9, 18, 4486},
};
AAFont F_K = { nullptr, F_K_GLYPHS, 19, 27, 7, F_K_B64, 2264 };

// F_T: 20px, 226 глифов, 18057 байт
static const char F_T_B64[] PROGMEM =
  "P/8D/+Av/gL/4C/+Av/QH/0B/9Af/AD/wAIhABMAH/wE//AL5wD/wM/wD/sL/wD/sL/wDvoK/gDfkJ/QDPgI/AARAAEQAAH/IA/0"
  "AABP8AL/IAAG/QBP8AAjr8M4/jIL//////+g7//////3AB/zAP9QAAP/EB/yAABv4AT/AAj//////9C///////oDPvgz36MgAP9A"
  "DvUAAC/xAf8wAAX/AD/xAAAAAAwwAAAAAADzAAAAADrv/GAAAI/////AAE//38//kAn/kPNP/gDP9g8wVmAJ/+bzAAAAL///xyAA"
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  "Ac/RAu+wHP0QAC77z9EAAALv/RAAAAHP+wAAABz977AAAc/RLvsAHP0QAu+wX9EAAC70BRAAAAJQ"
  ;
static const Glyph F_T_GLYPHS[] PROGMEM = {
  {0x0020, 0, 0, 0, 0, 5, 0},
  {0x0021, 5, 15, 1, -15, 7, 0},
  {0x0022, 9, 7, 1, -15, 11, 75},
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  {0x2715, 12, 12, 2, -13, 16, 35970},
};
AAFont F_T = { nullptr, F_T_GLYPHS, 226, 20, 5, F_T_B64, 18057 };

// F_B: 15px, 225 глифов, 9551 байт
static const char F_B_B64[] PROGMEM =
  "ngngngngnQnQjQNQAAjQnQfw934PZuDlXQ1RICEADzAfEAAfEE4AAE4AewAP////8gKpIscgAMYA4wAR5RLzEL////+AA+AGwAAG"
  "wAmQAAmQC3AAAABSAAAACkAAAF3/swBfnIzyDKCkHXDLCkAABfzVAAADr/xAAACov0AACkDKH3CkDKCvjIz0AI3/xAAACkAAAABC"
  "AACP5AAB5QA/J9AAmwAF0D8AThAAPzjQHlAAAI7TCqAAAAAABeEAAAAAAeQG7UAAALkB9G4AAF4QTgHwAC9AAvNuAAuAAAf+UABe"
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  "As+WevkADNIAAE9wXyAAAAbxmwAAAAD0yQAAAADnmwAAAAD0XyAAAAbxDNEAAE9wAt+FavkAAAfP60AAAQAAAAHnAAC6CPcAv0AI"
  "979AAAj/QAAAv/cAAL9I9wC/QAj3G0AACIA="
  ;
static const Glyph F_B_GLYPHS[] PROGMEM = {
  {0x0020, 0, 0, 0, 0, 4, 0},
  {0x0021, 3, 11, 1, -11, 4, 0},
  {0x0022, 5, 5, 1, -11, 7, 33},
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  {0x2715, 9, 9, 1, -10, 12, 19020},
};
AAFont F_B = { nullptr, F_B_GLYPHS, 225, 15, 4, F_B_B64, 9551 };

// F_SB: 15px, 225 глифов, 10130 байт
static const char F_SB_B64[] PROGMEM =
  "r3r3r2n2n2n1j1NyAwr3flj2j1f1j0b0f0bzbzJxJxAB9wP1AAP1BfIABfII8AH/////YY7oj9ggDaAPgAWPx5+mDP////sAbyCP"
  "AACPAL0AAL0A2gAAAAMgAAAACGAAAAXP/EAAf/7v9QDvOGX8AP84YBEAn/6AAAAI7/6BAAAJvvoBUwhi/wL/GGT/AL/+7/gACN/9"
  "YAAACGAAAAADIAAAr9QAANoAb2vgAI4QCeBvED9AAH858A2QAAHf9wnhAAAAMQTzAAAAAAHoA9+gAACdANxvcABPMA9g2QAegADq"
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  "AABfTOAAAAA/efEAAABfRfcAAADPEM9gABr3AC3+q/+QAAB8/rQAABAAAAAecAALoI9wC/QAj3v0AACP9AAAC/9wAAv0j3AL9ACP"
  "cbQAAIg="
  ;
static const Glyph F_SB_GLYPHS[] PROGMEM = {
  {0x0020, 0, 0, 0, 0, 4, 0},
  {0x0021, 3, 11, 1, -11, 5, 0},
  {0x0022, 6, 5, 1, -11, 8, 33},
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  {0x2715, 9, 9, 1, -10, 12, 20179},
};
AAFont F_SB = { nullptr, F_SB_GLYPHS, 225, 15, 4, F_SB_B64, 10130 };

// F_X: 12px, 225 глифов, 6840 байт
static const char F_X_B64[] PROGMEM =
  "7Ozr69vaEaja238cpvC5XwZTgACoCaAA1QxwT///+BX0X0EE8D8AKNN+MM////ALcKkADlDWAAABAAAAB0AAAr/7IA7rr9Avh0SB"
  "H/tgAAO/+zAAB57xSzdH8y/bruEEz/wwAAdAAAABAABO5AAeQLdsAJkAt2wE4QBO5B5AAAAAmQAAAAThTuQAHkC3bACZALdsBOEA"
  "TuQCz8IACeXaAArAygAF/PMAA/9QMS+s4/R/Id/xT6W/wAbv1/fbyrllCeAfkG8wnwC+ANwAzQCvAG8wH5AI0E9ADrAI8QXzA/YB"
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  "ANoAANkAAD9AB/VEREzQL//////3AI39cADPhY/AjyAAL31wAACM9QAABf1wAACMjyAAL3DPhY/AAI39cAAQAAFtEAqQrRrRAK/R"
  "AAr9EArRrRbRAKkBAAAQ"
  ;
static const Glyph F_X_GLYPHS[] PROGMEM = {
  {0x0020, 0, 0, 0, 0, 3, 0},
  {0x0021, 2, 9, 1, -9, 4, 0},
  {0x0022, 5, 4, 1, -9, 6, 18},
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  {0x2715, 7, 8, 1, -8, 9, 13623},
};
AAFont F_X = { nullptr, F_X_GLYPHS, 225, 12, 3, F_X_B64, 6840 };

// F_H: 28px, 225 глифов, 34488 байт
static const char F_H_B64[] PROGMEM =
  "j//wf//gf//gf//gb//Qb//Qb//QX//AX//AX//AT/+wT/+wT/+wP/+gEzMgAAAABZgQX//Qr//yj//wG/5AT/+wT/+j//oD//ov"
  "/5A//5H/+QL/+A//gB//cP/3AP/2D/9gD/9g7/UA//UHiCAHiCAAAI/6AAX/0AAAAK/3AAj/oAAAAN/1AAr/cAAAAP/yAA3/UAAA"
  "Av/wAA//IAAv/////////8BP/////////5B//////////3ASLf9iIr/4IhAAD/8wAM/1AAAAH/8QAO/zAAAAP/8AAf/xAAARb/0R"
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  "//////Ev//AAAAAC//8S//8AAAAAL//xL//wAAAAAv//Ev//AAAAAC//8S//8AAAAAL//xL//wAAAAAv//Ev//AAAAAC//8S//8A"
  "AAAAL//xL//wAAAAAv//Ev//Av//Av//Av//Av//Av//Av//Av//Av//Av//Av//Av//Av//Av//Av//Av//Av//Av//Av//Av//"
  "Av//AAAAAAAK//gAAAAAAK//gAAAAAAK//gAAAAAAK//gAAAAAAK//gAAAAAAK//gAAAAAAK//gAAAAAAK//gAAAAAAK//gAAAAA"
  "AK//gAAAAAAK//gAAAAAAK//gAAAAAAK//gbu7EAAK//gf//IAAK//gP//MAAM//YM//oAAv//MH//+3j//+AA3//////0AALP//"
  "//9wAAAGvf7JEAAv//AAAABf//wC//8AAAA///4QL//wAAAe//8wAv//AAAM//9QAC//8AAK//9wAAL//wAH//+gAAAv//AE///A"
  "AAAC//8B7//hAAAAL//wz//yAAAAAv//b//9AAAAAC//////+AAAAAL///////MAAAAv///17//QAAAC///1BP//gAAAL//3AAr/"
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  "Ad//+gAAAAAd/73/oAAAAd/7Ad/6AAAd/7AAHf+gAd/7AAAB3/oH/7AAAAAt/0CbAAAAAALVAAAAAAAAAAAA"
  ;
static const Glyph F_H_GLYPHS[] PROGMEM = {
  {0x0020, 0, 0, 0, 0, 8, 0},
  {0x0021, 6, 21, 2, -21, 9, 0},
  {0x0022, 11, 9, 2, -21, 15, 126},
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  {0x2715, 16, 17, 3, -18, 22, 68703},
};
AAFont F_H = { nullptr, F_H_GLYPHS, 225, 28, 7, F_H_B64, 34488 };

// F_P: 34px, 12 глифов, 3216 байт
static const char F_P_B64[] PROGMEM =
  "AAAAAAAI4gAAAAAAAAAAAAA2z3YAAAAAAAAAAAAFz/2wAAAAAAAAAAAAAc9AAAAAAAAAAAAAAMuOQAAAAAAAAAJ6qH0AXGqpQAAA"
  "ABn////gBv///+QAAB38UROv2v1iA4/1AAn6AAAAT/sAAAA/8gH9AAAAAP9wAAAAX5B/YAAAAA/3AAAAAO4J8gAAAAD/cAAAAArx"
  "ryAAAAAP9wAAAACvGPQAAAAA/3AAAAAM8D+gAAAAD/cAAAAD+gDPYAAAAP9wAAAB30AD/5IRER/3EREU76AABf///////////8EA"
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  "AAAD4AAGcAAAAAAAALYACFAAAABQAABcAAwgAAAGcAAADiANAgABaSAAAAlwSNsACXcAAAAFsCtyMGpwAAAAAeADmLbEAAAAAADS"
  "AAAKIAAAAAAApQAAgwAAAAAAAIcAAoAAAAAAAABZAAZAAAAAAAAASwAGUAAAAAAAADwABLiIiIiIiIieAAAAADvHAAAAAAAAAAAv"
  "//gAAAAAAAAAB/Ye4AAAAAAAAABvpf0AAAAAAAAAAd//UAAAAAAAAACP//wgAAAAAAAAv+mL/zAAAAAAAG+xAAX9AAAAAAAN8QAA"
  "CfQAAAAAAPwAAABfcAAAAAAPwAAABfcAAAAAAM8gAACvQAAAAAAG/BAAb9AAAAAAAAz/qc/0AAAAAABN/+y9//gQAAAAj/kwAAFu"
  "/SAAAI/jAAAAABr+EABP4QAAAAAACPsADfMAAAAAAAAM9AT6AAAAAAAAAD+wrzAAAAAAAAAAzx3wAAAAAAAAAAj0/jMzMzMzMzMz"
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  "//+wr////////////x3////////////0/////////////2/////////////23////////////0AAAAAAAAAAAAAA"
  ;
static const Glyph F_P_GLYPHS[] PROGMEM = {
  {0x2654, 25, 25, 3, -25, 30, 0},
  {0x2655, 24, 25, 3, -25, 30, 625},
  {0x2656, 20, 26, 5, -25, 30, 1225},
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  {0x265F, 21, 26, 5, -25, 30, 5886},
};
AAFont F_P = { nullptr, F_P_GLYPHS, 12, 32, 9, F_P_B64, 3216 };


// ===================== Глобальное состояние =====================
Item mainIt[MAIN_CAP];
uint8_t mainN = 0;
Frac fracs[FRAC_CAP];
Target target = TGT_MAIN;
int8_t curFrac = -1;

bool justEval = false;     // только что нажали «=»
Val lastRes;
bool hasRes = false;
uint8_t errCode = E_OK;    // ошибка последнего «=»
Val preview;
bool previewOk = false;
Val memVal;
bool memSet = false;
uint8_t fmtMode = 0;       // 0 — дробь, 1 — смешанная, 2 — десятичная
bool cursorOn = true;

Surface sDisp, sSeg, sKey;
Key keys[32];
int nKeys = 0;

static const char* const FMT_NAMES[] = { "дробь", "смешанная", "десятичная" };
static const char* const SEG_NAMES[] = { "Выражение", "Числитель", "Знаменатель" };

static const uint8_t LAYOUT[6][5] = {
  { K_C,    K_MC,  K_MR,  K_MP,  K_MM  },
  { K_SQRT, K_SQR, K_POW, K_NEG, K_PCT },
  { K_7,    K_8,   K_9,   K_LP,  K_DIV },
  { K_4,    K_5,   K_6,   K_RP,  K_MUL },
  { K_1,    K_2,   K_3,   K_BS,  K_SUB },
  { K_DOT,  K_0,   K_EQ,  K_EQ,  K_ADD },
};

#define STRIP_H 32
// ===================== Общая прошивка: типы и состояние =====================
enum TabId : uint8_t { TAB_CALC, TAB_GAMES, TAB_REF, TAB_SET, TAB_COUNT };
enum GameScr : uint8_t { G_MENU, G_CHESS, G_CHECKERS, G_TTT, G_C4 };
enum RefScr : uint8_t { R_LIST, R_PAGE, R_FILES, R_TEXT, R_IMAGE, R_HTML };
enum LineKind : uint8_t { L_TEXT, L_H1, L_H2, L_FORMULA, L_BULLET, L_SPACE, L_MULT, L_NOTE };

struct CMove { int8_t from, to, promo; uint8_t flags; };          // flags: 1 — взятие, 2 — на проходе, 4 — рокировка
struct CState { int8_t bd[64]; int8_t side; uint8_t castle; int8_t ep; int8_t lastFrom, lastTo; int16_t half; };
struct CkMove { int8_t path[16]; int8_t caps[12]; uint8_t n, nc; }; // путь шашки и сбитые
struct CkState { int8_t b[64]; int8_t side; int8_t lastFrom, lastTo; };
struct RLine { uint8_t kind; int16_t h; std::string text; };
struct FileEnt { std::string name; bool dir; uint32_t size; };
struct JDec { uint16_t* px; int w, h; };
struct RefPage { const char* title; const char* sub; const char* body; };

// Цвета темы (фиолетовая по умолчанию; меняются в настройках)
uint16_t th_C_KEY_DOWN = MK565(40, 31, 56), th_C_PANEL_BORDER = MK565(106, 52, 152), th_C_FUNC = MK565(169, 163, 217);
uint16_t th_C_EQ = MK565(123, 31, 162), th_C_EQ_DOWN = MK565(152, 62, 192), th_C_BULB = MK565(126, 59, 168);
uint16_t th_C_SEG_TEXT = MK565(154, 148, 196), th_C_SEG_ON = MK565(42, 31, 61), th_C_ACCENT = MK565(186, 140, 255);

// Вкладки и экран
uint8_t curTab = TAB_CALC;
Surface sStrip;                      // полоса 320×32 для отрисовки вкладок
int scrollY = 0, scrollMax = 0;      // прокрутка текущего экрана
float scrollVel = 0;

// Настройки
int setBright = 80;                  // яркость, %
uint8_t setDim = 2;                  // затемнение: 0 — никогда, 1 — 30 с, 2 — 1 мин, 3 — 5 мин
uint8_t setTheme = 0;
bool setSound = false;               // щелчок при нажатии
bool setFlip = false;                // экран перевёрнут на 180°
bool setArmReset = false;            // «Сбросить настройки» нажата один раз

// Игры
uint8_t gScr = G_MENU;
CState cs;                           // шахматы
std::vector<CState> chHist;
std::vector<CMove> chLegal;
int chSel = -1, chPromoFrom = -1, chPromoTo = -1;
bool chAutoFlip = false;
uint8_t chResult = 0;                // 0 — идёт, 1 — мат белым, 2 — мат чёрным, 3 — пат, 4 — мало фигур, 5 — 50 ходов
CkState ks;                          // шашки
std::vector<CkState> ckHist;
std::vector<CkMove> ckMoves;
int8_t ckPath[16];
uint8_t ckPathN = 0;
int8_t tt[9];                        // крестики-нолики
int8_t ttTurn = 1, ttWin = 0, ttStarter = 1;
int8_t ttLine[3] = { -1, -1, -1 };
int ttScore[3] = { 0, 0, 0 };        // [1] — крестики, [2] — нолики, [0] — ничьи
int8_t c4[6][7];                     // четыре в ряд (строка 0 — нижняя)
int8_t c4Turn = 1, c4Win = 0, c4Starter = 1;
int8_t c4Cells[4][2];
int c4Score[3] = { 0, 0, 0 };

// Справочник и файлы
uint8_t rScr = R_LIST;
int rPage = -1;
std::vector<RLine> rLines;
std::string rTitle;
std::string fDir = "/";
std::vector<FileEnt> fEnts;
bool fSdOk = false;
uint16_t* imgPx = nullptr;
int imgW = 0, imgH = 0;
JDec gJ;
int listScrollSave = 0;

// Wi-Fi и экран телефона
bool wifiOn = false;
std::string wifiInfo;                // как подключиться
bool castOn = false;                 // показываем картинку с телефона
uint16_t* castPx = nullptr;
int castW = 0, castH = 0, castScroll = 0, castPanX = 0, castFrame = 0;
bool castZoom = false;
std::vector<uint8_t> castRx;         // принимаемый JPEG
volatile bool castReady = false;
// обратная связь: касания на плате уходят в браузер телефона (приложение забирает их запросом /__events)
std::vector<std::string> castEvents;
uint32_t castPollT = 0;              // когда телефон последний раз спрашивал события
bool castTapPend = false;            // одиночное касание ждёт, не будет ли второго (двойное — увеличение)
uint32_t castTapPendT = 0;
int castTapX = 0, castTapY = 0;
float castMarkSX = 0, castMarkSY = 0;  // кружок на месте нажатия (координаты снимка)
uint32_t castMarkT = 0;
int castMode = 0;                    // 0 — страница из браузера приложения, 1 — весь экран телефона
uint32_t castClosedT = 0;            // плата закрыла экран: опоздавшие кадры не открывают его снова

void pushPixels(int x, int y, int w, int h, const uint16_t* px);  // вывод на экран (своя на плате и в симуляторе)

// ===================== Графика: смешивание и примитивы =====================
static inline uint16_t mix565(uint16_t a, uint16_t b, int t) {  // t: 0 → a, 255 → b
  int ar = a >> 11, ag = (a >> 5) & 63, ab = a & 31;
  int br = b >> 11, bg = (b >> 5) & 63, bb = b & 31;
  int r = ar + (br - ar) * t / 255;
  int g = ag + (bg - ag) * t / 255;
  int bl = ab + (bb - ab) * t / 255;
  return (uint16_t)((r << 11) | (g << 5) | bl);
}

static inline float clamp01(float v) { return v < 0 ? 0 : (v > 1 ? 1 : v); }

bool surfAlloc(Surface& s, int w, int h) {
#ifndef HOST_SIM
  // буферы отрисовки — во внутренней памяти: она в несколько раз быстрее PSRAM
  s.px = (uint16_t*)heap_caps_malloc((size_t)w * h * 2, MALLOC_CAP_INTERNAL | MALLOC_CAP_8BIT);
  if (!s.px) s.px = (uint16_t*)malloc((size_t)w * h * 2);
#else
  s.px = (uint16_t*)malloc((size_t)w * h * 2);
#endif
  if (!s.px) return false;
  s.cap = w * h;
  s.w = w; s.h = h;
  s.cx0 = 0; s.cy0 = 0; s.cx1 = w; s.cy1 = h;
  return true;
}

void surfSize(Surface& s, int w, int h) {  // переиспользует буфер под меньший размер
  s.w = w; s.h = h;
  s.cx0 = 0; s.cy0 = 0; s.cx1 = w; s.cy1 = h;
}

void surfClip(Surface& s, int x0, int y0, int x1, int y1) {
  s.cx0 = x0 < 0 ? 0 : x0;
  s.cy0 = y0 < 0 ? 0 : y0;
  s.cx1 = x1 > s.w ? s.w : x1;
  s.cy1 = y1 > s.h ? s.h : y1;
}

void surfNoClip(Surface& s) { s.cx0 = 0; s.cy0 = 0; s.cx1 = s.w; s.cy1 = s.h; }

static inline void blendPx(Surface& s, int x, int y, uint16_t c, int a) {
  if (a <= 0 || x < s.cx0 || x >= s.cx1 || y < s.cy0 || y >= s.cy1) return;
  uint16_t& p = s.px[y * s.w + x];
  p = a >= 255 ? c : mix565(p, c, a);
}

void surfFill(Surface& s, uint16_t c) {
  int n = s.w * s.h;
  for (int i = 0; i < n; i++) s.px[i] = c;
}

void fillRectS(Surface& s, int x, int y, int w, int h, uint16_t c) {
  for (int yy = y; yy < y + h; yy++)
    for (int xx = x; xx < x + w; xx++) blendPx(s, xx, yy, c, 255);
}

// Скруглённый прямоугольник со сглаживанием (SDF): заливка + рамка толщиной bw
void roundRectS(Surface& s, float x, float y, float w, float h, float r, uint16_t fillC, uint16_t borderC, float bw) {
  float hx = w * 0.5f, hy = h * 0.5f, cx = x + hx, cy = y + hy;
  int x0 = (int)floorf(x) - 1, x1 = (int)ceilf(x + w) + 1;
  int y0 = (int)floorf(y) - 1, y1 = (int)ceilf(y + h) + 1;
  for (int py = y0; py < y1; py++) {
    for (int px = x0; px < x1; px++) {
      float qx = fabsf(px + 0.5f - cx) - (hx - r);
      float qy = fabsf(py + 0.5f - cy) - (hy - r);
      float ox = qx > 0 ? qx : 0, oy = qy > 0 ? qy : 0;
      float d = sqrtf(ox * ox + oy * oy) + fminf(fmaxf(qx, qy), 0.0f) - r;
      float outer = clamp01(0.5f - d);
      if (outer <= 0) continue;
      if (bw > 0) {
        blendPx(s, px, py, borderC, (int)(outer * 255));
        float inner = clamp01(0.5f - (d + bw));
        if (inner > 0) blendPx(s, px, py, fillC, (int)(inner * 255));
      } else {
        blendPx(s, px, py, fillC, (int)(outer * 255));
      }
    }
  }
}

// Отрезок с круглыми концами (для иконок)
void capsuleS(Surface& s, float ax, float ay, float bx, float by, float r, uint16_t c) {
  int x0 = (int)floorf(fminf(ax, bx) - r - 1), x1 = (int)ceilf(fmaxf(ax, bx) + r + 1);
  int y0 = (int)floorf(fminf(ay, by) - r - 1), y1 = (int)ceilf(fmaxf(ay, by) + r + 1);
  float bax = bx - ax, bay = by - ay, bb = bax * bax + bay * bay;
  for (int py = y0; py < y1; py++)
    for (int px = x0; px < x1; px++) {
      float pax = px + 0.5f - ax, pay = py + 0.5f - ay;
      float t = bb > 0 ? clamp01((pax * bax + pay * bay) / bb) : 0;
      float dx = pax - bax * t, dy = pay - bay * t;
      float d = sqrtf(dx * dx + dy * dy) - r;
      blendPx(s, px, py, c, (int)(clamp01(0.5f - d) * 255));
    }
}

void ringS(Surface& s, float cx, float cy, float r, float th, uint16_t c) {
  int x0 = (int)(cx - r - th - 1), x1 = (int)(cx + r + th + 2);
  int y0 = (int)(cy - r - th - 1), y1 = (int)(cy + r + th + 2);
  for (int py = y0; py < y1; py++)
    for (int px = x0; px < x1; px++) {
      float dx = px + 0.5f - cx, dy = py + 0.5f - cy;
      float d = fabsf(sqrtf(dx * dx + dy * dy) - r) - th * 0.5f;
      blendPx(s, px, py, c, (int)(clamp01(0.5f - d) * 255));
    }
}

// Многоугольник со сглаживанием (4x4 субпикселя)
void polyS(Surface& s, const float* xs, const float* ys, int n, uint16_t c) {
  float minx = xs[0], maxx = xs[0], miny = ys[0], maxy = ys[0];
  for (int i = 1; i < n; i++) {
    minx = fminf(minx, xs[i]); maxx = fmaxf(maxx, xs[i]);
    miny = fminf(miny, ys[i]); maxy = fmaxf(maxy, ys[i]);
  }
  for (int py = (int)floorf(miny); py <= (int)ceilf(maxy); py++)
    for (int px = (int)floorf(minx); px <= (int)ceilf(maxx); px++) {
      int hits = 0;
      for (int sy = 0; sy < 4; sy++)
        for (int sx = 0; sx < 4; sx++) {
          float X = px + (sx + 0.5f) / 4, Y = py + (sy + 0.5f) / 4;
          bool in = false;
          for (int i = 0, j = n - 1; i < n; j = i++)
            if (((ys[i] > Y) != (ys[j] > Y)) && (X < (xs[j] - xs[i]) * (Y - ys[i]) / (ys[j] - ys[i]) + xs[i])) in = !in;
          hits += in;
        }
      blendPx(s, px, py, c, hits * 255 / 16);
    }
}

// ===================== Текст =====================
static int b64v(char c) {
  if (c >= 'A' && c <= 'Z') return c - 'A';
  if (c >= 'a' && c <= 'z') return c - 'a' + 26;
  if (c >= '0' && c <= '9') return c - '0' + 52;
  if (c == '+') return 62;
  if (c == '/') return 63;
  return -1;
}

bool decodeFont(AAFont& f) {
  f.bits = (uint8_t*)malloc(f.nbytes);
  if (!f.bits) return false;
  uint32_t o = 0, acc = 0;
  int bits = 0;
  for (const char* p = f.b64; *p && o < f.nbytes; p++) {
    int v = b64v(*p);
    if (v < 0) continue;
    acc = (acc << 6) | v;
    bits += 6;
    if (bits >= 8) { bits -= 8; f.bits[o++] = (acc >> bits) & 0xFF; }
  }
  return o == f.nbytes;
}

static uint32_t utf8Next(const char*& s) {
  uint8_t c = (uint8_t)*s++;
  if (c < 0x80) return c;
  if ((c & 0xE0) == 0xC0 && *s) return ((c & 0x1F) << 6) | (*s++ & 0x3F);
  if ((c & 0xF0) == 0xE0 && s[0] && s[1]) {
    uint32_t r = ((c & 0x0F) << 12) | ((s[0] & 0x3F) << 6) | (s[1] & 0x3F);
    s += 2;
    return r;
  }
  return '?';
}

const Glyph* findGlyph(const AAFont& f, uint32_t cp) {
  int lo = 0, hi = f.n - 1;
  while (lo <= hi) {
    int mid = (lo + hi) / 2;
    uint16_t c = f.g[mid].cp;
    if (c == cp) return &f.g[mid];
    if (c < cp) lo = mid + 1; else hi = mid - 1;
  }
  return nullptr;
}

int textW(const AAFont& f, const char* s) {
  int w = 0;
  while (*s) {
    const Glyph* g = findGlyph(f, utf8Next(s));
    w += g ? g->adv : f.asc / 3;
  }
  return w;
}

int capH(const AAFont& f) {
  const Glyph* g = findGlyph(f, '0');
  return g ? g->h : f.asc * 7 / 10;
}

// Рисует строку от x по базовой линии base; возвращает x конца строки
int drawText(Surface& s, const AAFont& f, int x, int base, const char* str, uint16_t col) {
  while (*str) {
    const Glyph* g = findGlyph(f, utf8Next(str));
    if (!g) { x += f.asc / 3; continue; }
    int gx = x + g->xo, gy = base + g->yo;
    for (int yy = 0; yy < g->h; yy++)
      for (int xx = 0; xx < g->w; xx++) {
        uint32_t idx = g->off + yy * g->w + xx;
        uint8_t b = f.bits[idx >> 1];
        int a = (idx & 1) ? (b & 15) : (b >> 4);
        if (a) blendPx(s, gx + xx, gy + yy, col, a * 17);
      }
    x += g->adv;
  }
  return x;
}

void drawTextCenter(Surface& s, const AAFont& f, int cx, int cy, const char* str, uint16_t col) {
  drawText(s, f, cx - textW(f, str) / 2, cy + capH(f) / 2, str, col);
}

// ===================== Арифметика: точные дроби с запасным double =====================
static int64_t gcd64(int64_t a, int64_t b) {
  if (a < 0) a = -a;
  if (b < 0) b = -b;
  while (b) { int64_t t = a % b; a = b; b = t; }
  return a;
}

static Val vErr(uint8_t e) { Val r; memset(&r, 0, sizeof r); r.err = e; return r; }

static Val vReal(double x) {
  Val r; memset(&r, 0, sizeof r);
  r.v = x;
  if (!isfinite(x)) r.err = E_OVER;
  return r;
}

static Val vExact(int64_t n, int64_t d) {
  if (d == 0) return vErr(E_DIV0);
  if (n == INT64_MIN || d == INT64_MIN) return vReal((double)n / (double)d);
  if (d < 0) { n = -n; d = -d; }
  int64_t g = gcd64(n, d);
  if (g > 1) { n /= g; d /= g; }
  Val r; memset(&r, 0, sizeof r);
  r.exact = true; r.n = n; r.d = d; r.v = (double)n / (double)d;
  return r;
}

static Val vNeg(const Val& a) {
  if (a.err) return a;
  if (a.exact) return vExact(-a.n, a.d);
  return vReal(-a.v);
}

static Val vAdd(const Val& a, const Val& b) {
  if (a.err) return a;
  if (b.err) return b;
  if (a.exact && b.exact) {
    int64_t g = gcd64(a.d, b.d), t1, t2, n, d;
    if (!__builtin_mul_overflow(a.n, b.d / g, &t1) && !__builtin_mul_overflow(b.n, a.d / g, &t2) &&
        !__builtin_add_overflow(t1, t2, &n) && !__builtin_mul_overflow(a.d, b.d / g, &d))
      return vExact(n, d);
  }
  return vReal(a.v + b.v);
}

static Val vSub(const Val& a, const Val& b) { return vAdd(a, vNeg(b)); }

static Val vMul(const Val& a, const Val& b) {
  if (a.err) return a;
  if (b.err) return b;
  if (a.exact && b.exact) {
    int64_t g1 = gcd64(a.n, b.d), g2 = gcd64(b.n, a.d), n, d;
    if (g1 == 0) g1 = 1;
    if (g2 == 0) g2 = 1;
    if (!__builtin_mul_overflow(a.n / g1, b.n / g2, &n) && !__builtin_mul_overflow(a.d / g2, b.d / g1, &d))
      return vExact(n, d);
  }
  return vReal(a.v * b.v);
}

static Val vInv(const Val& a) {
  if (a.err) return a;
  if (a.exact) {
    if (a.n == 0) return vErr(E_DIV0);
    return vExact(a.d, a.n);
  }
  if (a.v == 0) return vErr(E_DIV0);
  return vReal(1.0 / a.v);
}

static Val vDiv(const Val& a, const Val& b) {
  if (a.err) return a;
  return vMul(a, vInv(b));
}

static Val vPow(const Val& b, const Val& e) {
  if (b.err) return b;
  if (e.err) return e;
  if (b.exact && e.exact && e.d == 1 && e.n >= -64 && e.n <= 64) {
    int64_t k = e.n < 0 ? -e.n : e.n;
    Val r = vExact(1, 1), base = b;
    while (k) {
      if (k & 1) r = vMul(r, base);
      k >>= 1;
      if (k) base = vMul(base, base);
      if (r.err) return r;
    }
    return e.n < 0 ? vInv(r) : r;
  }
  double bv = b.v, ev = e.v;
  if (bv == 0 && ev < 0) return vErr(E_DIV0);
  if (bv < 0) {
    if (e.exact && (e.d & 1)) {  // нечётный корень из отрицательного: (−8)^(1/3) = −2
      double m = pow(-bv, ev);
      return vReal((e.n & 1) ? -m : m);
    }
    if (floor(ev) != ev) return vErr(E_DOMAIN);
  }
  return vReal(pow(bv, ev));
}

static int64_t isqrt64(int64_t x) {
  int64_t r = (int64_t)sqrt((double)x);
  while (r > 0 && r * r > x) r--;
  while ((r + 1) * (r + 1) <= x) r++;
  return r;
}

static Val vSqrt(const Val& a) {
  if (a.err) return a;
  if (a.v < 0) return vErr(E_DOMAIN);
  if (a.exact && a.n <= 4000000000000000000LL && a.d <= 4000000000000000000LL) {
    int64_t sn = isqrt64(a.n), sd = isqrt64(a.d);
    if (sn * sn == a.n && sd * sd == a.d) return vExact(sn, sd);
  }
  return vReal(sqrt(a.v));
}

// ===================== Разбор выражения =====================
static bool isDigitC(char c) { return c >= '0' && c <= '9'; }
static bool isBinOp(char c) { return c == '+' || c == '-' || c == '*' || c == '/' || c == '^'; }
static bool isOperandEnd(char c) { return isDigitC(c) || c == '.' || c == ')' || c == 's' || c == '%' || c == 'F'; }
static bool startsOperand(char c) { return isDigitC(c) || c == '.' || c == '(' || c == 'r' || c == 'F'; }

Val evalItems(const Item* it, int n);

Val Parser::fail(uint8_t e) {
  if (!err) err = e;
  return vErr(e);
}

Val Parser::expr() {
  Val a = term();
  while (!err) {
    char c = peek();
    if (c != '+' && c != '-') break;
    p++;
    Val b = term();
    if (err) break;
    if (b.pct) b = vMul(a, b);  // 200 + 10% = 220
    a = (c == '+') ? vAdd(a, b) : vSub(a, b);
    a.pct = false;
    if (a.err) fail(a.err);
  }
  return a;
}

Val Parser::term() {
  Val a = unary();
  while (!err) {
    char c = peek();
    if (c == '*' || c == '/') {
      p++;
      Val b = unary();
      if (err) break;
      a = (c == '*') ? vMul(a, b) : vDiv(a, b);
    } else if (startsOperand(c)) {  // неявное умножение: 2(3+4), 3√2, 2·дробь
      Val b = unary();
      if (err) break;
      a = vMul(a, b);
    } else {
      break;
    }
    a.pct = false;
    if (a.err) fail(a.err);
  }
  return a;
}

Val Parser::unary() {
  if (peek() == 'm') {
    p++;
    Val a = unary();
    bool pct = a.pct;
    a = vNeg(a);
    a.pct = pct;
    return a;
  }
  return power();
}

Val Parser::power() {
  Val a = postfix();
  if (!err && peek() == '^') {
    p++;
    Val e = unary();
    if (err) return a;
    a = vPow(a, e);
    a.pct = false;
    if (a.err) fail(a.err);
  }
  return a;
}

Val Parser::postfix() {
  Val a = primary();
  while (!err) {
    char c = peek();
    if (c == 's') { p++; a = vMul(a, a); a.pct = false; }
    else if (c == '%') { p++; a = vDiv(a, vExact(100, 1)); a.pct = true; }
    else break;
    if (a.err) fail(a.err);
  }
  return a;
}

Val Parser::primary() {
  char c = peek();
  if (isDigitC(c) || c == '.') return number();
  if (c == '(') {
    p++;
    Val a = expr();
    if (err) return a;
    if (peek() == ')') p++;
    else if (p < n) return fail(E_SYNTAX);  // незакрытую скобку в конце закрываем сами
    a.pct = false;
    return a;
  }
  if (c == 'r') {
    p++;
    Val a = primary();
    if (err) return a;
    a = vSqrt(a);
    if (a.err) fail(a.err);
    return a;
  }
  if (c == 'F') {
    Frac& F = fracs[it[p].f];
    p++;
    if (!F.num.n || !F.den.n) return fail(E_SYNTAX);
    Val a = evalItems(F.num.it, F.num.n);
    if (a.err) return fail(a.err);
    Val b = evalItems(F.den.it, F.den.n);
    if (b.err) return fail(b.err);
    a = vDiv(a, b);
    if (a.err) fail(a.err);
    a.pct = false;
    return a;
  }
  return fail(E_SYNTAX);
}

Val Parser::number() {
  int64_t num = 0, den = 1;
  bool dot = false, ovf = false;
  int digits = 0, bl = 0;
  char buf[40];
  while (p < n) {
    char c = it[p].c;
    if (c == '.') {
      if (dot) return fail(E_SYNTAX);
      dot = true;
    } else if (isDigitC(c)) {
      digits++;
      if (!ovf && (__builtin_mul_overflow(num, (int64_t)10, &num) || __builtin_add_overflow(num, (int64_t)(c - '0'), &num))) ovf = true;
      if (!ovf && dot && __builtin_mul_overflow(den, (int64_t)10, &den)) ovf = true;
    } else {
      break;
    }
    if (bl < 38) buf[bl++] = c;
    p++;
  }
  if (!digits) return fail(E_SYNTAX);
  buf[bl] = 0;
  if (ovf) return vReal(strtod(buf, nullptr));
  return vExact(num, den);
}

Val evalItems(const Item* it, int n) {
  if (n <= 0) return vErr(E_SYNTAX);
  Parser P;
  P.it = it; P.n = n; P.p = 0; P.err = 0;
  Val v = P.expr();
  if (!P.err && P.p != n) P.err = E_SYNTAX;
  if (P.err) return vErr(P.err);
  return v;
}

Val evalMain() { return evalItems(mainIt, mainN); }

// ===================== Форматирование чисел =====================
// Заменяет ASCII-минус на «−», точку на запятую, e на E
void prettyNum(const char* in, char* out, int cap) {
  int o = 0;
  for (const char* p = in; *p && o < cap - 4; p++) {
    char c = *p;
    if (c == '-') { out[o++] = (char)0xE2; out[o++] = (char)0x88; out[o++] = (char)0x92; }
    else if (c == '.') out[o++] = ',';
    else if (c == 'e') out[o++] = 'E';
    else if (c == '+') continue;
    else out[o++] = c;
  }
  out[o] = 0;
}

void fmtReal(double v, char* out, int cap) {
  char b[40];
  if (v == 0) { snprintf(out, cap, "0"); return; }
  snprintf(b, sizeof b, "%.12g", v);
  // убираем ведущие нули порядка: 1e-07 → 1e-7
  char* e = strchr(b, 'e');
  if (e) {
    char* q = e + 1;
    if (*q == '+' || *q == '-') q++;
    char* z = q;
    while (*z == '0' && z[1]) z++;
    if (z != q) memmove(q, z, strlen(z) + 1);
  }
  prettyNum(b, out, cap);
}

// Точная дробь десятичной записью, период в скобках: 1/3 → 0,(3), 1/6 → 0,1(6)
void fmtDecimalExact(int64_t n, int64_t d, char* out, int cap) {
  bool neg = n < 0;
  uint64_t un = neg ? (uint64_t)(-n) : (uint64_t)n, ud = (uint64_t)d;
  uint64_t ip = un / ud, rem = un % ud;
  if (ip >= 1000000000000ULL || ud > 100000000000000000ULL) { fmtReal((double)n / d, out, cap); return; }
  char b[64];
  int o = snprintf(b, sizeof b, "%s%llu", neg ? "-" : "", (unsigned long long)ip);
  if (rem) {
    uint64_t seen[16];
    int pos[16], cnt = 0;
    b[o++] = '.';
    bool done = false;
    for (int k = 0; k < 14 && rem; k++) {
      for (int j = 0; j < cnt; j++)
        if (seen[j] == rem) {  // нашли период
          memmove(b + pos[j] + 1, b + pos[j], o - pos[j]);
          b[pos[j]] = '(';
          o++;
          b[o++] = ')';
          done = true;
          break;
        }
      if (done) break;
      seen[cnt] = rem; pos[cnt] = o; cnt++;
      rem *= 10;
      b[o++] = '0' + (char)(rem / ud);
      rem %= ud;
    }
    if (!done && rem) { fmtReal((double)n / d, out, cap); return; }
  }
  b[o] = 0;
  prettyNum(b, out, cap);
}

static const char* errText(uint8_t e) {
  switch (e) {
    case E_DIV0: return "Деление на ноль";
    case E_DOMAIN: return "Нет решения";
    case E_OVER: return "Слишком большое";
    default: return "Ошибка в выражении";
  }
}

// ===================== Редактирование выражения =====================
Field activeField() {
  if (target == TGT_MAIN || curFrac < 0) return { mainIt, &mainN, MAIN_CAP, true };
  Part& p = (target == TGT_NUM) ? fracs[curFrac].num : fracs[curFrac].den;
  return { p.it, &p.n, PART_CAP, false };
}

static char lastC(const Field& f) { return *f.n ? f.it[*f.n - 1].c : 0; }

static bool pushC(Field& f, char c) {
  if (*f.n >= f.cap) return false;
  f.it[(*f.n)++] = { c, -1 };
  return true;
}

int8_t allocFrac() {
  for (int i = 0; i < FRAC_CAP; i++)
    if (!fracs[i].used) {
      fracs[i].used = true;
      fracs[i].num.n = 0;
      fracs[i].den.n = 0;
      return (int8_t)i;
    }
  return -1;
}

void clearAll() {
  mainN = 0;
  for (int i = 0; i < FRAC_CAP; i++) fracs[i].used = false;
  target = TGT_MAIN;
  curFrac = -1;
  justEval = false;
}

bool trailingHasDot(const Field& f) {
  for (int i = *f.n - 1; i >= 0; i--) {
    char c = f.it[i].c;
    if (c == '.') return true;
    if (!isDigitC(c)) return false;
  }
  return false;
}

int openParens(const Field& f) {
  int d = 0;
  for (int i = 0; i < *f.n; i++) {
    if (f.it[i].c == '(') d++;
    else if (f.it[i].c == ')') d--;
  }
  return d;
}

// Начало операнда, который заканчивается перед end (−1, если операнда нет)
int operandStart(const Field& f, int end) {
  int i = end - 1;
  while (i >= 0 && (f.it[i].c == 's' || f.it[i].c == '%')) i--;
  if (i < 0) return -1;
  char c = f.it[i].c;
  int start;
  if (isDigitC(c) || c == '.') {
    start = i;
    while (start > 0 && (isDigitC(f.it[start - 1].c) || f.it[start - 1].c == '.')) start--;
  } else if (c == 'F') {
    start = i;
  } else if (c == ')') {
    int depth = 0;
    start = -1;
    for (int j = i; j >= 0; j--) {
      if (f.it[j].c == ')') depth++;
      else if (f.it[j].c == '(' && --depth == 0) { start = j; break; }
    }
    if (start < 0) return -1;
  } else {
    return -1;
  }
  while (start > 0 && f.it[start - 1].c == 'r') start--;
  return start;
}

void toggleSign(Field& f) {
  int n = *f.n;
  if (n && f.it[n - 1].c == 'm') { (*f.n)--; return; }
  int st = operandStart(f, n);
  if (st < 0) { pushC(f, 'm'); return; }  // после оператора — начинаем отрицательное число
  if (st > 0 && f.it[st - 1].c == 'm') {
    memmove(&f.it[st - 1], &f.it[st], (n - st) * sizeof(Item));
    (*f.n)--;
  } else if (n < f.cap) {
    memmove(&f.it[st + 1], &f.it[st], (n - st) * sizeof(Item));
    f.it[st] = { 'm', -1 };
    (*f.n)++;
  }
}

void backspace(Field& f) {
  if (f.isMain) {
    if (!mainN) return;
    Item last = mainIt[mainN - 1];
    if (last.c == 'F') {
      Frac& F = fracs[last.f];
      if (!F.num.n && !F.den.n) { F.used = false; mainN--; }
      else { curFrac = last.f; target = TGT_DEN; }  // заходим в дробь, чтобы стирать её по символу
      return;
    }
    mainN--;
    return;
  }
  if (*f.n) { (*f.n)--; return; }
  if (target == TGT_DEN) { target = TGT_NUM; return; }
  Frac& F = fracs[curFrac];
  if (!F.den.n && mainN && mainIt[mainN - 1].c == 'F' && mainIt[mainN - 1].f == curFrac) {
    F.used = false;
    mainN--;
  }
  target = TGT_MAIN;
  curFrac = -1;
}

bool appendDigits(Field& f, int64_t x) {
  char b[24];
  snprintf(b, sizeof b, "%lld", (long long)x);
  for (char* q = b; *q; q++)
    if (!pushC(f, *q)) return false;
  return true;
}

// Вставляет значение (ответ или память) в поле: дробью, если можно
void appendValue(Field& f, const Val& v) {
  if (isOperandEnd(lastC(f))) pushC(f, '*');
  if (v.exact) {
    int64_t n = v.n < 0 ? -v.n : v.n;
    if (v.n < 0) pushC(f, 'm');
    if (v.d == 1) { appendDigits(f, n); return; }
    if (f.isMain && mainN < MAIN_CAP) {
      int8_t fi = allocFrac();
      if (fi >= 0) {
        Field nf = { fracs[fi].num.it, &fracs[fi].num.n, PART_CAP, false };
        Field df = { fracs[fi].den.it, &fracs[fi].den.n, PART_CAP, false };
        appendDigits(nf, n);
        appendDigits(df, v.d);
        mainIt[mainN++] = { 'F', fi };
        return;
      }
    }
    pushC(f, '(');
    appendDigits(f, n);
    pushC(f, '/');
    appendDigits(f, v.d);
    pushC(f, ')');
    return;
  }
  double x = v.v;
  if (x < 0) { pushC(f, 'm'); x = -x; }
  char b[32];
  snprintf(b, sizeof b, "%.10g", x);
  char* e = strchr(b, 'e');
  for (char* q = b; *q && q != e; q++) pushC(f, *q);
  if (e) {  // 1.5e20 → 1.5×10^20
    int ex = atoi(e + 1);
    pushC(f, '*'); pushC(f, '1'); pushC(f, '0'); pushC(f, '^');
    if (ex < 0) { pushC(f, 'm'); ex = -ex; }
    appendDigits(f, ex);
  }
}

void loadAns() {
  clearAll();
  Field f = activeField();
  appendValue(f, lastRes);
}

void selectTarget(Target t) {
  if (t == TGT_MAIN) { target = TGT_MAIN; return; }
  if (justEval) clearAll();
  if (target == TGT_MAIN) {
    if (mainN && mainIt[mainN - 1].c == 'F') {
      curFrac = mainIt[mainN - 1].f;
    } else {
      if (mainN >= MAIN_CAP) return;
      int8_t f = allocFrac();
      if (f < 0) return;
      mainIt[mainN++] = { 'F', f };
      curFrac = f;
    }
  }
  target = t;
}

static char keyChar(uint8_t k) {
  if (k <= K_9) return '0' + k;
  switch (k) {
    case K_DOT: return '.';
    case K_ADD: return '+';
    case K_SUB: return '-';
    case K_MUL: return '*';
    case K_DIV: return '/';
    case K_POW: return '^';
    case K_SQR: return 's';
    case K_PCT: return '%';
    case K_LP: return '(';
    case K_RP: return ')';
    case K_SQRT: return 'r';
    case K_NEG: return 'n';
    case K_BS: return 'b';
  }
  return 0;
}

void editKey(uint8_t k) {
  char c = keyChar(k);
  if (!c) return;
  if (justEval) {
    if (c == 'b') { justEval = false; return; }
    if (isBinOp(c) || c == 's' || c == '%') {
      loadAns();
    } else if (c == 'r') {  // √ от ответа
      clearAll();
      Field f = activeField();
      pushC(f, 'r'); pushC(f, '(');
      appendValue(f, lastRes);
      pushC(f, ')');
      return;
    } else if (c == 'n') {  // ± меняет знак ответа
      lastRes = vNeg(lastRes);
      loadAns();
      justEval = true;
      return;
    } else {
      clearAll();  // цифра, запятая или скобка — новое выражение
    }
    justEval = false;
  }
  Field f = activeField();
  char last = lastC(f);
  if (isDigitC(c)) { pushC(f, c); return; }
  switch (c) {
    case '.':
      if (trailingHasDot(f)) return;
      if (!isDigitC(last)) pushC(f, '0');
      pushC(f, '.');
      return;
    case '+': case '-': case '*': case '/': case '^':
      if (!last || last == '(' || last == 'r') { if (c == '-') pushC(f, 'm'); return; }
      if (last == 'm') return;
      if (isBinOp(last)) {
        if (c == '-' && last != '+' && last != '-') pushC(f, 'm');  // 5 × −3
        else f.it[*f.n - 1].c = c;                                  // замена оператора
        return;
      }
      pushC(f, c);
      return;
    case 's': case '%':
      if (isOperandEnd(last)) pushC(f, c);
      return;
    case '(': pushC(f, '('); return;
    case ')': if (openParens(f) > 0 && isOperandEnd(last)) pushC(f, ')'); return;
    case 'r': pushC(f, 'r'); return;
    case 'n': toggleSign(f); return;
    case 'b': backspace(f); return;
  }
}

bool exprHasOps() {
  for (int i = 0; i < mainN; i++) {
    char c = mainIt[i].c;
    if (!isDigitC(c) && c != '.') return true;
  }
  return false;
}

void updatePreview() {
  previewOk = false;
  if (justEval || !mainN || !exprHasOps()) return;
  preview = evalMain();
  previewOk = !preview.err;
}

void saveState();

void doEquals() {
  if (justEval || !mainN) return;
  Val v = evalMain();
  target = TGT_MAIN;
  curFrac = -1;
  if (v.err) { errCode = v.err; return; }  // выражение остаётся, чтобы его исправить
  lastRes = v;
  hasRes = true;
  justEval = true;
}

void onKey(uint8_t k) {
  errCode = E_OK;
  switch (k) {
    case K_C: clearAll(); hasRes = false; break;
    case K_EQ: doEquals(); break;
    case K_MC: memSet = false; memVal = vExact(0, 1); saveState(); break;
    case K_MR:
      if (memSet) {
        if (justEval) clearAll();
        Field f = activeField();
        appendValue(f, memVal);
      }
      break;
    case K_MP: case K_MM: {
      Val v = justEval ? lastRes : evalMain();
      if (v.err) { errCode = v.err; break; }
      if (k == K_MM) v = vNeg(v);
      memVal = memSet ? vAdd(memVal, v) : v;
      memSet = !memVal.err;
      saveState();
      break;
    }
    case K_SEG_MAIN: selectTarget(TGT_MAIN); break;
    case K_SEG_NUM: selectTarget(TGT_NUM); break;
    case K_SEG_DEN: selectTarget(TGT_DEN); break;
    case K_BULB: fmtMode = (fmtMode + 1) % 3; saveState(); break;
    default: editKey(k); break;
  }
  updatePreview();
}

// ===================== Отрисовка выражения =====================
static const char* itemStr(char c, char* tmp) {
  switch (c) {
    case '.': return ",";
    case '-': case 'm': return "−";
    case '*': return "×";
    case '/': return "÷";
    case 'r': return "√";
    case 's': return "²";
  }
  tmp[0] = c; tmp[1] = 0;
  return tmp;
}

static int opPad(char c, const AAFont& f) { return isBinOp(c) ? (&f == &F_M ? 3 : 2) : 0; }

// Строка части дроби (или главная строка без дробей): ширина и, если s != nullptr, отрисовка
int drawPlain(Surface* s, const Item* it, int n, const AAFont& f, int x, int base, uint16_t col) {
  char tmp[2];
  int x0 = x;
  for (int i = 0; i < n; i++) {
    char c = it[i].c;
    const char* str = itemStr(c, tmp);
    int pad = opPad(c, f);
    x += pad;
    if (s) drawText(*s, f, x, base, str, col);
    x += textW(f, str) + pad;
  }
  return x - x0;
}

// Геометрия строки выражения внутри экрана
#define EXP_BASE 57       // базовая линия основного текста
#define EXP_BAR 50        // линия дроби
#define EXP_RIGHT 288
#define EXP_LEFT 12

int partW(const Part& p) { return p.n ? drawPlain(nullptr, p.it, p.n, F_F, 0, 0, 0) : 11; }

void drawPlaceholder(Surface& s, int x, int base, uint16_t col) {
  roundRectS(s, x + 0.5f, base - 13 + 0.5f, 10, 14, 2.5f, C_PANEL, col, 1.2f);
}

void drawCursor(Surface& s, int x, int top, int bottom) {
  if (cursorOn) fillRectS(s, x, top, 2, bottom - top, C_ACCENT);
}

// Главная строка с дробями. s == nullptr — только измерить ширину
int drawMainLine(Surface* s, int x) {
  char tmp[2];
  int x0 = x;
  int capM = capH(F_M), capF = capH(F_F);
  for (int i = 0; i < mainN; i++) {
    char c = mainIt[i].c;
    if (c == 'F') {
      int fi = mainIt[i].f;
      Frac& F = fracs[fi];
      int wn = partW(F.num), wd = partW(F.den);
      int fw = (wn > wd ? wn : wd) + 8;
      x += 2;
      if (s) {
        bool editing = (target != TGT_MAIN && curFrac == fi);
        uint16_t barC = editing ? C_ACCENT : C_DIGIT;
        fillRectS(*s, x, EXP_BAR, fw, 2, barC);
        int nb = EXP_BAR - 4, db = EXP_BAR + 5 + capF;
        int nx = x + (fw - wn) / 2, dx = x + (fw - wd) / 2;
        bool numA = editing && target == TGT_NUM, denA = editing && target == TGT_DEN;
        if (F.num.n) drawPlain(s, F.num.it, F.num.n, F_F, nx, nb, C_DIGIT);
        else drawPlaceholder(*s, nx, nb, numA ? C_ACCENT : C_DIM);
        if (F.den.n) drawPlain(s, F.den.it, F.den.n, F_F, dx, db, C_DIGIT);
        else drawPlaceholder(*s, dx, db, denA ? C_ACCENT : C_DIM);
        if (numA) drawCursor(*s, F.num.n ? nx + wn + 1 : nx + 12, nb - capF - 1, nb + 2);
        if (denA) drawCursor(*s, F.den.n ? dx + wd + 1 : dx + 12, db - capF - 1, db + 2);
      }
      x += fw + 2;
    } else {
      const char* str = itemStr(c, tmp);
      int pad = opPad(c, F_M);
      x += pad;
      if (s) drawText(*s, F_M, x, EXP_BASE, str, C_DIGIT);
      x += textW(F_M, str) + pad;
    }
  }
  if (s && target == TGT_MAIN && !justEval) drawCursor(*s, x + 1, EXP_BASE - capM - 2, EXP_BASE + 3);
  return x - x0 + 4;
}

// ===================== Отрисовка результата =====================
// Рисует значение, выровненное по правому краю right. big — крупный шрифт итогового ответа
void drawValue(Surface& s, const Val& v, int right, bool big, uint16_t col) {
  const AAFont& fn = big ? F_L : F_M;
  int base = big ? 110 : 108;
  char sign[4] = "", whole[32] = "", num[24] = "", den[24] = "", dec[64] = "";
  bool frac = false;
  if (v.exact && v.d != 1 && fmtMode != 2) {
    int64_t an = v.n < 0 ? -v.n : v.n;
    if (v.n < 0) strcpy(sign, "−");
    if (fmtMode == 1 && an > v.d) {
      snprintf(whole, sizeof whole, "%lld", (long long)(an / v.d));
      an %= v.d;
    }
    snprintf(num, sizeof num, "%lld", (long long)an);
    snprintf(den, sizeof den, "%lld", (long long)v.d);
    frac = true;
  } else if (v.exact) {
    fmtDecimalExact(v.n, v.d, dec, sizeof dec);
  } else {
    fmtReal(v.v, dec, sizeof dec);
  }

  if (!frac) {
    const AAFont* f = &fn;
    if (textW(*f, dec) > right - EXP_LEFT) f = &F_M;  // длинное число — шрифт помельче
    drawText(s, *f, right - textW(*f, dec), base, dec, col);
    return;
  }
  int capF = capH(F_F);
  int wn = textW(F_F, num), wd = textW(F_F, den);
  int fw = (wn > wd ? wn : wd) + 6;
  int bar = big ? 95 : 94;
  int x = right - fw;
  fillRectS(s, x, bar, fw, 2, col);
  drawText(s, F_F, x + (fw - wn) / 2, bar - 4, num, col);
  drawText(s, F_F, x + (fw - wd) / 2, bar + 5 + capF, den, col);
  x -= 4;
  if (whole[0]) { x -= textW(fn, whole); drawText(s, fn, x, base, whole, col); x -= 2; }
  if (sign[0]) { x -= textW(fn, sign); drawText(s, fn, x, base, sign, col); }
}

void drawBulb(Surface& s, float cx, float cy, uint16_t c) {
  ringS(s, cx, cy - 2, 6.2f, 1.8f, c);
  capsuleS(s, cx - 2.6f, cy + 6.5f, cx + 2.6f, cy + 6.5f, 0.95f, c);
  capsuleS(s, cx - 1.6f, cy + 9.3f, cx + 1.6f, cy + 9.3f, 0.95f, c);
}

void renderDisplay() {
  Surface& s = sDisp;
  surfNoClip(s);
  surfFill(s, C_BG);
  roundRectS(s, 0.5f, 0.5f, DISP_W - 1, DISP_H - 1, 16, C_PANEL, C_PANEL_BORDER, 2.0f);

  int x = 16;
  if (memSet) x = drawText(s, F_S, x, 22, "M", C_ACCENT) + 8;
  drawText(s, F_S, x, 22, FMT_NAMES[fmtMode], C_DIM);
  drawBulb(s, 279, 17, fmtMode ? C_ACCENT : C_BULB);

  surfClip(s, EXP_LEFT, 26, EXP_RIGHT + 2, 76);
  int w = drawMainLine(nullptr, 0);
  drawMainLine(&s, EXP_RIGHT - w);

  surfClip(s, EXP_LEFT, 74, EXP_RIGHT + 2, DISP_H - 3);
  if (errCode) {
    const char* m = errText(errCode);
    drawText(s, F_M, EXP_RIGHT - textW(F_M, m), 106, m, C_ERR);
  } else if (justEval) {
    drawValue(s, lastRes, EXP_RIGHT, true, C_WHITE);
  } else if (previewOk) {
    drawValue(s, preview, EXP_RIGHT, false, C_DIM);
  }
  surfNoClip(s);
  pushPixels(DISP_X, DISP_Y, s.w, s.h, s.px);
}

void renderSegments() {
  Surface& s = sSeg;
  surfFill(s, C_BG);
  int segW = (SEG_W - 2 * 6) / 3;
  for (int i = 0; i < 3; i++) {
    int x = i * (segW + 6);
    bool on = (int)target == i;
    roundRectS(s, x + 0.5f, 0.5f, segW - 1, SEG_H - 1, 10, on ? C_SEG_ON : C_KEY, on ? C_EQ : C_BORDER, 1.5f);
    drawTextCenter(s, F_S, x + segW / 2, SEG_H / 2 - 1, SEG_NAMES[i], on ? C_WHITE : C_SEG_TEXT);
  }
  pushPixels(SEG_X, SEG_Y, s.w, s.h, s.px);
}

// ===================== Клавиатура =====================
static const char* keyLabel(uint8_t id) {
  static const char* const L[] = {
    "0", "1", "2", "3", "4", "5", "6", "7", "8", "9",
    ",", "+", "−", "×", "÷", "xⁿ", "x²", "%", "(", ")", "√x", "±", "",
    "C", "=", "MC", "MR", "M+", "M−",
  };
  return id <= K_MM ? L[id] : "";
}

void buildLayout() {
  float colW = (PAD_W - 4 * COL_GAP) / 5.0f;
  nKeys = 0;
  for (int r = 0; r < 6; r++)
    for (int c = 0; c < 5; c++) {
      uint8_t id = LAYOUT[r][c];
      if (c > 0 && LAYOUT[r][c - 1] == id) continue;  // продолжение широкой клавиши
      int span = 1;
      while (c + span < 5 && LAYOUT[r][c + span] == id) span++;
      int x0 = PAD_X + (int)roundf(c * (colW + COL_GAP));
      int x1 = PAD_X + (int)roundf((c + span) * (colW + COL_GAP) - COL_GAP);
      keys[nKeys++] = { id, (int16_t)x0, (int16_t)(PAD_Y + r * ROW_PITCH), (int16_t)(x1 - x0), (int16_t)KEY_H };
    }
}

void renderKey(const Key& k, bool down) {
  Surface& s = sKey;
  surfSize(s, k.w, k.h);
  surfFill(s, C_BG);
  uint16_t fill = down ? C_KEY_DOWN : C_KEY, border = down ? C_EQ : C_BORDER;
  if (k.id == K_EQ) { fill = down ? C_EQ_DOWN : C_EQ; border = fill; }
  roundRectS(s, 0.5f, 0.5f, k.w - 1, k.h - 1, 11, fill, border, 1.6f);

  float cx = k.w / 2.0f, cy = k.h / 2.0f;
  if (k.id == K_BS) {  // значок «стереть»
    float xs[] = { cx - 13, cx - 5.5f, cx + 12, cx + 12, cx - 5.5f };
    float ys[] = { cy, cy - 9, cy - 9, cy + 9, cy + 9 };
    polyS(s, xs, ys, 5, C_FUNC);
    capsuleS(s, cx - 1.5f, cy - 4, cx + 6.5f, cy + 4, 1.4f, fill);
    capsuleS(s, cx + 6.5f, cy - 4, cx - 1.5f, cy + 4, 1.4f, fill);
  } else {
    uint8_t id = k.id;
    const char* lab = keyLabel(id);
    bool digit = id <= K_9 || id == K_DOT;
    bool bigFont = digit || id == K_ADD || id == K_SUB || id == K_MUL || id == K_DIV || id == K_LP || id == K_RP || id == K_EQ;
    uint16_t col = digit ? C_DIGIT : (id == K_C ? C_CLEAR : (id == K_EQ ? C_WHITE : C_FUNC));
    drawTextCenter(s, bigFont ? F_K : F_M, (int)cx, (int)cy, lab, col);
  }
  pushPixels(k.x, k.y, s.w, s.h, s.px);
}

void calcRenderAll() {
  static uint16_t row[SCREEN_W];
  for (int i = 0; i < SCREEN_W; i++) row[i] = C_BG;
  for (int y = 0; y < TAB_Y; y++) pushPixels(0, y, SCREEN_W, 1, row);
  for (int i = 0; i < nKeys; i++) renderKey(keys[i], false);
  renderSegments();
  renderDisplay();
}

// Что под пальцем: индекс в keys[] (≥0) или код зоны (K_SEG_*, K_BULB) со знаком минус
int calcHit(int x, int y) {
  for (int i = 0; i < nKeys; i++) {
    const Key& k = keys[i];
    if (x >= k.x - 3 && x < k.x + k.w + 3 && y >= k.y - 3 && y < k.y + k.h + 3) return i;
  }
  if (y >= SEG_Y - 3 && y < SEG_Y + SEG_H + 3) {
    int i = (x - SEG_X) * 3 / SEG_W;
    if (i >= 0 && i < 3) return -(K_SEG_MAIN + i) - 1;
  }
  if (y >= DISP_Y && y < DISP_Y + 40 && x >= DISP_X + DISP_W - 60) return -K_BULB - 1;
  return -1000;
}


// ===================== Общие элементы интерфейса =====================
#define C_BLACK 0x0000
void beepClick();      // щелчок (если включён в настройках)
void applyBacklight();
void saveSettings();
uint32_t nowMs();

static inline uint16_t blendA(uint16_t bg, uint16_t fg, int a) {  // a: 0…255
  uint32_t rb = bg & 0xF81F;
  rb += (((fg & 0xF81F) - rb) * (uint32_t)(a >> 2)) >> 6;
  uint32_t g = bg & 0x07E0;
  g += (((fg & 0x07E0) - g) * (uint32_t)a) >> 8;
  return (uint16_t)((rb & 0xF81F) | (g & 0x07E0));
}

// Скруглённый прямоугольник: заливка с градиентом сверху вниз и прозрачностью, рамка 1 px
void rrectX(Surface& s, float x, float y, float w, float h, float r, uint16_t c0, uint16_t c1, int a0, int a1, uint16_t bc, int ba) {
  if (w <= 0 || h <= 0) return;
  float hx = w * 0.5f, hy = h * 0.5f, cx = x + hx, cy = y + hy;
  if (r > hx) r = hx;
  if (r > hy) r = hy;
  int X0 = std::max((int)floorf(x), s.cx0), X1 = std::min((int)ceilf(x + w), s.cx1);
  int Y0 = std::max((int)floorf(y), s.cy0), Y1 = std::min((int)ceilf(y + h), s.cy1);
  bool grad = c0 != c1 || a0 != a1;
  uint16_t c = c0;
  int a = a0;
  for (int py = Y0; py < Y1; py++) {
    float qy = fabsf(py + 0.5f - cy) - (hy - r);
    if (grad) {
      int t = (int)(clamp01((py + 0.5f - y) / h) * 255);
      c = mix565(c0, c1, t);
      a = a0 + (a1 - a0) * t / 255;
    }
    uint16_t* row = s.px + py * s.w;
    for (int px = X0; px < X1; px++) {
      float qx = fabsf(px + 0.5f - cx) - (hx - r);
      float d = (qx > 0 && qy > 0) ? sqrtf(qx * qx + qy * qy) - r : fmaxf(qx, qy) - r;
      float cov = clamp01(0.5f - d);
      if (cov <= 0) continue;
      if (ba > 0) {
        float in = clamp01(0.5f - (d + 1.0f));
        int fa = (int)(in * a);
        if (fa > 0) row[px] = fa >= 255 ? c : blendA(row[px], c, fa);
        int ea = (int)((cov - in) * ba);
        if (ea > 0) row[px] = blendA(row[px], bc, ea);
      } else {
        int fa = (int)(cov * a);
        if (fa > 0) row[px] = fa >= 255 ? c : blendA(row[px], c, fa);
      }
    }
  }
}
void rr(Surface& s, float x, float y, float w, float h, float r, uint16_t c, int a) { rrectX(s, x, y, w, h, r, c, c, a, a, 0, 0); }
void panel(Surface& s, float x, float y, float w, float h, float r) { rrectX(s, x, y, w, h, r, C_PANEL, C_PANEL, 255, 255, C_BORDER, 255); }
void outlineA(Surface& s, float x, float y, float w, float h, float r, uint16_t c, int a) { rrectX(s, x, y, w, h, r, c, c, 0, 0, c, a); }
void discA(Surface& s, float cx, float cy, float r, uint16_t c, int a) { rr(s, cx - r, cy - r, 2 * r, 2 * r, r, c, a); }

int capBase(const AAFont& f, float y, float h) { return (int)(y + (h + capH(f)) * 0.5f + 0.5f); }
void textC(Surface& s, const AAFont& f, int cx, int base, const std::string& t, uint16_t c) { drawText(s, f, cx - textW(f, t.c_str()) / 2, base, t.c_str(), c); }
int textR(Surface& s, const AAFont& f, int right, int base, const std::string& t, uint16_t c) { int x = right - textW(f, t.c_str()); drawText(s, f, x, base, t.c_str(), c); return x; }

void putUtf8(std::string& out, uint32_t cp) {
  if (cp < 0x80) out += (char)cp;
  else if (cp < 0x800) { out += (char)(0xC0 | (cp >> 6)); out += (char)(0x80 | (cp & 63)); }
  else if (cp < 0x10000) { out += (char)(0xE0 | (cp >> 12)); out += (char)(0x80 | ((cp >> 6) & 63)); out += (char)(0x80 | (cp & 63)); }
  else { out += (char)(0xF0 | (cp >> 18)); out += (char)(0x80 | ((cp >> 12) & 63)); out += (char)(0x80 | ((cp >> 6) & 63)); out += (char)(0x80 | (cp & 63)); }
}

// Один знак по центру точки (по габаритам глифа)
void glyphC(Surface& s, const AAFont& f, uint32_t cp, float cx, float cy, uint16_t col) {
  const Glyph* g = findGlyph(f, cp);
  if (!g) return;
  std::string t;
  putUtf8(t, cp);
  drawText(s, f, (int)(cx - g->xo - g->w / 2.0f + 0.5f), (int)(cy - g->yo - g->h / 2.0f + 0.5f), t.c_str(), col);
}

// Перенос по словам
std::vector<std::string> wrapText(const AAFont& f, const std::string& text, int maxW) {
  std::vector<std::string> lines;
  std::string line, word;
  size_t i = 0;
  while (i <= text.size()) {
    if (i == text.size() || text[i] == ' ') {
      if (!word.empty()) {
        std::string cand = line.empty() ? word : line + " " + word;
        if (textW(f, cand.c_str()) <= maxW || line.empty()) {
          if (line.empty() && textW(f, word.c_str()) > maxW) {  // слишком длинное слово — режем
            std::string part;
            const char* p = word.c_str();
            while (*p) {
              const char* q = p;
              utf8Next(q);
              std::string ch(p, q - p);
              if (!part.empty() && textW(f, (part + ch).c_str()) > maxW) { lines.push_back(part); part.clear(); }
              part += ch;
              p = q;
            }
            line = part;
          } else line = cand;
        } else { lines.push_back(line); line = word; }
        word.clear();
      }
      i++;
      continue;
    }
    word += text[i++];
  }
  if (!line.empty() || lines.empty()) lines.push_back(line);
  return lines;
}

std::string ellipsize(const AAFont& f, const std::string& t, int maxW) {
  if (textW(f, t.c_str()) <= maxW) return t;
  std::string r = t;
  while (!r.empty()) {
    size_t k = r.size() - 1;
    while (k > 0 && ((unsigned char)r[k] & 0xC0) == 0x80) k--;
    r.erase(k);
    if (textW(f, (r + "…").c_str()) <= maxW) return r + "…";
  }
  return "…";
}

// ---------- Отрисовка полосами ----------
uint32_t renderGen = 0;  // меняется при любой обычной перерисовке (для частичного обновления экрана телефона)
void renderRegion(int y0, int y1, void (*draw)(Surface&, int)) {
  renderGen++;
  for (int y = std::max(0, y0); y < std::min(SCREEN_H, y1); y += STRIP_H) {
    int h = std::min(STRIP_H, std::min(SCREEN_H, y1) - y);
    surfSize(sStrip, SCREEN_W, h);
    surfFill(sStrip, C_BG);
    draw(sStrip, y);
    pushPixels(0, y, SCREEN_W, h, sStrip.px);
  }
}

// ---------- Тема ----------
static const uint8_t THEMES[6][6] = {
  { 186, 140, 255, 123, 31, 162 },  // фиолетовая
  { 125, 178, 255, 32, 96, 210 },   // синяя
  { 104, 226, 160, 18, 132, 82 },   // зелёная
  { 255, 178, 96, 204, 92, 18 },    // оранжевая
  { 255, 132, 182, 192, 32, 104 },  // розовая
  { 92, 216, 230, 12, 124, 144 },   // бирюзовая
};
static const char* const THEME_NAMES[6] = { "Фиолетовая", "Синяя", "Зелёная", "Оранжевая", "Розовая", "Бирюзовая" };
void applyTheme(int i) {
  if (i < 0 || i > 5) i = 0;
  const uint8_t* t = THEMES[i];
  uint16_t acc = MK565(t[0], t[1], t[2]), main = MK565(t[3], t[4], t[5]);
  th_C_ACCENT = acc;
  th_C_EQ = main;
  th_C_EQ_DOWN = mix565(main, C_WHITE, 50);
  th_C_PANEL_BORDER = mix565(main, C_PANEL, 50);
  th_C_BULB = mix565(main, acc, 20);
  th_C_SEG_ON = mix565(C_BG, main, 80);
  th_C_KEY_DOWN = mix565(C_BG, main, 70);
  th_C_SEG_TEXT = mix565(acc, MK565(150, 150, 160), 120);
  th_C_FUNC = mix565(acc, MK565(205, 205, 215), 150);
}

// ---------- Значки ----------
void iconChevronL(Surface& s, float cx, float cy, float sz, uint16_t c) {
  capsuleS(s, cx + sz * 0.5f, cy - sz, cx - sz * 0.5f, cy, 1.7f, c);
  capsuleS(s, cx - sz * 0.5f, cy, cx + sz * 0.5f, cy + sz, 1.7f, c);
}
void iconChevronR(Surface& s, float cx, float cy, float sz, uint16_t c) {
  capsuleS(s, cx - sz * 0.5f, cy - sz, cx + sz * 0.5f, cy, 1.7f, c);
  capsuleS(s, cx + sz * 0.5f, cy, cx - sz * 0.5f, cy + sz, 1.7f, c);
}
void iconCalc(Surface& s, float cx, float cy, uint16_t c) {
  outlineA(s, cx - 8, cy - 10, 16, 20, 3, c, 255);
  outlineA(s, cx - 7.5f, cy - 9.5f, 15, 19, 2.5f, c, 255);
  rr(s, cx - 5, cy - 7, 10, 4, 1, c, 255);
  for (int r = 0; r < 2; r++)
    for (int k = 0; k < 3; k++) discA(s, cx - 4 + k * 4, cy + 1 + r * 4.5f, 1.3f, c, 255);
}
void iconBook(Surface& s, float cx, float cy, uint16_t c) {
  float lx[] = { cx - 11, cx - 1, cx - 1, cx - 11 }, ly[] = { cy - 8, cy - 6, cy + 9, cy + 7 };
  polyS(s, lx, ly, 4, c);
  float rx[] = { cx + 1, cx + 11, cx + 11, cx + 1 }, ry[] = { cy - 6, cy - 8, cy + 7, cy + 9 };
  polyS(s, rx, ry, 4, c);
}
void iconGear(Surface& s, float cx, float cy, uint16_t c) {
  ringS(s, cx, cy, 5.5f, 3.0f, c);
  for (int k = 0; k < 8; k++) {
    float a = k * 0.7854f, ca = cosf(a), sa = sinf(a);
    capsuleS(s, cx + ca * 7.5f, cy + sa * 7.5f, cx + ca * 9.5f, cy + sa * 9.5f, 1.8f, c);
  }
}
void iconUndo(Surface& s, float cx, float cy, uint16_t c) {
  for (int k = 0; k <= 10; k++) {  // дуга
    float a0 = 3.4f - k * 0.27f, a1 = 3.4f - (k + 1) * 0.27f;
    if (k < 10) capsuleS(s, cx + cosf(a0) * 6.5f, cy + 1 + sinf(a0) * 6.5f, cx + cosf(a1) * 6.5f, cy + 1 + sinf(a1) * 6.5f, 1.3f, c);
  }
  float xs[] = { cx - 10, cx - 3, cx - 7.5f }, ys[] = { cy - 2, cy - 1, cy + 4 };
  polyS(s, xs, ys, 3, c);
}
void iconRestart(Surface& s, float cx, float cy, uint16_t c) {
  for (int k = 0; k < 12; k++) {
    float a0 = -1.2f + k * 0.42f, a1 = -1.2f + (k + 1) * 0.42f;
    capsuleS(s, cx + cosf(a0) * 7, cy + sinf(a0) * 7, cx + cosf(a1) * 7, cy + sinf(a1) * 7, 1.3f, c);
  }
  float xs[] = { cx + 2, cx + 6.5f, cx + 7.5f }, ys[] = { cy - 9.5f, cy - 4, cy - 10.5f };
  polyS(s, xs, ys, 3, c);
}
void iconFlip(Surface& s, float cx, float cy, uint16_t c) {
  capsuleS(s, cx - 4, cy - 7, cx - 4, cy + 7, 1.3f, c);
  float a[] = { cx - 8, cx, cx - 4 }, b[] = { cy - 3, cy - 3, cy - 8 };
  polyS(s, a, b, 3, c);
  capsuleS(s, cx + 4, cy - 7, cx + 4, cy + 7, 1.3f, c);
  float d[] = { cx, cx + 8, cx + 4 }, e[] = { cy + 3, cy + 3, cy + 8 };
  polyS(s, d, e, 3, c);
}
void iconFolder(Surface& s, float cx, float cy, uint16_t c) {
  rr(s, cx - 10, cy - 8, 8, 4, 1.5f, c, 255);
  rr(s, cx - 10, cy - 6, 20, 14, 2.5f, c, 255);
}
void iconDoc(Surface& s, float cx, float cy, uint16_t c) {
  outlineA(s, cx - 7, cy - 9, 14, 18, 2.5f, c, 255);
  for (int k = 0; k < 3; k++) rr(s, cx - 4, cy - 4 + k * 4, 8 - (k == 2) * 3, 1.6f, 0.8f, c, 255);
}
void iconImage(Surface& s, float cx, float cy, uint16_t c) {
  outlineA(s, cx - 9, cy - 7, 18, 14, 2.5f, c, 255);
  float xs[] = { cx - 6, cx - 1, cx + 2, cx + 4, cx + 7 }, ys[] = { cy + 5, cy - 1, cy + 2, cy, cy + 5 };
  polyS(s, xs, ys, 5, c);
  discA(s, cx + 3, cy - 3, 1.6f, c, 255);
}

// Круглая кнопка в шапке
void headButton(Surface& s, float cx, float cy, int kind, uint16_t c) {
  rrectX(s, cx - 17, cy - 17, 34, 34, 17, C_KEY, C_KEY, 255, 255, C_BORDER, 255);
  if (kind == 0) iconUndo(s, cx, cy, c);
  else if (kind == 1) iconRestart(s, cx, cy, c);
  else iconFlip(s, cx, cy, c);
}
// Шапка экрана: «‹ назад», заголовок по центру
int rightLimit = SCREEN_W - 16;  // правый край заголовка (левее кнопок шапки)
void drawHeader(Surface& s, int o, const char* back, const std::string& title) {
  if (back) {
    iconChevronL(s, 18, o + 28, 6, C_ACCENT);
    drawText(s, F_SB, 28, capBase(F_SB, o + 12, 32), back, C_ACCENT);
  }
  if (title.empty()) return;
  const AAFont& f = textW(F_T, title.c_str()) > 130 ? F_SB : F_T;  // длинный заголовок — мельче
  int w = textW(f, title.c_str()), left = back ? 34 + textW(F_SB, back) + 10 : 16;
  int cx = std::max(SCREEN_W / 2, left + w / 2);
  cx = std::min(cx, rightLimit - w / 2);
  drawText(s, f, cx - w / 2, capBase(f, o + 12, 32), title.c_str(), C_WHITE);
}

// ---------- Панель вкладок ----------
static const char* const TAB_NAMES[TAB_COUNT] = { "Калькулятор", "Игры", "Справочник", "Настройки" };
void drawTabBar(Surface& s, int top) {
  int o = TAB_Y - top;
  fillRectS(s, 0, o, SCREEN_W, TAB_H, MK565(10, 10, 13));
  fillRectS(s, 0, o, SCREEN_W, 1, C_BORDER);
  for (int i = 0; i < TAB_COUNT; i++) {
    float cx = 40 + 80 * i, cy = o + 19;
    bool on = i == curTab;
    uint16_t col = on ? C_ACCENT : C_DIM;
    if (on) rr(s, cx - 27, o + 5, 54, 28, 14, C_EQ, 110);
    if (i == TAB_CALC) iconCalc(s, cx, cy, col);
    else if (i == TAB_GAMES) glyphC(s, F_T, 0x265E, cx, cy, col);
    else if (i == TAB_REF) iconBook(s, cx, cy, col);
    else iconGear(s, cx, cy, col);
    textC(s, F_X, (int)cx, o + 46, TAB_NAMES[i], on ? C_WHITE : C_DIM);
  }
}
void renderTabBar() { renderRegion(TAB_Y, SCREEN_H, drawTabBar); }

// ===================== Игры для двоих =====================
#define BX 8              // доска 8×8: левый верхний угол и клетка
#define BY 66
#define SQ 38
#define C_LIGHT MK565(236, 232, 212)
#define C_DARKSQ MK565(122, 148, 92)
#define C_CKDARK MK565(112, 78, 58)
#define C_CKLIGHT MK565(226, 204, 168)
#define C_RED MK565(226, 64, 72)
#define C_GOLD MK565(255, 200, 70)

// ---------- Шахматы: правила ----------
// Клетка: 0 = a1 … 63 = h8. Фигура: 1 пешка, 2 конь, 3 слон, 4 ладья, 5 ферзь, 6 король; у чёрных со знаком минус.
static const int8_t KN_D[8][2] = { { 1, 2 }, { 2, 1 }, { 2, -1 }, { 1, -2 }, { -1, -2 }, { -2, -1 }, { -2, 1 }, { -1, 2 } };
static const int8_t KG_D[8][2] = { { 1, 0 }, { 1, 1 }, { 0, 1 }, { -1, 1 }, { -1, 0 }, { -1, -1 }, { 0, -1 }, { 1, -1 } };

void chReset(CState& s) {
  static const int8_t back[8] = { 4, 2, 3, 5, 6, 3, 2, 4 };
  memset(s.bd, 0, 64);
  for (int f = 0; f < 8; f++) { s.bd[f] = back[f]; s.bd[8 + f] = 1; s.bd[48 + f] = -1; s.bd[56 + f] = -back[f]; }
  s.side = 1; s.castle = 15; s.ep = -1; s.lastFrom = s.lastTo = -1; s.half = 0;
}

bool chAttacked(const CState& s, int sq, int by) {
  int f = sq & 7, r = sq >> 3;
  int pr = r - by;  // пешка стороны by бьёт «вперёд»
  if (pr >= 0 && pr < 8)
    for (int df = -1; df <= 1; df += 2) { int pf = f + df; if (pf >= 0 && pf < 8 && s.bd[pr * 8 + pf] == by) return true; }
  for (int k = 0; k < 8; k++) {
    int nf = f + KN_D[k][0], nr = r + KN_D[k][1];
    if (nf >= 0 && nf < 8 && nr >= 0 && nr < 8 && s.bd[nr * 8 + nf] == 2 * by) return true;
    nf = f + KG_D[k][0]; nr = r + KG_D[k][1];
    if (nf >= 0 && nf < 8 && nr >= 0 && nr < 8 && s.bd[nr * 8 + nf] == 6 * by) return true;
  }
  for (int k = 0; k < 8; k++) {
    int df = KG_D[k][0], dr = KG_D[k][1], nf = f + df, nr = r + dr;
    bool diag = df && dr;
    while (nf >= 0 && nf < 8 && nr >= 0 && nr < 8) {
      int p = s.bd[nr * 8 + nf];
      if (p) {
        if (p == 5 * by || p == (diag ? 3 : 4) * by) return true;
        break;
      }
      nf += df; nr += dr;
    }
  }
  return false;
}

int chKing(const CState& s, int side) { for (int i = 0; i < 64; i++) if (s.bd[i] == 6 * side) return i; return -1; }
bool chInCheck(const CState& s, int side) { int k = chKing(s, side); return k >= 0 && chAttacked(s, k, -side); }

void chAddPawn(std::vector<CMove>& v, int from, int to, uint8_t fl, int side) {
  int r = to >> 3;
  if (r == 7 || r == 0) { for (int p = 5; p >= 2; p--) v.push_back({ (int8_t)from, (int8_t)to, (int8_t)p, fl }); }
  else v.push_back({ (int8_t)from, (int8_t)to, 0, fl });
}

void chPseudo(const CState& s, std::vector<CMove>& v) {
  int sd = s.side;
  for (int sq = 0; sq < 64; sq++) {
    int p = s.bd[sq] * sd;
    if (p <= 0) continue;
    int f = sq & 7, r = sq >> 3;
    if (p == 1) {
      int nr = r + sd;
      if (nr < 0 || nr > 7) continue;
      if (!s.bd[nr * 8 + f]) {
        chAddPawn(v, sq, nr * 8 + f, 0, sd);
        int start = sd > 0 ? 1 : 6;
        if (r == start && !s.bd[(r + 2 * sd) * 8 + f]) v.push_back({ (int8_t)sq, (int8_t)((r + 2 * sd) * 8 + f), 0, 0 });
      }
      for (int df = -1; df <= 1; df += 2) {
        int nf = f + df;
        if (nf < 0 || nf > 7) continue;
        int to = nr * 8 + nf;
        if (s.bd[to] * sd < 0) chAddPawn(v, sq, to, 1, sd);
        else if (to == s.ep) v.push_back({ (int8_t)sq, (int8_t)to, 0, 3 });
      }
    } else if (p == 2 || p == 6) {
      for (int k = 0; k < 8; k++) {
        int nf = f + (p == 2 ? KN_D[k][0] : KG_D[k][0]), nr = r + (p == 2 ? KN_D[k][1] : KG_D[k][1]);
        if (nf < 0 || nf > 7 || nr < 0 || nr > 7) continue;
        int t = s.bd[nr * 8 + nf] * sd;
        if (t <= 0) v.push_back({ (int8_t)sq, (int8_t)(nr * 8 + nf), 0, (uint8_t)(t < 0 ? 1 : 0) });
      }
      if (p == 6) {  // рокировка
        int base = sd > 0 ? 0 : 56;
        uint8_t kBit = sd > 0 ? 1 : 4, qBit = sd > 0 ? 2 : 8;
        if (sq == base + 4 && !chAttacked(s, sq, -sd)) {
          if ((s.castle & kBit) && s.bd[base + 7] == 4 * sd && !s.bd[base + 5] && !s.bd[base + 6] && !chAttacked(s, base + 5, -sd) && !chAttacked(s, base + 6, -sd))
            v.push_back({ (int8_t)sq, (int8_t)(base + 6), 0, 4 });
          if ((s.castle & qBit) && s.bd[base] == 4 * sd && !s.bd[base + 1] && !s.bd[base + 2] && !s.bd[base + 3] && !chAttacked(s, base + 3, -sd) && !chAttacked(s, base + 2, -sd))
            v.push_back({ (int8_t)sq, (int8_t)(base + 2), 0, 4 });
        }
      }
    } else {
      for (int k = 0; k < 8; k++) {
        int df = KG_D[k][0], dr = KG_D[k][1];
        bool diag = df && dr;
        if ((p == 3 && !diag) || (p == 4 && diag)) continue;
        int nf = f + df, nr = r + dr;
        while (nf >= 0 && nf < 8 && nr >= 0 && nr < 8) {
          int t = s.bd[nr * 8 + nf] * sd;
          if (t > 0) break;
          v.push_back({ (int8_t)sq, (int8_t)(nr * 8 + nf), 0, (uint8_t)(t < 0 ? 1 : 0) });
          if (t < 0) break;
          nf += df; nr += dr;
        }
      }
    }
  }
}

CState chApply(const CState& s, const CMove& m) {
  CState n = s;
  int sd = s.side, p = n.bd[m.from];
  bool pawn = p * sd == 1, capture = n.bd[m.to] != 0 || (m.flags & 2);
  if (m.flags & 2) n.bd[m.to - 8 * sd] = 0;  // на проходе
  n.bd[m.to] = m.promo ? (int8_t)(m.promo * sd) : (int8_t)p;
  n.bd[m.from] = 0;
  if (m.flags & 4) {  // рокировка: ладья
    int base = sd > 0 ? 0 : 56;
    if (m.to == base + 6) { n.bd[base + 5] = n.bd[base + 7]; n.bd[base + 7] = 0; }
    else { n.bd[base + 3] = n.bd[base]; n.bd[base] = 0; }
  }
  if (p * sd == 6) n.castle &= sd > 0 ? ~3 : ~12;
  if (m.from == 0 || m.to == 0) n.castle &= ~2;
  if (m.from == 7 || m.to == 7) n.castle &= ~1;
  if (m.from == 56 || m.to == 56) n.castle &= ~8;
  if (m.from == 63 || m.to == 63) n.castle &= ~4;
  n.ep = pawn && abs(m.to - m.from) == 16 ? (int8_t)((m.from + m.to) / 2) : (int8_t)-1;
  n.half = pawn || capture ? 0 : s.half + 1;
  n.side = -sd;
  n.lastFrom = m.from; n.lastTo = m.to;
  return n;
}

void chLegalMoves(const CState& s, std::vector<CMove>& out) {
  std::vector<CMove> v;
  v.reserve(64);
  chPseudo(s, v);
  out.clear();
  for (auto& m : v) {
    CState n = chApply(s, m);
    if (!chInCheck(n, s.side)) out.push_back(m);
  }
}

uint64_t chPerft(const CState& s, int depth) {
  std::vector<CMove> v;
  chLegalMoves(s, v);
  if (depth == 1) return v.size();
  uint64_t n = 0;
  for (auto& m : v) n += chPerft(chApply(s, m), depth - 1);
  return n;
}

bool chInsufficient(const CState& s) {
  int minors = 0;
  for (int i = 0; i < 64; i++) {
    int p = abs(s.bd[i]);
    if (p == 1 || p == 4 || p == 5) return false;
    if (p == 2 || p == 3) minors++;
  }
  return minors <= 1;
}

void chUpdate() {
  chLegalMoves(cs, chLegal);
  chResult = 0;
  if (chLegal.empty()) chResult = chInCheck(cs, cs.side) ? (cs.side > 0 ? 2 : 1) : 3;
  else if (chInsufficient(cs)) chResult = 4;
  else if (cs.half >= 100) chResult = 5;
}
void chNew() { chReset(cs); chHist.clear(); chSel = chPromoFrom = chPromoTo = -1; chUpdate(); }

int chMaterial(int side) {
  static const int val[7] = { 0, 1, 3, 3, 5, 9, 0 };
  int m = 0;
  for (int i = 0; i < 64; i++) if (cs.bd[i] * side > 0) m += val[abs(cs.bd[i])];
  return m;
}

// ---------- Шашки (русские): правила ----------
// Шашки стоят на тёмных полях ((ряд + столбец) чётное). 1 — белая, 2 — белая дамка, −1/−2 — чёрные. Белые идут вверх.
void ckReset(CkState& s) {
  memset(s.b, 0, 64);
  for (int r = 0; r < 8; r++)
    for (int f = 0; f < 8; f++)
      if ((r + f) % 2 == 0) { if (r < 3) s.b[r * 8 + f] = 1; else if (r > 4) s.b[r * 8 + f] = -1; }
  s.side = 1; s.lastFrom = s.lastTo = -1;
}

static const int8_t DIAG[4][2] = { { 1, 1 }, { -1, 1 }, { 1, -1 }, { -1, -1 } };

// Поиск всех цепочек взятий (сбитые снимаются в конце хода — «турецкий удар» запрещён)
void ckCaptures(const CkState& s, int pos, bool king, int side, CkMove& cur, uint64_t taken, std::vector<CkMove>& out) {
  int f = pos & 7, r = pos >> 3;
  bool any = false;
  for (int d = 0; d < 4; d++) {
    int df = DIAG[d][0], dr = DIAG[d][1];
    int nf = f + df, nr = r + dr;
    if (king) while (nf >= 0 && nf < 8 && nr >= 0 && nr < 8 && !s.b[nr * 8 + nf]) { nf += df; nr += dr; }
    if (nf < 0 || nf > 7 || nr < 0 || nr > 7) continue;
    int e = nr * 8 + nf;
    if (s.b[e] * side >= 0 || (taken >> e & 1)) continue;  // не враг или уже сбит
    // поля за сбиваемой
    std::vector<int> lands;
    int lf = nf + df, lr = nr + dr;
    while (lf >= 0 && lf < 8 && lr >= 0 && lr < 8 && !s.b[lr * 8 + lf]) {
      lands.push_back(lr * 8 + lf);
      if (!king) break;
      lf += df; lr += dr;
    }
    if (lands.empty()) continue;
    // дамка обязана встать туда, откуда можно бить дальше (если такое поле есть)
    std::vector<int> cont;
    uint64_t t2 = taken | (1ULL << e);
    for (int l : lands) {
      bool k2 = king || ((l >> 3) == (side > 0 ? 7 : 0));
      std::vector<CkMove> probe;
      CkMove tmp = cur;
      tmp.path[tmp.n++] = l; tmp.caps[tmp.nc++] = e;
      ckCaptures(s, l, k2, side, tmp, t2, probe);
      if (!probe.empty() && probe[0].nc > tmp.nc) cont.push_back(l);
    }
    const std::vector<int>& use = cont.empty() ? lands : cont;
    for (int l : use) {
      if (cur.n >= 15 || cur.nc >= 12) continue;
      any = true;
      bool k2 = king || ((l >> 3) == (side > 0 ? 7 : 0));  // стала дамкой — бьёт дальше как дамка
      CkMove nx = cur;
      nx.path[nx.n++] = l;
      nx.caps[nx.nc++] = e;
      size_t before = out.size();
      ckCaptures(s, l, k2, side, nx, t2, out);
      if (out.size() == before) out.push_back(nx);
    }
  }
  (void)any;
}

void ckGen(const CkState& s, std::vector<CkMove>& out) {
  out.clear();
  int side = s.side;
  CkState t = s;
  for (int sq = 0; sq < 64; sq++) {
    if (s.b[sq] * side <= 0) continue;
    bool king = abs(s.b[sq]) == 2;
    t.b[sq] = 0;  // шашка «поднята» с поля, пока бьёт
    CkMove m;
    memset(&m, 0, sizeof m);
    m.path[0] = sq; m.n = 1; m.nc = 0;
    ckCaptures(t, sq, king, side, m, 0, out);
    t.b[sq] = s.b[sq];
  }
  if (!out.empty()) return;  // бить обязательно
  for (int sq = 0; sq < 64; sq++) {
    if (s.b[sq] * side <= 0) continue;
    bool king = abs(s.b[sq]) == 2;
    int f = sq & 7, r = sq >> 3;
    for (int d = 0; d < 4; d++) {
      int df = DIAG[d][0], dr = DIAG[d][1];
      if (!king && dr != side) continue;
      int nf = f + df, nr = r + dr;
      while (nf >= 0 && nf < 8 && nr >= 0 && nr < 8 && !s.b[nr * 8 + nf]) {
        CkMove m;
        memset(&m, 0, sizeof m);
        m.path[0] = sq; m.path[1] = nr * 8 + nf; m.n = 2;
        out.push_back(m);
        if (!king) break;
        nf += df; nr += dr;
      }
    }
  }
}

CkState ckApply(const CkState& s, const CkMove& m) {
  CkState n = s;
  int from = m.path[0], to = m.path[m.n - 1];
  int p = n.b[from];
  n.b[from] = 0;
  for (int i = 0; i < m.nc; i++) n.b[m.caps[i]] = 0;
  bool crowned = false;
  for (int i = 1; i < m.n; i++) if ((m.path[i] >> 3) == (s.side > 0 ? 7 : 0)) crowned = true;
  n.b[to] = crowned ? (int8_t)(2 * s.side) : (int8_t)p;
  n.side = -s.side;
  n.lastFrom = from; n.lastTo = to;
  return n;
}

void ckNew() { ckReset(ks); ckHist.clear(); ckPathN = 0; ckGen(ks, ckMoves); }
int ckCount(int side) { int n = 0; for (int i = 0; i < 64; i++) if (ks.b[i] * side > 0) n++; return n; }

// ---------- Крестики-нолики и «4 в ряд»: правила ----------
static const int8_t TT_LINES[8][3] = { { 0, 1, 2 }, { 3, 4, 5 }, { 6, 7, 8 }, { 0, 3, 6 }, { 1, 4, 7 }, { 2, 5, 8 }, { 0, 4, 8 }, { 2, 4, 6 } };
void ttNew() { memset(tt, 0, sizeof tt); ttTurn = ttStarter; ttWin = 0; ttLine[0] = -1; }
void ttCheck() {
  for (auto& l : TT_LINES)
    if (tt[l[0]] && tt[l[0]] == tt[l[1]] && tt[l[1]] == tt[l[2]]) { ttWin = tt[l[0]]; memcpy(ttLine, l, 3); ttScore[ttWin]++; return; }
  bool full = true;
  for (int i = 0; i < 9; i++) if (!tt[i]) full = false;
  if (full) { ttWin = 3; ttScore[0]++; }
}

void c4New() { memset(c4, 0, sizeof c4); c4Turn = c4Starter; c4Win = 0; }
bool c4Check(int r, int c) {
  static const int8_t D[4][2] = { { 0, 1 }, { 1, 0 }, { 1, 1 }, { 1, -1 } };
  int p = c4[r][c];
  for (auto& d : D) {
    int n = 1, cells[7][2], k = 0;
    cells[k][0] = r; cells[k][1] = c; k++;
    for (int sgn = -1; sgn <= 1; sgn += 2)
      for (int i = 1; i < 4; i++) {
        int rr2 = r + d[0] * i * sgn, cc = c + d[1] * i * sgn;
        if (rr2 < 0 || rr2 > 5 || cc < 0 || cc > 6 || c4[rr2][cc] != p) break;
        cells[k][0] = rr2; cells[k][1] = cc; k++; n++;
      }
    if (n >= 4) { for (int i = 0; i < 4; i++) { c4Cells[i][0] = cells[i][0]; c4Cells[i][1] = cells[i][1]; } return true; }
  }
  return false;
}
int c4Drop(int c) {  // строка, куда упала фишка, или −1
  for (int r = 0; r < 6; r++)
    if (!c4[r][c]) {
      c4[r][c] = c4Turn;
      if (c4Check(r, c)) { c4Win = c4Turn; c4Score[c4Turn]++; }
      else {
        bool full = true;
        for (int k = 0; k < 7; k++) if (!c4[5][k]) full = false;
        if (full) { c4Win = 3; c4Score[0]++; }
      }
      c4Turn = 3 - c4Turn;
      return r;
    }
  return -1;
}

// ---------- Меню игр ----------
#define GCARD_W 146
#define GCARD_H 152
static const char* const GAME_TITLES[4] = { "Шахматы", "Шашки", "Крестики-нолики", "4 в ряд" };
static const char* const GAME_SUBS[4] = { "Все правила, отмена хода", "Русские, бить обязательно", "Поле 3×3, счёт партий", "Собери линию из четырёх" };
void gCardPos(int i, int& x, int& y) { x = 10 + (i % 2) * (GCARD_W + 8); y = 86 + (i / 2) * (GCARD_H + 10); }

void drawPiece(Surface& s, int p, float cx, float cy) {
  if (!p) return;
  int a = abs(p);
  if (p > 0) {
    glyphC(s, F_P, 0x2659 + 7 - a, cx, cy, C_WHITE);       // сплошной знак — заливка
    glyphC(s, F_P, 0x2653 + 7 - a, cx, cy, MK565(30, 30, 34));  // контур
  } else {
    glyphC(s, F_P, 0x2659 + 7 - a, cx, cy, MK565(28, 28, 32));
  }
}

void drawCkPiece(Surface& s, int p, float cx, float cy, float r, int alpha) {
  if (!p) return;
  uint16_t c0 = p > 0 ? MK565(248, 244, 232) : MK565(200, 52, 60), c1 = p > 0 ? MK565(206, 198, 180) : MK565(130, 24, 34);
  rrectX(s, cx - r, cy - r + 2, 2 * r, 2 * r, r, C_BLACK, C_BLACK, alpha * 60 / 255, alpha * 60 / 255, 0, 0);
  rrectX(s, cx - r, cy - r, 2 * r, 2 * r, r, c0, c1, alpha, alpha, C_BLACK, alpha * 120 / 255);
  rrectX(s, cx - r * 0.66f, cy - r * 0.66f, r * 1.32f, r * 1.32f, r * 0.66f, c1, c0, alpha * 140 / 255, alpha * 140 / 255, 0, 0);
  if (abs(p) == 2) {  // корона дамки
    float k = r / 14.0f;
    float xs[] = { cx - 7 * k, cx - 7 * k, cx - 3.5f * k, cx, cx + 3.5f * k, cx + 7 * k, cx + 7 * k };
    float ys[] = { cy + 4 * k, cy - 5 * k, cy - 1 * k, cy - 6 * k, cy - 1 * k, cy - 5 * k, cy + 4 * k };
    polyS(s, xs, ys, 7, C_GOLD);
  }
}

void drawGameMenu(Surface& s, int top) {
  int o = -top;
  drawText(s, F_H, 16, o + 46, "Игры", C_WHITE);
  drawText(s, F_B, 16, o + 70, "Для двоих на одном экране", C_DIM);
  for (int i = 0; i < 4; i++) {
    int x, y;
    gCardPos(i, x, y);
    y += o;
    if (y > s.h || y + GCARD_H < 0) continue;
    panel(s, x, y, GCARD_W, GCARD_H, 16);
    rrectX(s, x + 6, y + 6, GCARD_W - 12, 86, 12, mix565(C_PANEL, C_EQ, 90), mix565(C_PANEL, C_EQ, 40), 255, 255, 0, 0);
    float cx = x + GCARD_W / 2.0f, cy = y + 49;
    if (i == 0) {
      for (int k = 0; k < 4; k++) rr(s, cx - 38 + (k % 2) * 38, cy - 38 + (k / 2) * 38, 38, 38, 0, (k == 0 || k == 3) ? C_LIGHT : C_DARKSQ, 255);
      drawPiece(s, 2, cx - 19, cy - 19);
      drawPiece(s, -5, cx + 19, cy + 19);
      drawPiece(s, 1, cx + 19, cy - 19);
      drawPiece(s, -6, cx - 19, cy + 19);
    } else if (i == 1) {
      for (int k = 0; k < 4; k++) rr(s, cx - 38 + (k % 2) * 38, cy - 38 + (k / 2) * 38, 38, 38, 0, (k == 0 || k == 3) ? C_CKDARK : C_CKLIGHT, 255);
      drawCkPiece(s, 1, cx - 19, cy - 19, 14, 255);
      drawCkPiece(s, -1, cx + 19, cy + 19, 14, 255);
    } else if (i == 2) {
      for (int k = 1; k < 3; k++) { capsuleS(s, cx - 36 + k * 24, cy - 34, cx - 36 + k * 24, cy + 34, 1.5f, C_DIM); capsuleS(s, cx - 36, cy - 36 + k * 24, cx + 36, cy - 36 + k * 24, 1.5f, C_DIM); }
      capsuleS(s, cx - 31, cy - 31, cx - 17, cy - 17, 2.6f, C_ACCENT);
      capsuleS(s, cx - 17, cy - 31, cx - 31, cy - 17, 2.6f, C_ACCENT);
      ringS(s, cx, cy, 8, 2.6f, C_GOLD);
      capsuleS(s, cx + 17, cy + 17, cx + 31, cy + 31, 2.6f, C_ACCENT);
      capsuleS(s, cx + 31, cy + 17, cx + 17, cy + 31, 2.6f, C_ACCENT);
    } else {
      rr(s, cx - 46, cy - 34, 92, 70, 8, MK565(36, 70, 170), 255);
      for (int r = 0; r < 3; r++)
        for (int c = 0; c < 4; c++) {
          int v = (r == 2 && c < 3) ? 1 : (r == 1 && c == 1) ? 2 : (r == 2 && c == 3) ? 2 : 0;
          discA(s, cx - 33 + c * 22, cy - 20 + r * 22, 8, v == 1 ? C_RED : v == 2 ? C_GOLD : MK565(16, 28, 70), 255);
        }
    }
    drawText(s, F_SB, x + 12, y + 116, GAME_TITLES[i], C_WHITE);
    std::vector<std::string> sub = wrapText(F_X, GAME_SUBS[i], GCARD_W - 22);
    for (size_t k = 0; k < sub.size() && k < 2; k++) drawText(s, F_X, x + 12, y + 133 + 14 * (int)k, sub[k].c_str(), C_DIM);
  }
}

// ---------- Шахматы: экран ----------
int chView(int sq) {  // клетка → номер на экране (0 — левый верхний угол)
  int f = sq & 7, r = sq >> 3;
  bool flip = chAutoFlip && cs.side < 0;
  return flip ? (r * 8 + (7 - f)) : ((7 - r) * 8 + f);
}
int chFromView(int col, int row) {
  bool flip = chAutoFlip && cs.side < 0;
  return flip ? (row * 8 + (7 - col)) : ((7 - row) * 8 + col);
}

void drawChess(Surface& s, int top) {
  int o = -top;
  if (top < 60) {
    rightLimit = 204; drawHeader(s, o, "Игры", "Шахматы"); rightLimit = SCREEN_W - 16;
    headButton(s, 222, o + 28, 2, chAutoFlip ? C_ACCENT : C_DIM);
    headButton(s, 262, o + 28, 0, chHist.empty() ? C_BORDER : C_FUNC);
    headButton(s, 300, o + 28, 1, C_FUNC);
  }
  int kingInCheck = chInCheck(cs, cs.side) ? chKing(cs, cs.side) : -1;
  for (int sq = 0; sq < 64; sq++) {
    int v = chView(sq), col = v % 8, row = v / 8;
    int x = BX + col * SQ, y = o + BY + row * SQ;
    if (y > s.h || y + SQ < 0) continue;
    bool light = ((sq & 7) + (sq >> 3)) % 2 == 1;
    uint16_t c = light ? C_LIGHT : C_DARKSQ;
    if (sq == cs.lastFrom || sq == cs.lastTo) c = mix565(c, MK565(246, 220, 80), 110);
    if (sq == chSel) c = mix565(c, MK565(250, 230, 60), 170);
    rr(s, x, y, SQ, SQ, 0, c, 255);
    if (sq == kingInCheck) rrectX(s, x + 2, y + 2, SQ - 4, SQ - 4, SQ / 2, C_RED, C_RED, 190, 120, 0, 0);
    // подписи полей
    if (col == 0) { char b[2] = { (char)('1' + (sq >> 3)), 0 }; drawText(s, F_X, x + 2, y + 12, b, light ? C_DARKSQ : C_LIGHT); }
    if (row == 7) { char b[2] = { (char)('a' + (sq & 7)), 0 }; drawText(s, F_X, x + SQ - 9, y + SQ - 3, b, light ? C_DARKSQ : C_LIGHT); }
    drawPiece(s, cs.bd[sq], x + SQ / 2.0f, y + SQ / 2.0f + 1);
    if (chSel >= 0)
      for (auto& m : chLegal)
        if (m.from == chSel && m.to == sq && (m.promo == 0 || m.promo == 5)) {
          if (cs.bd[sq] || (m.flags & 2)) outlineA(s, x + 2, y + 2, SQ - 4, SQ - 4, SQ / 2, MK565(30, 30, 30), 150);
          else discA(s, x + SQ / 2.0f, y + SQ / 2.0f, 6, MK565(30, 30, 30), 90);
        }
  }
  outlineA(s, BX - 1, o + BY - 1, SQ * 8 + 2, SQ * 8 + 2, 2, C_BORDER, 255);
  // выбор фигуры для превращения пешки
  if (chPromoTo >= 0) {
    int v = chView(chPromoTo), col = v % 8;
    int x = BX + std::min(col, 4) * SQ - 4, y = o + BY + 3 * SQ - 10;
    rrectX(s, x, y, SQ * 4 + 8, SQ + 20, 12, C_PANEL, C_PANEL, 250, 250, C_ACCENT, 255);
    static const int8_t opts[4] = { 5, 4, 3, 2 };
    for (int k = 0; k < 4; k++) drawPiece(s, opts[k] * cs.side, x + 4 + SQ * k + SQ / 2.0f, y + 10 + SQ / 2.0f + 1);
  }
  // строка состояния
  int sy = o + BY + SQ * 8 + 10;
  if (sy < s.h && sy + 50 > 0) {
    static const char* const RES[6] = { "", "Мат! Победили белые", "Мат! Победили чёрные", "Пат — ничья", "Ничья: мало фигур", "Ничья: 50 ходов без взятий" };
    std::string st;
    uint16_t col = C_WHITE;
    if (chResult) { st = RES[chResult]; col = C_GOLD; }
    else {
      st = cs.side > 0 ? "Ход белых" : "Ход чёрных";
      if (kingInCheck >= 0) { st += " — шах!"; col = C_ERR; }
    }
    discA(s, 22, sy + 15, 8, cs.side > 0 ? C_WHITE : MK565(30, 30, 34), 255);
    outlineA(s, 14, sy + 7, 16, 16, 8, C_DIM, 255);
    drawText(s, F_SB, 38, sy + 20, st.c_str(), col);
    int d = chMaterial(1) - chMaterial(-1);
    std::string mat = d == 0 ? "Материал равный" : (d > 0 ? "Белые +" : "Чёрные +") + std::to_string(abs(d));
    drawText(s, F_X, 38, sy + 38, (mat + " · ход " + std::to_string(chHist.size() / 2 + 1)).c_str(), C_DIM);
  }
}

void chTap(int x, int y) {
  if (y < 56) {
    if (x < 90) { gScr = G_MENU; return; }
    if (x >= 205 && x < 240) chAutoFlip = !chAutoFlip;
    else if (x >= 244 && x < 281 && !chHist.empty()) { cs = chHist.back(); chHist.pop_back(); chSel = chPromoTo = -1; chUpdate(); }
    else if (x >= 282) chNew();
    return;
  }
  if (chPromoTo >= 0) {
    int v = chView(chPromoTo), col = v % 8;
    int px = BX + std::min(col, 4) * SQ - 4, py = BY + 3 * SQ - 10;
    if (y >= py && y < py + SQ + 20 && x >= px && x < px + SQ * 4 + 8) {
      static const int8_t opts[4] = { 5, 4, 3, 2 };
      int k = std::max(0, std::min(3, (x - px - 4) / SQ));
      for (auto& m : chLegal)
        if (m.from == chPromoFrom && m.to == chPromoTo && m.promo == opts[k]) { chHist.push_back(cs); cs = chApply(cs, m); break; }
      chUpdate();
    }
    chPromoTo = chPromoFrom = chSel = -1;
    return;
  }
  if (chResult) return;
  int col = (x - BX) / SQ, row = (y - BY) / SQ;
  if (x < BX || col > 7 || y < BY || row > 7) { chSel = -1; return; }
  int sq = chFromView(col, row);
  if (chSel >= 0) {
    for (auto& m : chLegal)
      if (m.from == chSel && m.to == sq) {
        if (m.promo) { chPromoFrom = chSel; chPromoTo = sq; return; }
        chHist.push_back(cs);
        cs = chApply(cs, m);
        chSel = -1;
        chUpdate();
        return;
      }
  }
  chSel = cs.bd[sq] * cs.side > 0 ? sq : -1;
}

// ---------- Шашки: экран ----------
int ckView(int sq) { int f = sq & 7, r = sq >> 3; return (7 - r) * 8 + f; }
bool ckPrefix(const CkMove& m) {
  if (m.n < ckPathN) return false;
  for (int i = 0; i < ckPathN; i++) if (m.path[i] != ckPath[i]) return false;
  return true;
}

void drawCheckers(Surface& s, int top) {
  int o = -top;
  if (top < 60) {
    rightLimit = 244; drawHeader(s, o, "Игры", "Шашки"); rightLimit = SCREEN_W - 16;
    headButton(s, 262, o + 28, 0, ckHist.empty() ? C_BORDER : C_FUNC);
    headButton(s, 300, o + 28, 1, C_FUNC);
  }
  bool mustCap = !ckMoves.empty() && ckMoves[0].nc > 0;
  uint64_t taken = 0, movable = 0, targets = 0;
  if (ckPathN)
    for (auto& m : ckMoves)
      if (ckPrefix(m)) {
        for (int i = 0; i < m.nc && i < ckPathN - 1; i++) taken |= 1ULL << m.caps[i];
        if (m.n > ckPathN) targets |= 1ULL << m.path[ckPathN];
      }
  for (auto& m : ckMoves) movable |= 1ULL << m.path[0];
  for (int sq = 0; sq < 64; sq++) {
    int v = ckView(sq), col = v % 8, row = v / 8;
    int x = BX + col * SQ, y = o + BY + row * SQ;
    if (y > s.h || y + SQ < 0) continue;
    bool dark = ((sq & 7) + (sq >> 3)) % 2 == 0;
    uint16_t c = dark ? C_CKDARK : C_CKLIGHT;
    if (dark && (sq == ks.lastFrom || sq == ks.lastTo)) c = mix565(c, MK565(200, 170, 60), 80);
    if (ckPathN && sq == ckPath[0]) c = mix565(c, MK565(240, 210, 70), 150);
    rr(s, x, y, SQ, SQ, 0, c, 255);
    int p = ks.b[sq];
    float cx = x + SQ / 2.0f, cy = y + SQ / 2.0f;
    if (ckPathN && sq == ckPath[0]) p = 0;  // шашка «в пути»
    if (ckPathN && sq == ckPath[ckPathN - 1]) p = ks.b[ckPath[0]];
    drawCkPiece(s, p, cx, cy, 14, (taken >> sq & 1) ? 90 : 255);
    if (!ckPathN && mustCap && (movable >> sq & 1) && ks.b[sq] * ks.side > 0) outlineA(s, cx - 17, cy - 17, 34, 34, 17, C_GOLD, 230);
    if (targets >> sq & 1) discA(s, cx, cy, 7, C_GOLD, 200);
  }
  outlineA(s, BX - 1, o + BY - 1, SQ * 8 + 2, SQ * 8 + 2, 2, C_BORDER, 255);
  int sy = o + BY + SQ * 8 + 10;
  if (sy < s.h && sy + 50 > 0) {
    std::string st;
    uint16_t col = C_WHITE;
    if (ckMoves.empty()) { st = ks.side > 0 ? "Победили чёрные!" : "Победили белые!"; col = C_GOLD; }
    else { st = ks.side > 0 ? "Ход белых" : "Ход чёрных"; if (mustCap) { st += " — бить обязательно"; col = C_GOLD; } }
    drawCkPiece(s, ks.side, 22, sy + 15, 8, 255);
    drawText(s, F_SB, 38, sy + 20, st.c_str(), col);
    std::string cnt = "Белых " + std::to_string(ckCount(1)) + " · чёрных " + std::to_string(ckCount(-1));
    drawText(s, F_X, 38, sy + 38, cnt.c_str(), C_DIM);
  }
}

void ckTap(int x, int y) {
  if (y < 56) {
    if (x < 90) { gScr = G_MENU; return; }
    if (x >= 244 && x < 281 && !ckHist.empty()) { ks = ckHist.back(); ckHist.pop_back(); ckPathN = 0; ckGen(ks, ckMoves); }
    else if (x >= 282) ckNew();
    return;
  }
  if (ckMoves.empty()) return;
  int col = (x - BX) / SQ, row = (y - BY) / SQ;
  if (x < BX || col > 7 || y < BY || row > 7) return;
  int sq = (7 - row) * 8 + col;
  if (ckPathN) {  // продолжение пути
    for (auto& m : ckMoves)
      if (ckPrefix(m) && m.n > ckPathN && m.path[ckPathN] == sq) {
        ckPath[ckPathN++] = sq;
        for (auto& f : ckMoves)  // путь закончен — делаем ход
          if (ckPrefix(f) && f.n == ckPathN) {
            ckHist.push_back(ks);
            ks = ckApply(ks, f);
            ckPathN = 0;
            ckGen(ks, ckMoves);
            return;
          }
        return;
      }
    if (ckPathN == 1) ckPathN = 0;  // другая шашка — выбор заново
    else return;                    // посреди взятия менять нельзя
  }
  for (auto& m : ckMoves) if (m.path[0] == sq) { ckPath[0] = sq; ckPathN = 1; return; }
}

// ---------- Крестики-нолики: экран ----------
#define TT_X 34
#define TT_Y 112
#define TT_C 84
void drawScore(Surface& s, int y, const char* a, int sa, const char* b, int sb, int draws, int turnSide, uint16_t ca, uint16_t cb) {
  rrectX(s, 16, y, 288, 44, 14, C_PANEL, C_PANEL, 255, 255, C_BORDER, 255);
  std::string l = std::string(a) + " " + std::to_string(sa), r = std::to_string(sb) + " " + b;
  if (turnSide == 1) rr(s, 18, y + 2, 142, 40, 12, C_EQ, 90);
  if (turnSide == 2) rr(s, 160, y + 2, 142, 40, 12, C_EQ, 90);
  drawText(s, F_SB, 30, capBase(F_SB, y, 44), l.c_str(), ca);
  textR(s, F_SB, 290, capBase(F_SB, y, 44), r, cb);
  textC(s, F_X, 160, capBase(F_X, y, 44), "ничьих " + std::to_string(draws), C_DIM);
}

void drawTtt(Surface& s, int top) {
  int o = -top;
  if (top < 60) { rightLimit = 282; drawHeader(s, o, "Игры", "Крестики-нолики"); rightLimit = SCREEN_W - 16; headButton(s, 300, o + 28, 1, C_FUNC); }
  drawScore(s, o + 56, "✕", ttScore[1], "○", ttScore[2], ttScore[0], ttWin ? 0 : ttTurn, C_ACCENT, C_GOLD);
  int gy = o + TT_Y;
  rrectX(s, TT_X - 6, gy - 6, TT_C * 3 + 12, TT_C * 3 + 12, 18, C_PANEL, C_PANEL, 255, 255, C_BORDER, 255);
  for (int k = 1; k < 3; k++) {
    capsuleS(s, TT_X + k * TT_C, gy + 10, TT_X + k * TT_C, gy + TT_C * 3 - 10, 1.6f, C_BORDER);
    capsuleS(s, TT_X + 10, gy + k * TT_C, TT_X + TT_C * 3 - 10, gy + k * TT_C, 1.6f, C_BORDER);
  }
  for (int i = 0; i < 9; i++) {
    float cx = TT_X + (i % 3) * TT_C + TT_C / 2.0f, cy = gy + (i / 3) * TT_C + TT_C / 2.0f;
    bool win = ttLine[0] >= 0 && (ttLine[0] == i || ttLine[1] == i || ttLine[2] == i);
    if (win) rr(s, cx - TT_C / 2.0f + 6, cy - TT_C / 2.0f + 6, TT_C - 12, TT_C - 12, 14, C_EQ, 120);
    if (tt[i] == 1) { capsuleS(s, cx - 22, cy - 22, cx + 22, cy + 22, 5, C_ACCENT); capsuleS(s, cx + 22, cy - 22, cx - 22, cy + 22, 5, C_ACCENT); }
    if (tt[i] == 2) ringS(s, cx, cy, 23, 8, C_GOLD);
  }
  std::string st = ttWin == 1 ? "Победили крестики! Нажмите, чтобы сыграть ещё" : ttWin == 2 ? "Победили нолики! Нажмите, чтобы сыграть ещё" : ttWin == 3 ? "Ничья. Нажмите, чтобы сыграть ещё" : (ttTurn == 1 ? "Ходят крестики" : "Ходят нолики");
  std::vector<std::string> lines = wrapText(F_SB, st, 290);
  for (size_t k = 0; k < lines.size(); k++) textC(s, F_SB, 160, o + TT_Y + TT_C * 3 + 32 + 20 * (int)k, lines[k], ttWin ? C_GOLD : C_WHITE);
}

void tttTap(int x, int y) {
  if (y < 56) { if (x < 90) gScr = G_MENU; else if (x >= 282) { ttNew(); ttScore[0] = ttScore[1] = ttScore[2] = 0; } return; }
  if (ttWin) { ttStarter = 3 - ttStarter; ttNew(); return; }
  int c = (x - TT_X) / TT_C, r = (y - TT_Y) / TT_C;
  if (x < TT_X || y < TT_Y || c > 2 || r > 2) return;
  int i = r * 3 + c;
  if (tt[i]) return;
  tt[i] = ttTurn;
  ttTurn = 3 - ttTurn;
  ttCheck();
}

// ---------- 4 в ряд: экран ----------
#define C4_X 13
#define C4_Y 124
#define C4_C 42
int c4AnimCol = -1, c4AnimRow = -1;
float c4AnimY = 0;
void drawC4(Surface& s, int top) {
  int o = -top;
  if (top < 60) { rightLimit = 282; drawHeader(s, o, "Игры", "4 в ряд"); rightLimit = SCREEN_W - 16; headButton(s, 300, o + 28, 1, C_FUNC); }
  drawScore(s, o + 56, "Красные", c4Score[1], "Жёлтые", c4Score[2], c4Score[0], c4Win ? 0 : c4Turn, C_RED, C_GOLD);
  int gy = o + C4_Y;
  rrectX(s, C4_X - 4, gy - 4, C4_C * 7 + 8, C4_C * 6 + 8, 14, MK565(44, 82, 196), MK565(26, 52, 140), 255, 255, MK565(90, 130, 230), 255);
  for (int r = 0; r < 6; r++)
    for (int c = 0; c < 7; c++) {
      float cx = C4_X + c * C4_C + C4_C / 2.0f, cy = gy + (5 - r) * C4_C + C4_C / 2.0f;
      int v = c4[r][c];
      if (c == c4AnimCol && r == c4AnimRow) v = 0;
      discA(s, cx, cy, 16, v == 1 ? C_RED : v == 2 ? C_GOLD : MK565(14, 24, 62), 255);
      if (v) discA(s, cx - 4, cy - 5, 6, C_WHITE, 50);
      if (c4Win && c4Win < 3)
        for (auto& cell : c4Cells) if (cell[0] == r && cell[1] == c) ringS(s, cx, cy, 17, 3, C_WHITE);
    }
  if (c4AnimCol >= 0) {
    float cx = C4_X + c4AnimCol * C4_C + C4_C / 2.0f;
    discA(s, cx, gy + c4AnimY, 16, c4[c4AnimRow][c4AnimCol] == 1 ? C_RED : C_GOLD, 255);
  }
  std::string st = c4Win == 1 ? "Победили красные! Нажмите, чтобы сыграть ещё" : c4Win == 2 ? "Победили жёлтые! Нажмите, чтобы сыграть ещё" : c4Win == 3 ? "Ничья. Нажмите, чтобы сыграть ещё" : (c4Turn == 1 ? "Ходят красные — нажмите на столбец" : "Ходят жёлтые — нажмите на столбец");
  std::vector<std::string> lines = wrapText(F_SB, st, 290);
  for (size_t k = 0; k < lines.size(); k++) textC(s, F_SB, 160, o + C4_Y + C4_C * 6 + 32 + 20 * (int)k, lines[k], c4Win ? C_GOLD : C_WHITE);
}

void c4Animate(int col, int row);
void c4Tap(int x, int y) {
  if (y < 56) { if (x < 90) gScr = G_MENU; else if (x >= 282) { c4New(); c4Score[0] = c4Score[1] = c4Score[2] = 0; } return; }
  if (c4Win) { c4Starter = 3 - c4Starter; c4New(); return; }
  int c = (x - C4_X) / C4_C;
  if (x < C4_X || c > 6 || y < 100) return;
  int r = c4Drop(c);
  if (r >= 0) c4Animate(c, r);
}

// ---------- Вкладка «Игры» ----------
void drawGames(Surface& s, int top) {
  switch (gScr) {
    case G_CHESS: drawChess(s, top); break;
    case G_CHECKERS: drawCheckers(s, top); break;
    case G_TTT: drawTtt(s, top); break;
    case G_C4: drawC4(s, top); break;
    default: drawGameMenu(s, top);
  }
}

void gamesTap(int x, int y) {
  switch (gScr) {
    case G_CHESS: chTap(x, y); break;
    case G_CHECKERS: ckTap(x, y); break;
    case G_TTT: tttTap(x, y); break;
    case G_C4: c4Tap(x, y); break;
    default:
      for (int i = 0; i < 4; i++) {
        int cx, cy;
        gCardPos(i, cx, cy);
        if (x >= cx && x < cx + GCARD_W && y >= cy && y < cy + GCARD_H) gScr = G_CHESS + i;
      }
  }
}

void gamesInit() { chNew(); ckNew(); ttNew(); c4New(); }

// ===================== Справочник и файлы с SD-карты =====================
// Разметка страниц: «## » — раздел, «= » — формула в рамке, «- » — пункт списка,
// «! » — примечание, пустая строка — отступ, остальное — обычный текст.
static const RefPage REF_PAGES[] = {
  { "Таблица умножения", "от 1×1 до 10×10", "@mult" },
  { "Алгебра", "степени, корни, уравнения",
    "## Формулы сокращённого умножения\n"
    "= (a + b)² = a² + 2ab + b²\n"
    "= (a − b)² = a² − 2ab + b²\n"
    "= a² − b² = (a − b)(a + b)\n"
    "= (a + b)³ = a³ + 3a²b + 3ab² + b³\n"
    "= a³ + b³ = (a + b)(a² − ab + b²)\n"
    "= a³ − b³ = (a − b)(a² + ab + b²)\n"
    "\n## Степени\n"
    "= aⁿ · aᵐ = aⁿ⁺ᵐ    aⁿ : aᵐ = aⁿ⁻ᵐ\n"
    "= (aⁿ)ᵐ = aⁿᵐ    (ab)ⁿ = aⁿbⁿ\n"
    "= a⁰ = 1    a⁻ⁿ = 1 / aⁿ\n"
    "\n## Корни\n"
    "= √(ab) = √a · √b,  a ≥ 0, b ≥ 0\n"
    "= √(a²) = |a|\n"
    "\n## Квадратное уравнение ax² + bx + c = 0\n"
    "= D = b² − 4ac\n"
    "= x = (−b ± √D) / 2a\n"
    "- D > 0 — два корня, D = 0 — один, D < 0 — действительных корней нет\n"
    "- Теорема Виета: x₁ + x₂ = −b/a,  x₁ · x₂ = c/a\n"
    "\n## Прогрессии\n"
    "= aₙ = a₁ + d(n − 1)\n"
    "= Sₙ = (a₁ + aₙ) · n / 2\n"
    "= bₙ = b₁ · qⁿ⁻¹\n"
    "= Sₙ = b₁(qⁿ − 1) / (q − 1),  q ≠ 1\n"
    "\n## Проценты\n"
    "- p% от числа a: a · p / 100\n"
    "- Число по его части: часть · 100 / p\n" },
  { "Геометрия", "площади, объёмы, окружность",
    "## Треугольник\n"
    "= S = ½ · a · h\n"
    "= S = ½ · a · b · sin C\n"
    "- Сумма углов треугольника — 180°\n"
    "- Теорема Пифагора: c² = a² + b², где c — гипотенуза\n"
    "= Формула Герона: S = √(p(p − a)(p − b)(p − c)),  p = (a + b + c) / 2\n"
    "\n## Четырёхугольники\n"
    "= Прямоугольник: S = a · b,  P = 2(a + b)\n"
    "= Квадрат: S = a²,  d = a√2\n"
    "= Параллелограмм: S = a · h\n"
    "= Ромб: S = d₁ · d₂ / 2\n"
    "= Трапеция: S = (a + b) / 2 · h\n"
    "\n## Окружность и круг\n"
    "= C = 2πr\n"
    "= S = πr²\n"
    "- π ≈ 3,14159\n"
    "\n## Объёмы тел\n"
    "= Куб: V = a³\n"
    "= Прямоугольный параллелепипед: V = abc\n"
    "= Цилиндр: V = πr²h\n"
    "= Конус: V = ⅓ πr²h\n"
    "= Шар: V = 4/3 · πr³,  S = 4πr²\n" },
  { "Тригонометрия", "значения и тождества",
    "## Значения\n"
    "- sin 0° = 0,   cos 0° = 1,   tg 0° = 0\n"
    "- sin 30° = 1/2,   cos 30° = √3/2,   tg 30° = √3/3\n"
    "- sin 45° = √2/2,   cos 45° = √2/2,   tg 45° = 1\n"
    "- sin 60° = √3/2,   cos 60° = 1/2,   tg 60° = √3\n"
    "- sin 90° = 1,   cos 90° = 0,   tg 90° не существует\n"
    "\n## Основные тождества\n"
    "= sin²α + cos²α = 1\n"
    "= tg α = sin α / cos α\n"
    "= 1 + tg²α = 1 / cos²α\n"
    "\n## Двойной угол\n"
    "= sin 2α = 2 sin α cos α\n"
    "= cos 2α = cos²α − sin²α\n"
    "\n## Теоремы для треугольника\n"
    "= a / sin A = b / sin B = c / sin C\n"
    "= c² = a² + b² − 2ab · cos C\n" },
  { "Физика", "основные формулы 7–9 класса",
    "## Движение\n"
    "= v = s / t\n"
    "= a = (v − v₀) / t\n"
    "= s = v₀t + at² / 2\n"
    "\n## Силы\n"
    "= F = ma  (второй закон Ньютона)\n"
    "= F = mg,   g ≈ 9,8 м/с²\n"
    "= Fупр = kΔx  (закон Гука)\n"
    "= Fтр = μN\n"
    "\n## Работа и энергия\n"
    "= A = F · s\n"
    "= N = A / t\n"
    "= Eк = mv² / 2\n"
    "= Eп = mgh\n"
    "\n## Давление и плотность\n"
    "= ρ = m / V\n"
    "= p = F / S\n"
    "= p = ρgh  (в жидкости)\n"
    "= Fа = ρжgVт  (сила Архимеда)\n"
    "\n## Электричество\n"
    "= I = U / R  (закон Ома)\n"
    "= R = ρl / S\n"
    "= P = UI\n"
    "= Q = I²Rt\n"
    "- Последовательно: R = R₁ + R₂;  параллельно: 1/R = 1/R₁ + 1/R₂\n"
    "\n## Теплота\n"
    "= Q = cm(t₂ − t₁)\n"
    "= Q = λm  (плавление),   Q = Lm  (парообразование)\n"
    "= Q = qm  (сгорание топлива)\n" },
  { "Химия", "первые 20 элементов",
    "## Элемент — символ — атомная масса\n"
    "- 1 Водород — H — 1\n- 2 Гелий — He — 4\n- 3 Литий — Li — 7\n- 4 Бериллий — Be — 9\n- 5 Бор — B — 11\n"
    "- 6 Углерод — C — 12\n- 7 Азот — N — 14\n- 8 Кислород — O — 16\n- 9 Фтор — F — 19\n- 10 Неон — Ne — 20\n"
    "- 11 Натрий — Na — 23\n- 12 Магний — Mg — 24\n- 13 Алюминий — Al — 27\n- 14 Кремний — Si — 28\n- 15 Фосфор — P — 31\n"
    "- 16 Сера — S — 32\n- 17 Хлор — Cl — 35,5\n- 18 Аргон — Ar — 40\n- 19 Калий — K — 39\n- 20 Кальций — Ca — 40\n"
    "\n## Полезные формулы\n"
    "= n = m / M  (количество вещества)\n"
    "= N = n · Nₐ,   Nₐ ≈ 6,02 · 10²³ моль⁻¹\n"
    "= V = n · Vₘ,   Vₘ = 22,4 л/моль  (газ при н. у.)\n"
    "= ω = m(вещества) / m(раствора) · 100%\n" },
  { "Русский язык", "короткие подсказки",
    "## Гласные после шипящих\n"
    "- ЖИ и ШИ пишутся с буквой И: жизнь, шишка\n"
    "- ЧА и ЩА — с буквой А, ЧУ и ЩУ — с буквой У: чаща, щука\n"
    "- ЧК, ЧН, НЩ, ЩН — без мягкого знака: точка, ночной\n"
    "\n## -ТСЯ или -ТЬСЯ\n"
    "- Задайте вопрос к глаголу. Что делает? — -тся: он учится\n"
    "- Что делать? — -ться: надо учиться\n"
    "\n## НЕ с глаголами\n"
    "- Пишется раздельно: не знаю, не пришёл\n"
    "- Слитно — если без НЕ слово не употребляется: ненавидеть, негодовать\n"
    "\n## Приставки ПРЕ- и ПРИ-\n"
    "- ПРИ — близость, присоединение, неполнота: приехать, пришить, приоткрыть\n"
    "- ПРЕ — «очень» или «пере-»: премудрый, преградить\n"
    "\n## Запятая перед союзами\n"
    "- Перед А и НО запятая ставится всегда: тихо, но тепло\n"
    "- Перед И — только если соединяются части сложного предложения\n"
    "! Это краткие подсказки. Полные правила и исключения — в учебнике.\n" },
  { "Единицы и приставки", "перевод единиц",
    "## Приставки СИ\n"
    "- гига (Г) — 10⁹,   мега (М) — 10⁶,   кило (к) — 10³\n"
    "- санти (с) — 10⁻²,   милли (м) — 10⁻³,   микро (мк) — 10⁻⁶\n"
    "\n## Длина и площадь\n"
    "- 1 км = 1000 м,   1 м = 100 см = 1000 мм\n"
    "- 1 м² = 10 000 см²,   1 га = 10 000 м²\n"
    "\n## Объём и масса\n"
    "- 1 л = 1 дм³ = 1000 см³,   1 м³ = 1000 л\n"
    "- 1 т = 1000 кг,   1 кг = 1000 г\n"
    "\n## Время и скорость\n"
    "- 1 ч = 60 мин = 3600 с\n"
    "= 1 м/с = 3,6 км/ч\n"
    "\n## Информация\n"
    "- 1 байт = 8 бит,   1 КБ = 1024 байта,   1 МБ = 1024 КБ\n" },
};
#define REF_N ((int)(sizeof(REF_PAGES) / sizeof(REF_PAGES[0])))

// ---------- Разбор текста в строки ----------
#define TXT_X 16
#define TXT_W 288
#define PAGE_TOP 60

void addWrapped(uint8_t kind, const AAFont& f, const std::string& t, int w, int lh) {
  for (auto& l : wrapText(f, t, w)) rLines.push_back({ kind, (int16_t)lh, l });
}

void parseMarkup(const std::string& body) {
  rLines.clear();
  size_t i = 0;
  while (i <= body.size()) {
    size_t j = body.find('\n', i);
    if (j == std::string::npos) j = body.size();
    std::string ln = body.substr(i, j - i);
    i = j + 1;
    if (ln == "@mult") { rLines.push_back({ L_MULT, 300, "" }); continue; }
    if (ln.empty()) { rLines.push_back({ L_SPACE, 10, "" }); continue; }
    if (ln.compare(0, 3, "## ") == 0) { rLines.push_back({ L_SPACE, 6, "" }); addWrapped(L_H2, F_SB, ln.substr(3), TXT_W, 24); continue; }
    if (ln.compare(0, 2, "# ") == 0) { addWrapped(L_H1, F_T, ln.substr(2), TXT_W, 28); continue; }
    if (ln.compare(0, 2, "= ") == 0) { auto w = wrapText(F_SB, ln.substr(2), TXT_W - 24); for (size_t k = 0; k < w.size(); k++) rLines.push_back({ L_FORMULA, (int16_t)(k + 1 == w.size() ? 34 : 22), w[k] }); continue; }
    if (ln.compare(0, 2, "- ") == 0) { auto w = wrapText(F_B, ln.substr(2), TXT_W - 16); for (size_t k = 0; k < w.size(); k++) rLines.push_back({ (uint8_t)(k ? L_TEXT : L_BULLET), 21, (k ? "\x01" : "") + w[k] }); continue; }
    if (ln.compare(0, 2, "! ") == 0) { rLines.push_back({ L_SPACE, 6, "" }); addWrapped(L_NOTE, F_X, ln.substr(2), TXT_W - 20, 17); continue; }
    addWrapped(L_TEXT, F_B, ln, TXT_W, 21);
  }
  rLines.push_back({ L_SPACE, 20, "" });
}

int linesHeight() { int h = 0; for (auto& l : rLines) h += l.h; return h; }

// ---------- HTML → текст (для своих сохранённых страниц) ----------
static const uint16_t CP1251_HI[64] = {
  0x0402, 0x0403, 0x201A, 0x0453, 0x201E, 0x2026, 0x2020, 0x2021, 0x20AC, 0x2030, 0x0409, 0x2039, 0x040A, 0x040C, 0x040B, 0x040F,
  0x0452, 0x2018, 0x2019, 0x201C, 0x201D, 0x2022, 0x2013, 0x2014, 0x0020, 0x2122, 0x0459, 0x203A, 0x045A, 0x045C, 0x045B, 0x045F,
  0x00A0, 0x040E, 0x045E, 0x0408, 0x00A4, 0x0490, 0x00A6, 0x00A7, 0x0401, 0x00A9, 0x0404, 0x00AB, 0x00AC, 0x00AD, 0x00AE, 0x0407,
  0x00B0, 0x00B1, 0x0406, 0x0456, 0x0491, 0x00B5, 0x00B6, 0x00B7, 0x0451, 0x2116, 0x0454, 0x00BB, 0x0458, 0x0405, 0x0455, 0x0457,
};
bool validUtf8(const std::string& s) {
  size_t i = 0, bad = 0, multi = 0;
  while (i < s.size()) {
    unsigned char c = s[i];
    if (c < 0x80) { i++; continue; }
    int n = c >= 0xF0 ? 3 : c >= 0xE0 ? 2 : c >= 0xC0 ? 1 : -1;
    if (n < 0 || i + n >= s.size() + (n ? 0 : 1)) { bad++; i++; continue; }
    bool ok = true;
    for (int k = 1; k <= n; k++) if (i + k >= s.size() || ((unsigned char)s[i + k] & 0xC0) != 0x80) ok = false;
    if (ok) { multi++; i += n + 1; } else { bad++; i++; }
  }
  return bad * 20 <= multi + 1;
}
std::string fromCp1251(const std::string& s) {
  std::string r;
  for (unsigned char c : s) {
    if (c < 0x80) r += (char)c;
    else if (c >= 0xC0) putUtf8(r, 0x410 + (c - 0xC0));
    else putUtf8(r, CP1251_HI[c - 0x80]);
  }
  return r;
}
std::string lowerAscii(std::string s) { for (auto& c : s) if (c >= 'A' && c <= 'Z') c += 32; return s; }

std::string htmlToMarkup(const std::string& h) {
  std::string out, cur;
  auto flush = [&](const char* prefix) {
    size_t a = cur.find_first_not_of(' ');
    if (a != std::string::npos) { size_t b = cur.find_last_not_of(' '); out += prefix; out += cur.substr(a, b - a + 1); out += '\n'; }
    cur.clear();
  };
  const char* pending = "";
  size_t i = 0;
  while (i < h.size()) {
    char c = h[i];
    if (c == '<') {
      size_t e = h.find('>', i);
      if (e == std::string::npos) break;
      std::string tag = lowerAscii(h.substr(i + 1, e - i - 1));
      bool close = !tag.empty() && tag[0] == '/';
      std::string name = tag.substr(close ? 1 : 0);
      size_t sp = name.find_first_of(" \t\r\n/");
      if (sp != std::string::npos) name = name.substr(0, sp);
      if (!close && (name == "script" || name == "style" || name == "head" || name == "noscript")) {
        size_t end = lowerAscii(h.substr(e)).find("</" + name);
        i = end == std::string::npos ? h.size() : e + end;
        continue;
      }
      if (name == "h1" || name == "h2" || name == "h3" || name == "h4") { flush(pending); pending = close ? "" : "## "; }
      else if (name == "li") { flush(pending); pending = close ? "" : "- "; }
      else if (name == "p" || name == "div" || name == "br" || name == "tr" || name == "table" || name == "ul" || name == "ol" || name == "section" || name == "article") { flush(pending); pending = ""; }
      else if (name == "td" || name == "th") cur += "  ";
      i = e + 1;
      continue;
    }
    if (c == '&') {
      size_t e = h.find(';', i);
      if (e != std::string::npos && e - i < 10) {
        std::string ent = h.substr(i + 1, e - i - 1);
        uint32_t cp = 0;
        if (ent == "nbsp") cp = ' '; else if (ent == "amp") cp = '&'; else if (ent == "lt") cp = '<'; else if (ent == "gt") cp = '>';
        else if (ent == "quot") cp = '"'; else if (ent == "laquo") cp = 0xAB; else if (ent == "raquo") cp = 0xBB;
        else if (ent == "mdash") cp = 0x2014; else if (ent == "ndash") cp = 0x2013; else if (ent == "hellip") cp = 0x2026;
        else if (ent == "times") cp = 0xD7; else if (ent == "minus") cp = 0x2212; else if (ent == "deg") cp = 0xB0;
        else if (!ent.empty() && ent[0] == '#') cp = (uint32_t)strtoul(ent.c_str() + (ent.size() > 1 && (ent[1] == 'x' || ent[1] == 'X') ? 2 : 1), nullptr, (ent.size() > 1 && (ent[1] == 'x' || ent[1] == 'X')) ? 16 : 10);
        if (cp) { putUtf8(cur, cp); i = e + 1; continue; }
      }
    }
    if (c == '\n' || c == '\r' || c == '\t') c = ' ';
    if (c == ' ' && !cur.empty() && cur.back() == ' ') { i++; continue; }
    cur += c;
    i++;
  }
  flush(pending);
  return out;
}

// ---------- SD-карта ----------
void refBack();
bool sdList(const std::string& dir, std::vector<FileEnt>& out);
std::string sdReadFile(const std::string& path, size_t maxBytes);
bool sdReadBytes(const std::string& path, std::vector<uint8_t>& buf, size_t maxBytes);
bool sdFormat();                      // FAT32 (только если карта не читается)
void* jpgFileOpen(const char* name, int32_t* size);  // чтение JPEG прямо с карты
void jpgFileClose(void* h);
int32_t jpgFileRead(JPEGFILE* f, uint8_t* buf, int32_t len);
int32_t jpgFileSeek(JPEGFILE* f, int32_t pos);
void sdForgetFail();                  // следующая попытка открыть карту — сразу, без паузы
bool sdFormatArmed = false;
std::string sdMsg;

int kindOf(const FileEnt& e) {  // 0 — папка, 1 — текст, 2 — HTML, 3 — картинка JPEG, 4 — PNG, −1 — прочее
  if (e.dir) return 0;
  std::string n = lowerAscii(e.name);
  auto ends = [&](const char* x) { size_t l = strlen(x); return n.size() >= l && n.compare(n.size() - l, l, x) == 0; };
  if (ends(".txt") || ends(".md")) return 1;
  if (ends(".htm") || ends(".html")) return 2;
  if (ends(".jpg") || ends(".jpeg")) return 3;
  if (ends(".png")) return 4;
  return -1;
}

void filesLoad(const std::string& dir) {
  fEnts.clear();
  std::vector<FileEnt> all;
  fSdOk = sdList(dir, all);
  for (auto& e : all) if (!e.name.empty() && e.name[0] != '.' && e.name != "System Volume Information" && kindOf(e) >= 0) fEnts.push_back(e);
  std::sort(fEnts.begin(), fEnts.end(), [](const FileEnt& a, const FileEnt& b) { if (a.dir != b.dir) return a.dir; return lowerAscii(a.name) < lowerAscii(b.name); });
  fDir = dir;
  scrollY = 0;
}

std::string fmtBytes(uint32_t b) {
  char buf[24];
  if (b < 1024) snprintf(buf, sizeof buf, "%u Б", (unsigned)b);
  else if (b < 1048576) snprintf(buf, sizeof buf, "%.1f КБ", b / 1024.0);
  else snprintf(buf, sizeof buf, "%.1f МБ", b / 1048576.0);
  std::string s = buf;
  for (auto& c : s) if (c == '.') c = ',';
  return s;
}

int jpegToBuf(JPEGDRAW* d) {
  int bw = d->iWidthUsed > 0 ? d->iWidthUsed : d->iWidth;
  for (int yy = 0; yy < d->iHeight; yy++) {
    int Y = d->y + yy;
    if (Y >= gJ.h) break;
    for (int xx = 0; xx < bw; xx++) { int X = d->x + xx; if (X < gJ.w) gJ.px[Y * gJ.w + X] = d->pPixels[yy * d->iWidth + xx]; }
  }
  return 1;
}

// Картинка на всю ширину экрана: декодируем с уменьшением, затем сглаженно ужимаем до 320 px
bool openImage(const std::string& path, std::string& err) {
  free(imgPx); imgPx = nullptr; imgW = imgH = 0;
  JPEGDEC* j = new JPEGDEC();
  bool ok = false;
  if (j->open(path.c_str(), jpgFileOpen, jpgFileClose, jpgFileRead, jpgFileSeek, jpegToBuf)) {  // большие фото с телефона не влезут в память целиком
    int orient = j->getOrientation();
    int W = j->getWidth(), H = j->getHeight(), s = 1;
    while (s < 8 && (W / (s * 2) >= SCREEN_W || (long)(W / s) * (H / s) > 700000L)) s *= 2;
    int w = W / s, h = H / s;
    uint16_t* tmp = w > 0 && h > 0 ? (uint16_t*)calloc((size_t)w * h, 2) : nullptr;
    if (tmp) {
      gJ.px = tmp; gJ.w = w; gJ.h = h;
      j->setPixelType(RGB565_LITTLE_ENDIAN);
      if (j->decode(0, 0, s == 2 ? JPEG_SCALE_HALF : s == 4 ? JPEG_SCALE_QUARTER : s == 8 ? JPEG_SCALE_EIGHTH : 0)) {
        if (orient == 3 || orient == 6 || orient == 8) {  // фото снято боком: поворачиваем по метке EXIF
          uint16_t* rot = (uint16_t*)malloc((size_t)w * h * 2);
          if (rot) {
            int nw = orient == 3 ? w : h, nh = orient == 3 ? h : w;
            for (int y = 0; y < h; y++)
              for (int x = 0; x < w; x++) {
                int nx, ny;
                if (orient == 3) { nx = w - 1 - x; ny = h - 1 - y; }
                else if (orient == 6) { nx = h - 1 - y; ny = x; }
                else { nx = y; ny = w - 1 - x; }
                rot[ny * nw + nx] = tmp[y * w + x];
              }
            free(tmp);
            tmp = rot; w = nw; h = nh;
          }
        }
        int ow = std::min(w, (int)SCREEN_W), oh = (int)((long)h * ow / w);
        imgPx = (uint16_t*)malloc((size_t)ow * oh * 2);
        if (imgPx) {
          float k = (float)w / ow;
          for (int y = 0; y < oh; y++)
            for (int x = 0; x < ow; x++) {
              int x0 = (int)(x * k), x1 = std::max(x0 + 1, (int)((x + 1) * k)), y0 = (int)(y * k), y1 = std::max(y0 + 1, (int)((y + 1) * k));
              uint32_t R = 0, G = 0, B = 0, n = 0;
              for (int yy = y0; yy < y1 && yy < h; yy++)
                for (int xx = x0; xx < x1 && xx < w; xx++) { uint16_t c = tmp[yy * w + xx]; R += c >> 11; G += (c >> 5) & 63; B += c & 31; n++; }
              imgPx[y * ow + x] = n ? (uint16_t)(((R / n) << 11) | ((G / n) << 5) | (B / n)) : 0;
            }
          imgW = ow; imgH = oh; ok = true;
        } else err = "Картинка слишком большая";
      } else err = "Этот JPEG не поддерживается (возможно, прогрессивный). Пересохраните картинку как обычный JPEG.";
      free(tmp);
    } else err = "Картинка слишком большая";
    j->close();
  } else err = "Файл не читается как JPEG. Если это скриншот, он, скорее всего, в формате PNG — сохраните его как JPG.";
  delete j;
  return ok;
}

// ---------- Экран ----------
void drawSegTop(Surface& s, int o) {
  int w = 140;
  rrectX(s, 16, o + 12, w * 2 + 8, 34, 17, C_PANEL, C_PANEL, 255, 255, C_BORDER, 255);
  bool files = rScr == R_FILES;
  rr(s, files ? 20 + w + 4 : 20, o + 15, w, 28, 14, C_EQ, 255);
  textC(s, F_SB, 20 + w / 2, capBase(F_SB, o + 15, 28), "Справочник", files ? C_DIM : C_WHITE);
  textC(s, F_SB, 24 + w + w / 2, capBase(F_SB, o + 15, 28), "Мои файлы", files ? C_WHITE : C_DIM);
}

#define ROW_H 58
void drawRefList(Surface& s, int top) {
  int o = -top;
  for (int i = 0; i < REF_N; i++) {
    int y = o + PAGE_TOP + i * ROW_H - scrollY;
    if (y + ROW_H < 0 || y > s.h) continue;
    rrectX(s, 16, y, 288, ROW_H - 8, 14, C_PANEL, C_PANEL, 255, 255, C_BORDER, 255);
    rr(s, 26, y + 9, 32, 32, 10, C_EQ, 120);
    char num[4];
    snprintf(num, sizeof num, "%d", i + 1);
    textC(s, F_SB, 42, capBase(F_SB, y + 9, 32), num, C_ACCENT);
    drawText(s, F_SB, 70, y + 22, REF_PAGES[i].title, C_WHITE);
    drawText(s, F_X, 70, y + 39, REF_PAGES[i].sub, C_DIM);
    iconChevronR(s, 290, y + 25, 5, C_DIM);
  }
}

void drawMultTable(Surface& s, int y0) {
  int cell = 28, x0 = 13;
  for (int r = 0; r <= 10; r++)
    for (int c = 0; c <= 10; c++) {
      int x = x0 + c * cell, y = y0 + r * cell;
      if (y + cell < 0 || y > s.h) continue;
      bool head = r == 0 || c == 0;
      if (r == 0 && c == 0) { textC(s, F_X, x + cell / 2, capBase(F_X, y, cell), "×", C_ACCENT); continue; }
      int v = head ? (r == 0 ? c : r) : r * c;
      uint16_t bg = head ? mix565(C_PANEL, C_EQ, 120) : (r == c ? mix565(C_PANEL, C_EQ, 50) : ((r + c) % 2 ? C_PANEL : MK565(30, 31, 38)));
      rr(s, x + 1, y + 1, cell - 2, cell - 2, 5, bg, 255);
      textC(s, head ? F_SB : F_X, x + cell / 2, capBase(head ? F_SB : F_X, y, cell), std::to_string(v), head ? C_WHITE : C_DIGIT);
    }
}

void drawLines(Surface& s, int top, int y) {
  for (auto& l : rLines) {
    int yy = y;
    y += l.h;
    if (yy > s.h || yy + l.h < -30) continue;
    switch (l.kind) {
      case L_H1: drawText(s, F_T, TXT_X, yy + 21, l.text.c_str(), C_WHITE); break;
      case L_H2: drawText(s, F_SB, TXT_X, yy + 17, l.text.c_str(), C_ACCENT); break;
      case L_FORMULA:
        rrectX(s, TXT_X, yy, TXT_W, l.h - 4, 10, mix565(C_PANEL, C_EQ, 40), mix565(C_PANEL, C_EQ, 40), 255, 255, C_PANEL_BORDER, 200);
        drawText(s, F_SB, TXT_X + 12, yy + 19, l.text.c_str(), C_WHITE);
        break;
      case L_BULLET:
        discA(s, TXT_X + 4, yy + 11, 2.5f, C_ACCENT, 255);
        drawText(s, F_B, TXT_X + 14, yy + 15, l.text.c_str(), C_DIGIT);
        break;
      case L_NOTE: drawText(s, F_X, TXT_X + 4, yy + 12, l.text.c_str(), C_DIM); break;
      case L_MULT: drawMultTable(s, yy); break;
      case L_TEXT: {
        bool cont = !l.text.empty() && l.text[0] == '\x01';
        drawText(s, F_B, TXT_X + (cont ? 14 : 0), yy + 15, l.text.c_str() + (cont ? 1 : 0), C_DIGIT);
        break;
      }
      default: break;
    }
  }
  (void)top;
}

void drawFiles(Surface& s, int top) {
  int o = -top;
  int y0 = o + PAGE_TOP - scrollY;
  int x = 16;
  if (fDir != "/") {
    rrectX(s, 16, y0, 288, 40, 12, C_KEY, C_KEY, 255, 255, C_BORDER, 255);
    iconChevronL(s, 32, y0 + 20, 5, C_ACCENT);
    drawText(s, F_SB, 44, y0 + 25, ellipsize(F_SB, fDir, 240).c_str(), C_ACCENT);
    y0 += 48;
  }
  if (!fSdOk) {
    rrectX(s, 16, y0, 288, 248, 16, C_PANEL, C_PANEL, 255, 255, C_BORDER, 255);
    textC(s, F_SB, 160, y0 + 30, "Карта не читается", C_WHITE);
    std::string hint = sdMsg.empty() ? "Плата понимает только карты в формате FAT32. Карты на 64 ГБ и больше (SDXC) продаются в формате exFAT — их нужно переформатировать. Ещё проверьте, что карта вставлена до щелчка." : sdMsg;
    auto w = wrapText(F_X, hint, 260);
    for (size_t k = 0; k < w.size() && k < 7; k++) textC(s, F_X, 160, y0 + 54 + 16 * (int)k, w[k], C_DIM);
    rrectX(s, 30, y0 + 120 + 52, 260, 40, 12, sdFormatArmed ? MK565(90, 20, 36) : C_KEY, sdFormatArmed ? MK565(90, 20, 36) : C_KEY, 255, 255, sdFormatArmed ? C_CLEAR : C_BORDER, 255);
    textC(s, F_SB, 160, capBase(F_SB, y0 + 172, 40), sdFormatArmed ? "Точно? Все файлы удалятся" : "Отформатировать в FAT32", sdFormatArmed ? C_CLEAR : C_ACCENT);
    textC(s, F_X, 160, y0 + 228, "или нажмите сюда, чтобы проверить ещё раз", C_DIM);
    return;
  }
  if (fEnts.empty()) {
    rrectX(s, 16, y0, 288, 150, 16, C_PANEL, C_PANEL, 255, 255, C_BORDER, 255);
    textC(s, F_SB, 160, y0 + 34, "Здесь нет подходящих файлов", C_WHITE);
    const char* hint = "Положите на карту свои файлы TXT, HTML или картинки JPG и PNG — например, сохранённые страницы, конспекты или фото задач. Нажмите сюда, чтобы обновить список.";
    auto w = wrapText(F_X, hint, 260);
    for (size_t k = 0; k < w.size(); k++) textC(s, F_X, 160, y0 + 62 + 16 * (int)k, w[k], C_DIM);
    return;
  }
  for (size_t i = 0; i < fEnts.size(); i++) {
    int y = y0 + (int)i * 52;
    if (y + 52 < 0 || y > s.h) continue;
    const FileEnt& e = fEnts[i];
    rrectX(s, x, y, 288, 46, 12, C_PANEL, C_PANEL, 255, 255, C_BORDER, 255);
    int k = kindOf(e);
    uint16_t ic = k == 0 ? C_GOLD : k >= 3 ? MK565(110, 200, 255) : C_ACCENT;
    if (k == 0) iconFolder(s, 36, y + 23, ic); else if (k >= 3) iconImage(s, 36, y + 23, ic); else iconDoc(s, 36, y + 23, ic);
    drawText(s, F_SB, 58, y + 21, ellipsize(F_SB, e.name, 230).c_str(), C_WHITE);
    drawText(s, F_X, 58, y + 37, e.dir ? "папка" : (fmtBytes(e.size) + (k == 2 ? " · страница" : k >= 3 ? " · картинка" : " · текст")).c_str(), C_DIM);
  }
}

void drawRef(Surface& s, int top) {
  int o = -top;
  if (rScr == R_LIST || rScr == R_FILES) {
    s.cy0 = std::max(0, PAGE_TOP - 4 - top);
    if (rScr == R_LIST) drawRefList(s, top); else drawFiles(s, top);
    s.cy0 = 0;
    if (top < PAGE_TOP) { fillRectS(s, 0, o, SCREEN_W, PAGE_TOP - 4, C_BG); drawSegTop(s, o); }
    return;
  }
  // страница справочника, текст, картинка или HTML
  s.cy0 = std::max(0, 56 - top);
  if (rScr == R_HTML) {
    hv::Surface hs;
    hs.px = s.px; hs.w = s.w; hs.h = s.h;
    hs.cx0 = 0; hs.cx1 = s.w; hs.cy0 = s.cy0; hs.cy1 = s.h;
    if (hs.cy0 < hs.cy1) hv::drawStrip(hs, top - 56 + scrollY);
  } else if (rScr == R_IMAGE) {
    int y = o + 60 - scrollY;
    if (imgPx)
      for (int py = std::max(s.cy0, y); py < std::min(s.h, y + imgH); py++)
        memcpy(s.px + py * s.w + (SCREEN_W - imgW) / 2, imgPx + (py - y) * imgW, imgW * 2);
  } else drawLines(s, top, o + PAGE_TOP - scrollY);
  s.cy0 = 0;
  if (top < 56) {
    fillRectS(s, 0, o, SCREEN_W, 56, C_BG);
    drawHeader(s, o, rScr == R_PAGE || (rScr == R_HTML && !hv::history.empty()) ? "Назад" : "Файлы", "");
    textC(s, F_SB, 186, capBase(F_SB, o + 12, 32), ellipsize(F_SB, rTitle, 200), C_WHITE);
    fillRectS(s, 0, o + 55, SCREEN_W, 1, C_BORDER);
  }
  // полоса прокрутки
  if (scrollMax > 0) {
    int vh = TAB_Y - 60, bh = std::max(30, vh * vh / (vh + scrollMax)), by = 60 + (vh - bh) * scrollY / scrollMax;
    rr(s, SCREEN_W - 5, o + by, 3, bh, 1.5f, rScr == R_HTML && hv::doc.bg > 0x8410 ? MK565(120, 120, 130) : C_DIM, 140);
  }
}

void refSetScrollMax() {
  int vh = TAB_Y - PAGE_TOP;
  int h = 0;
  if (rScr == R_LIST) h = REF_N * ROW_H;
  else if (rScr == R_FILES) h = (fDir != "/" ? 48 : 0) + std::max(160, (int)fEnts.size() * 52);
  else if (rScr == R_IMAGE) h = imgH + 20;
  else if (rScr == R_HTML) { h = hv::doc.height; vh = TAB_Y - 56; }
  else h = linesHeight();
  scrollMax = std::max(0, h - vh);
  scrollY = std::max(0, std::min(scrollY, scrollMax));
}

// HTML и PNG открывает движок страниц (стили, картинки, ссылки)
void htmlSync() {  // после перехода по ссылке: заголовок и прокрутка из движка
  rTitle = hv::doc.title.empty() ? hv::fileName(hv::curUrl) : hv::doc.title;
  if (hv::curUrl.compare(0, 4, "dir:") == 0 && hv::doc.title.empty()) rTitle = hv::curUrl.substr(4);
  scrollY = hv::scrollY;
  refSetScrollMax();
  hv::scrollY = scrollY;
}
void openHtmlFile(const std::string& path) {
  if (!hv::init()) { parseMarkup("## Не хватило памяти\nЗакройте другие файлы и попробуйте ещё раз."); rTitle = "Ошибка"; rScr = R_TEXT; scrollY = 0; return; }
  hv::openFile(path);
  rScr = R_HTML;
  htmlSync();
}

void openTextFile(const FileEnt& e) {
  std::string path = (fDir == "/" ? "/" : fDir + "/") + e.name;
  std::string t = sdReadFile(path, 400000);
  if (!validUtf8(t)) t = fromCp1251(t);
  if (kindOf(e) == 2) t = htmlToMarkup(t);
  else {  // в обычном тексте не путаем строки с разметкой
    std::string r;
    size_t i = 0;
    while (i <= t.size()) {
      size_t j = t.find('\n', i);
      if (j == std::string::npos) j = t.size();
      std::string ln = t.substr(i, j - i);
      if (!ln.empty() && ln.back() == '\r') ln.pop_back();
      if (ln.size() >= 2 && (ln[0] == '#' || ln[0] == '=' || ln[0] == '-' || ln[0] == '!') && ln[1] == ' ') ln = " " + ln;
      r += ln + "\n";
      i = j + 1;
    }
    t = r;
  }
  if (kindOf(e) == 2 && t.size() < 80 && sdReadFile(path, 200000).find("<script") != std::string::npos)
    t = "## Это страница-программа\nВ файле почти нет текста: это игра или приложение на JavaScript (например, «Своя игра»). Плата показывает только текст и картинки, программы на ней не запускаются.\n- Откройте файл на телефоне или компьютере в браузере.\n- Чтобы видеть его и на плате, откройте файл в приложении ESP32 Flasher → «Экран на плату».";
  if (t.size() < 2) t = "! Файл пустой.";
  rTitle = e.name;
  parseMarkup(t);
  rScr = R_TEXT;
  scrollY = 0;
}

void refTap(int x, int y) {
  if (rScr == R_LIST || rScr == R_FILES) {
    if (y < PAGE_TOP) {
      if (y >= 10 && y < 50 && x >= 16 && x < 304) {
        uint8_t want = x < 160 ? R_LIST : R_FILES;
        if (want != rScr) { rScr = want; scrollY = 0; if (want == R_FILES) { sdForgetFail(); filesLoad(fDir); } }
      }
      return;
    }
    int cy = y - PAGE_TOP + scrollY;
    if (rScr == R_LIST) {
      int i = cy / ROW_H;
      if (i >= 0 && i < REF_N && cy % ROW_H < ROW_H - 8) {
        rPage = i;
        rTitle = REF_PAGES[i].title;
        parseMarkup(REF_PAGES[i].body);
        listScrollSave = scrollY;
        rScr = R_PAGE;
        scrollY = 0;
      }
      return;
    }
    if (fDir != "/") {
      if (cy < 44) { size_t sl = fDir.rfind('/'); filesLoad(sl == 0 ? "/" : fDir.substr(0, sl)); return; }
      cy -= 48;
    }
    if (!fSdOk) {
      if (cy >= 172 && cy < 212 && x >= 30 && x < 290) {  // кнопка форматирования: два нажатия
        if (!sdFormatArmed) { sdFormatArmed = true; return; }
        sdFormatArmed = false;
        sdMsg = sdFormat() ? "" : "Не получилось: плата не видит карту. Вставьте её до щелчка или отформатируйте в FAT32 на компьютере.";
        filesLoad("/");
        return;
      }
      sdFormatArmed = false;
      sdForgetFail();
      filesLoad(fDir);
      return;
    }
    if (fEnts.empty()) { sdForgetFail(); filesLoad(fDir); return; }
    int i = cy / 52;
    if (i < 0 || i >= (int)fEnts.size() || cy % 52 >= 46) return;
    const FileEnt& e = fEnts[i];
    int k = kindOf(e);
    listScrollSave = scrollY;
    if (k == 0) { filesLoad((fDir == "/" ? "/" : fDir + "/") + e.name); return; }
    if (k == 3) {
      std::string err;
      rTitle = e.name;
      if (openImage((fDir == "/" ? "/" : fDir + "/") + e.name, err)) { rScr = R_IMAGE; scrollY = 0; }
      else { parseMarkup("## Картинка не открылась\n" + err); rScr = R_TEXT; scrollY = 0; }
      return;
    }
    if (k == 2 || k == 4) { openHtmlFile((fDir == "/" ? "/" : fDir + "/") + e.name); return; }
    openTextFile(e);
    return;
  }
  if (y < 56 && x < 110) { refBack(); return; }
  if (rScr == R_HTML && y >= 56) {
    hv::scrollY = scrollY;
    if (hv::tapAt(x, y - 56 + scrollY)) htmlSync();
  }
}

void refBack() {
  if (rScr == R_PAGE) { rScr = R_LIST; scrollY = listScrollSave; }
  else if (rScr == R_HTML) {
    if (hv::goBack()) { htmlSync(); return; }
    hv::close();
    rScr = R_FILES; scrollY = listScrollSave;
  }
  else if (rScr == R_TEXT || rScr == R_IMAGE) { free(imgPx); imgPx = nullptr; rScr = R_FILES; scrollY = listScrollSave; rLines.clear(); }
}

// ===================== Настройки =====================
void boardInfo(std::vector<std::string>& keys, std::vector<std::string>& vals);
void resetAllSettings();
void wifiEnable(bool on);

#define SET_TOP 64
// Верх каждой панели в координатах содержимого (до прокрутки)
#define SP_BRIGHT 0
#define SP_DIM 96
#define SP_THEME 192
#define SP_SOUND 298
#define SP_FLIP 362
#define SP_WIFI 426
#define SP_INFO 558
#define SP_RESET 750
#define SET_TOTAL 810
#define SL_X 30
#define SL_W 260

static const char* const DIM_NAMES[4] = { "Никогда", "30 с", "1 мин", "5 мин" };

void drawToggle(Surface& s, float x, float y, bool on) {
  rrectX(s, x, y, 50, 30, 15, on ? C_EQ : C_KEY, on ? C_EQ : C_KEY, 255, 255, on ? C_EQ : C_BORDER, 255);
  discA(s, on ? x + 35 : x + 15, y + 15, 11, on ? C_WHITE : C_DIM, 255);
}

void drawSettings(Surface& s, int top) {
  int o = -top;
  s.cy0 = std::max(0, SET_TOP - 4 - top);
  int y0 = o + SET_TOP - scrollY;
  char b[32];
  // яркость
  int y = y0 + SP_BRIGHT;
  panel(s, 16, y, 288, 86, 16);
  drawText(s, F_SB, 30, y + 28, "Яркость экрана", C_WHITE);
  snprintf(b, sizeof b, "%d%%", setBright);
  textR(s, F_SB, 290, y + 28, b, C_ACCENT);
  float k = (setBright - 5) / 95.0f;
  rr(s, SL_X, y + 54, SL_W, 8, 4, C_KEY, 255);
  rrectX(s, SL_X, y + 54, SL_W * k + 4, 8, 4, C_EQ, C_EQ, 255, 255, 0, 0);
  discA(s, SL_X + SL_W * k, y + 58, 12, C_WHITE, 255);
  // затемнение
  y = y0 + SP_DIM;
  panel(s, 16, y, 288, 86, 16);
  drawText(s, F_SB, 30, y + 28, "Затемнять при простое", C_WHITE);
  for (int i = 0; i < 4; i++) {
    int sx = 28 + i * 66;
    bool on = i == setDim;
    rrectX(s, sx, y + 42, 60, 30, 15, on ? C_EQ : C_KEY, on ? C_EQ : C_KEY, 255, 255, on ? C_EQ : C_BORDER, 255);
    textC(s, F_X, sx + 30, capBase(F_X, y + 42, 30), DIM_NAMES[i], on ? C_WHITE : C_DIM);
  }
  // тема
  y = y0 + SP_THEME;
  panel(s, 16, y, 288, 96, 16);
  drawText(s, F_SB, 30, y + 28, "Цвет оформления", C_WHITE);
  textR(s, F_X, 290, y + 28, THEME_NAMES[setTheme], C_DIM);
  for (int i = 0; i < 6; i++) {
    float cx = 46 + i * 46, cy = y + 64;
    uint16_t c = MK565(THEMES[i][0], THEMES[i][1], THEMES[i][2]);
    if (i == setTheme) ringS(s, cx, cy, 19, 2.5f, C_WHITE);
    discA(s, cx, cy, 14, c, 255);
  }
  // звук
  y = y0 + SP_SOUND;
  panel(s, 16, y, 288, 56, 16);
  drawText(s, F_SB, 30, y + 24, "Щелчок при нажатии", C_WHITE);
  drawText(s, F_X, 30, y + 41, "звук через динамик платы", C_DIM);
  drawToggle(s, 240, y + 13, setSound);
  // поворот
  y = y0 + SP_FLIP;
  panel(s, 16, y, 288, 56, 16);
  drawText(s, F_SB, 30, y + 24, "Перевернуть экран", C_WHITE);
  drawText(s, F_X, 30, y + 41, "если разъём USB мешает снизу", C_DIM);
  drawToggle(s, 240, y + 13, setFlip);
  // Wi-Fi
  y = y0 + SP_WIFI;
  panel(s, 16, y, 288, 120, 16);
  drawText(s, F_SB, 30, y + 24, "Wi-Fi: экран телефона", C_WHITE);
  drawToggle(s, 240, y + 11, wifiOn);
  {
    std::string t = wifiOn ? wifiInfo : "Включите, чтобы показывать на плате страницы из приложения ESP32 Flasher.";
    auto w = wrapText(F_X, t, 256);
    for (size_t i = 0; i < w.size() && i < 5; i++) drawText(s, F_X, 30, y + 48 + 15 * (int)i, w[i].c_str(), wifiOn ? C_DIGIT : C_DIM);
  }
  // о плате
  y = y0 + SP_INFO;
  static std::vector<std::string> ks2, vs;
  static uint32_t infoT = 0;
  if (ks2.empty() || nowMs() - infoT > 500) { ks2.clear(); vs.clear(); boardInfo(ks2, vs); infoT = nowMs(); }
  panel(s, 16, y, 288, 30 + 20 * (int)ks2.size() + 10, 16);
  drawText(s, F_SB, 30, y + 26, "О плате", C_WHITE);
  for (size_t i = 0; i < ks2.size(); i++) {
    drawText(s, F_X, 30, y + 50 + 20 * (int)i, ks2[i].c_str(), C_DIM);
    textR(s, F_X, 290, y + 50 + 20 * (int)i, vs[i], C_DIGIT);
  }
  // сброс
  y = y0 + SP_RESET;
  rrectX(s, 16, y, 288, 44, 14, setArmReset ? MK565(90, 20, 36) : C_KEY, setArmReset ? MK565(90, 20, 36) : C_KEY, 255, 255, C_CLEAR, 255);
  textC(s, F_SB, 160, capBase(F_SB, y, 44), setArmReset ? "Нажмите ещё раз, чтобы сбросить" : "Сбросить настройки", C_CLEAR);
  s.cy0 = 0;
  if (top < SET_TOP) {
    fillRectS(s, 0, o, SCREEN_W, SET_TOP - 4, C_BG);
    drawText(s, F_H, 16, o + 46, "Настройки", C_WHITE);
  }
}

void setScrollMax() { scrollMax = std::max(0, SET_TOTAL - (TAB_Y - SET_TOP)); scrollY = std::max(0, std::min(scrollY, scrollMax)); }

bool sliderHit(int x, int y) {
  int sy = SET_TOP - scrollY + SP_BRIGHT + 58;
  return y >= sy - 26 && y < sy + 26 && x >= SL_X - 16 && x < SL_X + SL_W + 16 && y >= SET_TOP;
}
void sliderSet(int x) {
  int v = 5 + (int)roundf(clamp01((x - SL_X) / (float)SL_W) * 95);
  if (v != setBright) { setBright = v; applyBacklight(); }
}

void settingsTap(int x, int y) {
  if (y < SET_TOP) return;
  int cy = y - SET_TOP + scrollY;
  bool armed = setArmReset;
  setArmReset = false;
  if (cy >= SP_DIM + 42 && cy < SP_DIM + 72 && x >= 28 && x < 292) { setDim = std::min(3, (x - 28) / 66); saveSettings(); return; }
  if (cy >= SP_THEME + 44 && cy < SP_THEME + 86) {
    int i = (x - 24) / 46;
    if (i >= 0 && i < 6) { setTheme = i; applyTheme(i); saveSettings(); }
    return;
  }
  if (cy >= SP_SOUND && cy < SP_SOUND + 56) { setSound = !setSound; saveSettings(); beepClick(); return; }
  if (cy >= SP_FLIP && cy < SP_FLIP + 56) { setFlip = !setFlip; saveSettings(); return; }
  if (cy >= SP_WIFI && cy < SP_WIFI + 120) { wifiEnable(!wifiOn); return; }
  if (cy >= SP_RESET && cy < SP_RESET + 44) {
    if (armed) resetAllSettings();
    else setArmReset = true;
  }
}

// ===================== Экран телефона на плате =====================
// Приложение ESP32 Flasher присылает снимок (JPEG) по Wi-Fi: страницу из своего браузера
// (режим «Экран на плату») или весь экран телефона (режим «Управление телефоном»).
// Плата показывает его на весь экран, а касания, свайпы и кнопки отправляет обратно:
// приложение забирает их запросом /__events и повторяет на телефоне.
#define CAST_TOP 44
#define CAST_BOT SCREEN_H
#define CAST_VH (CAST_BOT - CAST_TOP)
#define CAST_BTN_X0 176          // три кнопки в заголовке: 176..320, по 48 px
void wifiEnable(bool on);
bool castLinked() { return castPollT && nowMs() - castPollT < 3000; }

float castFit();
int castPanMax();
int castScrollMax();

bool castDecode(const uint8_t* data, size_t len) {
  JPEGDEC* j = new JPEGDEC();
  bool ok = false;
  int oldW = castW, oldH = castH;
  if (j->openRAM((uint8_t*)data, (int)len, jpegToBuf)) {
    int W = j->getWidth(), H = j->getHeight(), s = 1;
    while (s < 8 && (W / s > 640 || (long)(W / s) * (H / s) > 720000L)) s *= 2;
    int w = W / s, h = H / s;
    free(castPx); castPx = nullptr; castW = castH = 0;
    uint16_t* px = w > 0 && h > 0 ? (uint16_t*)calloc((size_t)w * h, 2) : nullptr;
    if (px) {
      gJ.px = px; gJ.w = w; gJ.h = h;
      j->setPixelType(RGB565_LITTLE_ENDIAN);
      if (j->decode(0, 0, s == 2 ? JPEG_SCALE_HALF : s == 4 ? JPEG_SCALE_QUARTER : s == 8 ? JPEG_SCALE_EIGHTH : 0)) { castPx = px; castW = w; castH = h; ok = true; }
      else free(px);
    }
    j->close();
  }
  delete j;
  if (ok) {
    castFrame++;
    castMarkT = 0;
    if (castW != oldW || castH != oldH) {
      // тот же кадр в другом разрешении (телефон прислал крупнее для «крупно»): картинка на экране та же
      bool sameShape = oldW > 0 && oldH > 0 && fabsf((float)castW / castH - (float)oldW / oldH) < 0.02f * castW / castH;
      if (!sameShape) { castZoom = false; castScroll = castPanX = 0; }
      castPanX = std::min(castPanX, castPanMax());
      castScroll = std::min(castScroll, castScrollMax());
    }
  }
  return ok;
}

// Масштаб: пикселей снимка на пиксель экрана. «Целиком» — снимок вписан в экран,
// «крупно» (двойное касание) — примерно вдвое ближе, с прокруткой пальцем.
float castFit() { return castPx ? std::max((float)castW / SCREEN_W, (float)castH / CAST_VH) : 1.0f; }
float castZoomK() { return castFit() / 2; }   // «крупно» — вдвое ближе; телефон пришлёт кадр вдвое подробнее
bool castCanZoom() { return castPx != nullptr; }
// Какого размера кадр нужен плате: ровно под экран, при «крупно» — вдвое больше
int castBoxW() { return castZoom ? 2 * SCREEN_W : SCREEN_W; }
int castBoxH() { return castZoom ? 2 * CAST_VH : CAST_VH; }
float castScale() { return castZoom ? castZoomK() : castFit(); }
int castContentW() { return castPx ? (int)(castW / castScale()) : 0; }
int castContentH() { return castPx ? (int)(castH / castScale()) : 0; }
int castScrollMax() { return std::max(0, castContentH() - CAST_VH); }
int castPanMax() { return std::max(0, castContentW() - SCREEN_W); }
int castOffX() { int cw = castContentW(); return cw < SCREEN_W ? (SCREEN_W - cw) / 2 : -castPanX; }
int castOffY() { int ch = castContentH(); return ch < CAST_VH ? (CAST_VH - ch) / 2 : -castScroll; }  // от CAST_TOP

// Точка экрана → доли снимка (0..1); false — мимо снимка
bool castToFrac(int x, int y, float& fx, float& fy) {
  if (!castPx) return false;
  float k = castScale();
  float sx = (x - castOffX()) * k, sy = (y - CAST_TOP - castOffY()) * k;
  if (sx < 0 || sy < 0 || sx >= castW || sy >= castH) return false;
  fx = sx / castW; fy = sy / castH;
  return true;
}

// Кнопки заголовка: в браузере — «−», «+», «назад»; при управлении телефоном — «назад», «домой», «недавние»
static const char* const CAST_KEYS_WEB[3] = { "zout", "zin", "back" };
static const char* const CAST_KEYS_CTL[3] = { "back", "home", "recents" };

void drawCastButton(Surface& s, int i, int o) {
  float cx = CAST_BTN_X0 + 24 + i * 48, cy = o + 22;
  rr(s, cx - 20, cy - 15, 40, 30, 10, C_KEY, 255);
  uint16_t c = C_WHITE;
  const char* k = castMode ? CAST_KEYS_CTL[i] : CAST_KEYS_WEB[i];
  if (!strcmp(k, "zout") || !strcmp(k, "zin")) {
    capsuleS(s, cx - 7, cy, cx + 7, cy, 1.4f, c);
    if (k[1] == 'i') capsuleS(s, cx, cy - 7, cx, cy + 7, 1.4f, c);
  } else if (!strcmp(k, "back")) {
    if (castMode) {  // треугольник «назад» Android
      capsuleS(s, cx + 5, cy - 7, cx - 6, cy, 1.4f, c);
      capsuleS(s, cx - 6, cy, cx + 5, cy + 7, 1.4f, c);
      capsuleS(s, cx + 5, cy - 7, cx + 5, cy + 7, 1.4f, c);
    } else iconChevronL(s, cx, cy, 6, c);
  } else if (!strcmp(k, "home")) {
    ringS(s, cx, cy, 7, 2.6f, c);
  } else {  // недавние
    capsuleS(s, cx - 6, cy - 6, cx + 6, cy - 6, 1.3f, c);
    capsuleS(s, cx - 6, cy + 6, cx + 6, cy + 6, 1.3f, c);
    capsuleS(s, cx - 6, cy - 6, cx - 6, cy + 6, 1.3f, c);
    capsuleS(s, cx + 6, cy - 6, cx + 6, cy + 6, 1.3f, c);
  }
}

void drawCast(Surface& s, int top) {
  int o = -top;
  if (castPx) {
    float k = castScale();
    int offX = castOffX(), offY = castOffY();
    int cw = castContentW(), ch = castContentH();
    int x0 = std::max(0, offX), x1 = std::min(SCREEN_W, offX + cw);
    bool nearest = k <= 1.05f;
    bool exact = fabsf(k - 1.0f) < 0.001f;  // кадр прислан точно под экран — просто копируем строки
    for (int py = 0; py < s.h; py++) {
      int y = top + py;
      if (y < CAST_TOP || y >= CAST_BOT) continue;
      int cy = y - CAST_TOP - offY;
      if (cy < 0 || cy >= ch) continue;
      int iy = std::min(castH - 1, (int)(cy * k)), iy2 = std::min(castH - 1, iy + 1);
      uint16_t* row = s.px + py * s.w;
      const uint16_t* r1 = castPx + iy * castW;
      const uint16_t* r2 = castPx + iy2 * castW;
      if (exact) { int sx0 = x0 - offX; if (x1 > x0 && sx0 >= 0 && sx0 + (x1 - x0) <= castW) { memcpy(row + x0, r1 + sx0, (x1 - x0) * 2); continue; } }
      for (int x = x0; x < x1; x++) {
        int ix = std::min(castW - 1, (int)((x - offX) * k));
        if (nearest) { row[x] = r1[ix]; continue; }
        int ix2 = std::min(castW - 1, ix + 1);  // уменьшение: среднее по 2×2 соседям
        uint16_t a = r1[ix], b = r1[ix2], c = r2[ix], d = r2[ix2];
        uint32_t R = (a >> 11) + (b >> 11) + (c >> 11) + (d >> 11), G = ((a >> 5) & 63) + ((b >> 5) & 63) + ((c >> 5) & 63) + ((d >> 5) & 63), B = (a & 31) + (b & 31) + (c & 31) + (d & 31);
        row[x] = (uint16_t)(((R >> 2) << 11) | ((G >> 2) << 5) | (B >> 2));
      }
    }
    int sm = castScrollMax();  // полоса прокрутки в режиме «крупно»
    if (sm > 0) {
      int vh = CAST_VH, bh = std::max(30, vh * vh / (vh + sm)), by = CAST_TOP + (vh - bh) * castScroll / sm;
      rr(s, SCREEN_W - 5, o + by, 3, bh, 1.5f, C_DIM, 160);
    }
    if (castMarkT) {  // кружок там, где нажали: нажатие ушло на телефон
      float mx = castMarkSX / k + offX, my = castMarkSY / k + offY + CAST_TOP + o;
      ringS(s, mx, my, 16, 3, C_ACCENT);
      discA(s, mx, my, 5, C_ACCENT, 200);
    }
  } else {
    int y = o + 110;
    rrectX(s, 16, y, 288, 200, 18, C_PANEL, C_PANEL, 255, 255, C_BORDER, 255);
    textC(s, F_SB, 160, y + 36, "Ждём картинку с телефона", C_WHITE);
    std::string hint = wifiOn ? "В приложении ESP32 Flasher откройте «Плата по Wi-Fi» → «Экран на плату» или «Управление телефоном». " + wifiInfo
                              : "Сначала включите Wi-Fi: Настройки → «Wi-Fi: экран телефона».";
    auto w = wrapText(F_X, hint, 256);
    for (size_t i = 0; i < w.size() && i < 9; i++) textC(s, F_X, 160, y + 64 + 16 * (int)i, w[i], C_DIM);
  }
  if (top < CAST_TOP) {
    fillRectS(s, 0, o, SCREEN_W, CAST_TOP, C_BG);
    iconChevronL(s, 18, o + 22, 6, C_ACCENT);
    drawText(s, F_SB, 28, capBase(F_SB, o + 6, 32), "Закрыть", C_ACCENT);
    if (castLinked() && castPx) {
      discA(s, 110, o + 22, 4, MK565(90, 220, 140), 255);  // телефон на связи и забирает нажатия
      for (int i = 0; i < 3; i++) drawCastButton(s, i, o);
    } else {
      textC(s, F_SB, 196, capBase(F_SB, o + 6, 32), "Экран телефона", C_WHITE);
    }
    fillRectS(s, 0, o + CAST_TOP - 1, SCREEN_W, 1, C_BORDER);
  }
}

// Двойное касание: приблизить место под пальцем или вернуть «целиком»
void castToggleZoom(int x, int y) {
  if (!castCanZoom() && !castZoom) return;
  float k1 = castScale();
  float sx = (x - castOffX()) * k1, sy = (y - CAST_TOP - castOffY()) * k1;  // точка снимка под пальцем
  castZoom = !castZoom;
  float k2 = castScale();
  castPanX = std::max(0, std::min(castPanMax(), (int)(sx / k2) - x));
  castScroll = std::max(0, std::min(castScrollMax(), (int)(sy / k2) - (y - CAST_TOP)));
}

// ---------- Нажатия на плате → телефон ----------
void castQueue(const std::string& ev) {
  if (castEvents.size() >= 24) castEvents.erase(castEvents.begin());
  castEvents.push_back(ev);
}
bool castSendTap(int x, int y) {
  float fx, fy;
  if (!castToFrac(x, y, fx, fy)) return false;
  char b[96];
  snprintf(b, sizeof b, "{\"t\":\"tap\",\"x\":%.4f,\"y\":%.4f,\"f\":%d}", fx, fy, castFrame);
  castQueue(b);
  castMarkSX = fx * castW; castMarkSY = fy * castH; castMarkT = nowMs() | 1;
  return true;
}
// Свайп: телефон проведёт пальцем по тем же точкам (листание любой страницы в обе стороны)
bool castSendDrag(int x0, int y0, int x1, int y1) {
  float a, b, c, d;
  if (!castToFrac(x0, y0, a, b)) return false;
  float k = castScale();  // конец может уйти за край снимка — ограничиваем
  float ex = std::max(0.0f, std::min(castW - 1.0f, (x1 - castOffX()) * k)), ey = std::max(0.0f, std::min(castH - 1.0f, (y1 - CAST_TOP - castOffY()) * k));
  c = ex / castW; d = ey / castH;
  char s[128];
  snprintf(s, sizeof s, "{\"t\":\"drag\",\"x0\":%.4f,\"y0\":%.4f,\"x1\":%.4f,\"y1\":%.4f}", a, b, c, d);
  castQueue(s);
  return true;
}
void castSendKey(const char* k) {
  char b[48];
  snprintf(b, sizeof b, "{\"t\":\"key\",\"k\":\"%s\"}", k);
  castQueue(b);
}
// Оставлено для совместимости с приложением 2.0: листание страницы
void castSendScroll(int dir) {
  char b[48];
  snprintf(b, sizeof b, "{\"t\":\"scroll\",\"d\":%d}", dir);
  castQueue(b);
}
std::string castTakeEvents() {
  std::string j = "{\"ok\":true,\"ev\":[";
  for (size_t i = 0; i < castEvents.size(); i++) j += (i ? "," : "") + castEvents[i];
  castEvents.clear();
  char b[48];
  snprintf(b, sizeof b, "],\"box\":[%d,%d]}", castBoxW(), castBoxH());
  return j + b;
}

// Новый кадр поверх старого: на экран уходят только полосы, которые изменились
uint32_t castHash[SCREEN_H / STRIP_H + 1];
uint32_t castHashGen = 0xFFFFFFFFu;
void castRenderDiff() {
  bool full = castHashGen != renderGen;  // экран перерисовывали иначе — сравнивать не с чем
  for (int i = 0, y = 0; y < SCREEN_H; y += STRIP_H, i++) {
    int h = std::min(STRIP_H, SCREEN_H - y);
    surfSize(sStrip, SCREEN_W, h);
    surfFill(sStrip, C_BG);
    drawCast(sStrip, y);
    uint32_t hh = 2166136261u;
    const uint16_t* p = sStrip.px;
    for (int k = 0, n = SCREEN_W * h; k < n; k++) hh = (hh ^ p[k]) * 16777619u;
    if (full || hh != castHash[i]) { pushPixels(0, y, SCREEN_W, h, sStrip.px); castHash[i] = hh; }
  }
  castHashGen = renderGen;
}
// Плата закрыла экран: телефон перестаёт присылать кадры
void castClose() {
  castOn = false;
  castTapPend = false;
  castZoom = false;
  castClosedT = nowMs() | 1;
  if (castLinked()) castQueue("{\"t\":\"close\"}");
}
// Касание заголовка; true — обработано
bool castHeaderTap(int x) {
  if (x < 120) { castClose(); return true; }
  if (x >= CAST_BTN_X0 && castLinked() && castPx) {
    int i = std::min(2, (x - CAST_BTN_X0) / 48);
    castSendKey(castMode ? CAST_KEYS_CTL[i] : CAST_KEYS_WEB[i]);
    return true;
  }
  return false;
}
// Вызывается из loop: отправляет одиночное касание, гасит кружок. true — нужно перерисовать
bool castTick(uint32_t now) {
  if (castTapPend && now - castTapPendT >= 400) {
    castTapPend = false;
    if (castSendTap(castTapX, castTapY)) return true;
  }
  if (castMarkT && now - castMarkT > 2500) { castMarkT = 0; return true; }
  return false;
}

// ===================== Вкладки: отрисовка и нажатия =====================
int tabScroll[TAB_COUNT] = { 0, 0, 0, 0 };

void drawTab(Surface& s, int top) {
  if (castOn) drawCast(s, top);
  else if (curTab == TAB_GAMES) drawGames(s, top);
  else if (curTab == TAB_REF) drawRef(s, top);
  else if (curTab == TAB_SET) drawSettings(s, top);
}
void updateScrollMax() {
  if (castOn) return;
  if (curTab == TAB_REF) refSetScrollMax();
  else if (curTab == TAB_SET) setScrollMax();
  else { scrollMax = 0; scrollY = 0; }
}
void renderContent() {
  if (curTab == TAB_CALC && !castOn) { calcRenderAll(); return; }
  updateScrollMax();
  renderRegion(0, castOn ? SCREEN_H : TAB_Y, drawTab);  // экран телефона — на весь экран, без вкладок
}
void renderEverything() { renderContent(); if (!castOn) renderTabBar(); }

void switchTab(int t) {
  if (castOn) { castClose(); curTab = t; scrollY = tabScroll[t]; renderEverything(); return; }
  if (t == curTab) {  // повторное нажатие — в начало вкладки
    if (t == TAB_GAMES && gScr != G_MENU) { gScr = G_MENU; renderContent(); }
    else if (t == TAB_REF && (rScr == R_PAGE || rScr == R_TEXT || rScr == R_IMAGE || rScr == R_HTML)) { refBack(); renderContent(); }
    else if (scrollY) { scrollY = 0; scrollVel = 0; renderContent(); }
    return;
  }
  tabScroll[curTab] = scrollY;
  curTab = t;
  scrollY = tabScroll[t];
  scrollVel = 0;
  setArmReset = false;
  renderEverything();
}

// «Назад» физической кнопкой
void goBack() {
  if (castOn) { castClose(); renderEverything(); return; }
  if (curTab == TAB_GAMES && gScr != G_MENU) { gScr = G_MENU; renderContent(); }
  else if (curTab == TAB_REF && (rScr == R_PAGE || rScr == R_TEXT || rScr == R_IMAGE || rScr == R_HTML)) { refBack(); renderContent(); }
  else switchTab((curTab + 1) % TAB_COUNT);
}

// Падение фишки в «4 в ряд»
void c4Animate(int col, int row) {
  float target = (5 - row) * C4_C + C4_C / 2.0f;
  c4AnimCol = col;
  c4AnimRow = row;
  for (int k = 0; k <= 7; k++) {
    float t = k / 7.0f;
    c4AnimY = -18 + (target + 18) * t * t;
    renderRegion(C4_Y - 24, C4_Y + C4_C * 6 + 4, drawTab);
  }
  c4AnimCol = c4AnimRow = -1;
}

// ---------- Калькулятор: нажатия (как в отдельной прошивке) ----------
int downIdx = -1000;
uint32_t nextRepeat = 0, lastBlink = 0;
void pressAction(int hit) {
  if (hit >= 0) {
    renderKey(keys[hit], true);
    onKey(keys[hit].id);
  } else if (hit != -1000) {
    onKey((uint8_t)(-hit - 1));
  }
  cursorOn = true;
  lastBlink = nowMs();
  renderDisplay();
  renderSegments();
}

// ---------- Общий разбор касаний ----------
bool tDown = false, tMoved = false, tSlider = false, tInTabs = false;
int tX0, tY0, tScroll0, tPan0, tLastY, tLastX;
uint32_t tLastT, lastTapT = 0;
int lastTapX = -100, lastTapY = -100;

void touchDown(int x, int y) {
  tDown = true; tMoved = false; tSlider = false;
  tX0 = x; tY0 = y; tScroll0 = scrollY; tLastY = y; tLastX = x; tLastT = nowMs();
  scrollVel = 0;
  tInTabs = y >= TAB_Y && !castOn;
  beepClick();
  if (tInTabs) return;
  if (castOn) { tScroll0 = castScroll; tPan0 = castPanX; return; }
  if (curTab == TAB_CALC) { downIdx = calcHit(x, y); pressAction(downIdx); nextRepeat = nowMs() + 450; return; }
  if (curTab == TAB_SET && sliderHit(x, y)) { tSlider = true; sliderSet(x); renderRegion(SET_TOP, SET_TOP + 96, drawTab); }
}

void touchMove(int x, int y) {
  if (!tDown || tInTabs) return;
  uint32_t now = nowMs();
  if (castOn) {
    if (abs(y - tY0) > 8 || abs(x - tX0) > 8) tMoved = true;
    if (!tMoved) return;
    int ns = std::max(0, std::min(castScrollMax(), tScroll0 - (y - tY0))), np = std::max(0, std::min(castPanMax(), tPan0 - (x - tX0)));
    float dt = (float)std::max<uint32_t>(1, now - tLastT);
    scrollVel = 0.6f * scrollVel + 0.4f * (-(y - tLastY) / dt);
    tLastY = y; tLastX = x; tLastT = now;
    if (castZoom && (ns != castScroll || np != castPanX)) { castScroll = ns; castPanX = np; renderRegion(CAST_TOP, CAST_BOT, drawTab); }
    return;
  }
  if (curTab == TAB_CALC) return;
  if (tSlider) {
    int old = setBright;
    sliderSet(x);
    if (old != setBright) renderRegion(std::max(SET_TOP, SET_TOP - scrollY), std::max(SET_TOP, SET_TOP - scrollY + 96), drawTab);
    return;
  }
  if (abs(y - tY0) > 8 || abs(x - tX0) > 12) tMoved = true;
  if (tMoved && scrollMax > 0) {
    int ns = std::max(0, std::min(scrollMax, tScroll0 - (y - tY0)));
    float dt = (float)std::max<uint32_t>(1, now - tLastT);
    scrollVel = 0.6f * scrollVel + 0.4f * (-(y - tLastY) / dt);
    tLastY = y; tLastT = now;
    if (ns != scrollY) { scrollY = ns; renderRegion(0, TAB_Y, drawTab); }
  }
}

void touchUp(int x, int y) {
  if (!tDown) return;
  tDown = false;
  if (tInTabs) {
    if (y >= TAB_Y - 10) switchTab(std::max(0, std::min(TAB_COUNT - 1, x / 80)));
    return;
  }
  if (castOn) {
    if (tMoved) {
      if (nowMs() - tLastT > 80) scrollVel = 0;
      // «целиком»: свайп уходит на телефон как движение пальца; «крупно» — сдвигает картинку на плате
      if (!castZoom) { scrollVel = 0; if (castLinked() && tY0 >= CAST_TOP) castSendDrag(tX0, tY0, tLastX, tLastY); }
      return;
    }
    if (tY0 < CAST_TOP) { if (castHeaderTap(tX0) && !castOn) renderEverything(); return; }
    uint32_t now = nowMs();
    if (!castCanZoom() && !castZoom) {  // увеличивать нечего — нажатие уходит сразу
      if (castSendTap(tX0, tY0)) renderRegion(CAST_TOP, CAST_BOT, drawTab);
      return;
    }
    if (now - lastTapT < 400 && abs(tX0 - lastTapX) < 40 && abs(tY0 - lastTapY) < 40) {  // двойное касание
      castTapPend = false;
      castToggleZoom(tX0, tY0);
      lastTapT = 0;
      renderContent();
    } else {
      lastTapT = now; lastTapX = tX0; lastTapY = tY0;
      castTapPend = true; castTapPendT = now; castTapX = tX0; castTapY = tY0;  // нажатие на телефоне — если не будет второго касания
    }
    return;
  }
  if (curTab == TAB_CALC) { if (downIdx >= 0) renderKey(keys[downIdx], false); downIdx = -1000; return; }
  if (tSlider) { tSlider = false; saveSettings(); return; }
  if (tMoved) { if (nowMs() - tLastT > 80) scrollVel = 0; return; }
  if (curTab == TAB_GAMES) gamesTap(tX0, tY0);
  else if (curTab == TAB_REF) refTap(tX0, tY0);
  else if (curTab == TAB_SET) settingsTap(tX0, tY0);
  renderContent();
}

// Инерция прокрутки; true — если что-то перерисовали
bool scrollTick() {
  if (tDown || fabsf(scrollVel) < 0.05f) return false;
  if (castOn) {
    int ns = std::max(0, std::min(castScrollMax(), (int)(castScroll + scrollVel * 16)));
    scrollVel *= 0.92f;
    if (ns == 0 || ns == castScrollMax()) scrollVel = 0;
    if (ns != castScroll) { castScroll = ns; renderRegion(CAST_TOP, CAST_BOT, drawTab); return true; }
    return false;
  }
  if (curTab == TAB_CALC) return false;
  int ns = std::max(0, std::min(scrollMax, (int)(scrollY + scrollVel * 16)));
  scrollVel *= 0.92f;
  if (ns == 0 || ns == scrollMax) scrollVel = 0;
  if (ns != scrollY) { scrollY = ns; renderRegion(0, TAB_Y, drawTab); return true; }
  return false;
}

bool allInit() {
  AAFont* fs[] = { &F_S, &F_M, &F_F, &F_L, &F_K, &F_T, &F_B, &F_SB, &F_X, &F_H, &F_P };
  for (AAFont* f : fs) if (!decodeFont(*f)) return false;
  if (!surfAlloc(sDisp, DISP_W, DISP_H) || !surfAlloc(sSeg, SEG_W, SEG_H) || !surfAlloc(sKey, 140, KEY_H) || !surfAlloc(sStrip, SCREEN_W, STRIP_H)) return false;
  memVal = vExact(0, 1);
  buildLayout();
  gamesInit();
  return true;
}

// ===================== Железо =====================
#ifndef HOST_SIM
#define PIN_SDA 21
#define PIN_SCL 22
#define PIN_BL 25
#define PIN_BOOT 0
#define PIN_PWR 36
#define PIN_SD_CS 15
#define PIN_I2S_BCLK 2
#define PIN_I2S_LRCK 4
#define PIN_I2S_DOUT 12
#define TCA9554_ADDR 0x20
#define FT6336_ADDR 0x38
#define ES8311_ADDR 0x18
#define FW_VERSION "1.6"

Arduino_DataBus* bus = new Arduino_HWSPI(27 /* DC */, 5 /* CS */, 18 /* SCK */, 23 /* MOSI */, 19 /* MISO */, &SPI, true);
Arduino_GFX* gfx = new Arduino_ST7796(bus, GFX_NOT_DEFINED, 0, true);
Preferences prefs;
I2SClass i2s;
bool dimmed = false, audioReady = false;
uint32_t lastActivity = 0;

uint32_t nowMs() { return millis(); }
void pushPixels(int x, int y, int w, int h, const uint16_t* px) { gfx->draw16bitRGBBitmap(x, y, (uint16_t*)px, w, h); }

void tcaWrite(uint8_t reg, uint8_t val) {
  Wire.beginTransmission(TCA9554_ADDR);
  Wire.write(reg);
  Wire.write(val);
  Wire.endTransmission();
}
void resetPanelAndTouch() {
  tcaWrite(0x01, 0xFF);
  tcaWrite(0x03, 0b11111000);  // P0 — сброс LCD, P1 — сброс тача, P2 — усилитель динамика
  tcaWrite(0x01, 0b11111000);
  delay(10);
  tcaWrite(0x01, 0b11111011);  // усилитель пока выключен
  delay(200);
}
void ampEnable(bool on) { tcaWrite(0x01, on ? 0xFF : 0b11111011); }

bool readTouch(TouchPt& t) {
  Wire.beginTransmission(FT6336_ADDR);
  Wire.write(0x02);
  if (Wire.endTransmission(false) != 0) return false;
  if (Wire.requestFrom((uint8_t)FT6336_ADDR, (uint8_t)5) != 5) return false;
  uint8_t d[5];
  for (int i = 0; i < 5; i++) d[i] = Wire.read();
  uint8_t n = d[0] & 0x0F;
  if (n == 0 || n > 2) return false;
  int x = std::min(((d[1] & 0x0F) << 8) | d[2], SCREEN_W - 1), y = std::min(((d[3] & 0x0F) << 8) | d[4], SCREEN_H - 1);
  if (setFlip) { x = SCREEN_W - 1 - x; y = SCREEN_H - 1 - y; }
  t.x = x; t.y = y;
  return true;
}

// ---------- Звук щелчка: кодек ES8311 + I2S ----------
void esW(uint8_t reg, uint8_t v) { Wire.beginTransmission(ES8311_ADDR); Wire.write(reg); Wire.write(v); Wire.endTransmission(); }
uint8_t esR(uint8_t reg) {
  Wire.beginTransmission(ES8311_ADDR); Wire.write(reg); Wire.endTransmission(false);
  Wire.requestFrom((uint8_t)ES8311_ADDR, (uint8_t)1);
  return Wire.available() ? Wire.read() : 0;
}
void es8311Init() {
  esW(0x00, 0x1F); delay(20); esW(0x00, 0x00); esW(0x00, 0x80);
  esW(0x01, 0x3F | 0x80);
  esW(0x06, esR(0x06) & ~(1 << 5));
  esW(0x02, (esR(0x02) & 0x07) | (0 << 5) | (2 << 3));
  esW(0x03, (0 << 6) | 0x10); esW(0x04, 0x10); esW(0x05, 0x00);
  esW(0x06, (esR(0x06) & 0xE0) | (4 - 1));
  esW(0x07, esR(0x07) & 0xC0); esW(0x08, 0xFF);
  esW(0x00, esR(0x00) & 0xBF);
  esW(0x09, 4 << 2); esW(0x0A, 4 << 2);
  esW(0x0D, 0x01); esW(0x0E, 0x02); esW(0x12, 0x00); esW(0x13, 0x10); esW(0x1C, 0x6A); esW(0x37, 0x08);
  esW(0x32, 150);  // громкость
}
void beepClick() {
  if (!setSound) return;
  if (!audioReady) {
    es8311Init();
    i2s.setPins(PIN_I2S_BCLK, PIN_I2S_LRCK, PIN_I2S_DOUT, -1, -1);
    audioReady = i2s.begin(I2S_MODE_STD, 44100, I2S_DATA_BIT_WIDTH_32BIT, I2S_SLOT_MODE_STEREO, I2S_STD_SLOT_BOTH);
  }
  if (!audioReady) return;
  ampEnable(true);
  static int32_t buf[2 * 441];  // 10 мс
  for (int i = 0; i < 441; i++) {
    float env = expf(-i / 70.0f), v = sinf(i * 2 * 3.14159f * 2200 / 44100) * env * 9000;
    buf[2 * i] = buf[2 * i + 1] = (int32_t)((uint32_t)(int32_t)v << 16);
  }
  i2s.write((uint8_t*)buf, sizeof buf);
}

void applyBacklight() {
  int v = dimmed ? 8 : (int)(2.55f * setBright * setBright / 100.0f + 6);
  analogWrite(PIN_BL, std::min(255, v));
}

// ---------- SD-карта ----------
bool sdOk = false;
uint32_t sdFailT = 0;      // когда карта последний раз не ответила: повторяем не чаще раза в 5 с
uint32_t sdSizeMB = 0;
void sdForgetFail() { sdFailT = 0; }
bool sdBegin() {
  if (sdOk && SD.cardType() != CARD_NONE) return true;
  SD.end();
  // без карты каждая попытка занимает до секунды — не повторяем её на каждом кадре
  if (!sdOk && sdFailT && millis() - sdFailT < 5000) return false;
  sdOk = SD.begin(PIN_SD_CS, SPI, 20000000) || (SD.end(), SD.begin(PIN_SD_CS, SPI, 4000000));  // медленнее — для капризных карт
  sdFailT = sdOk ? 0 : (millis() | 1);
  if (sdOk) sdSizeMB = (uint32_t)(SD.cardSize() >> 20);
  return sdOk;
}
bool sdFormat() {  // FatFs форматирует только карту без понятной ей файловой системы (например, exFAT)
  SD.end();
  sdOk = SD.begin(PIN_SD_CS, SPI, 4000000, "/sd", 5, true);
  sdFailT = sdOk ? 0 : (millis() | 1);
  if (sdOk) sdSizeMB = (uint32_t)(SD.cardSize() >> 20);
  return sdOk;
}
void* jpgFileOpen(const char* name, int32_t* size) {
  if (!sdBegin()) return nullptr;
  File* f = new File(SD.open(name));
  if (!*f) { delete f; return nullptr; }
  *size = f->size();
  return f;
}
void jpgFileClose(void* h) { File* f = (File*)h; if (f) { f->close(); delete f; } }
int32_t jpgFileRead(JPEGFILE* jf, uint8_t* buf, int32_t len) { File* f = (File*)jf->fHandle; int32_t n = f->read(buf, len); jf->iPos = f->position(); return n; }
int32_t jpgFileSeek(JPEGFILE* jf, int32_t pos) { File* f = (File*)jf->fHandle; f->seek(pos); jf->iPos = pos; return pos; }
bool sdList(const std::string& dir, std::vector<FileEnt>& out) {
  if (!sdBegin()) return false;
  File d = SD.open(dir.c_str());
  if (!d || !d.isDirectory()) return false;
  File f;
  while ((f = d.openNextFile())) {
    std::string n = f.name();
    size_t sl = n.rfind('/');
    if (sl != std::string::npos) n = n.substr(sl + 1);
    out.push_back({ n, f.isDirectory(), (uint32_t)f.size() });
    f.close();
    if (out.size() > 400) break;
  }
  d.close();
  return true;
}
std::string sdReadFile(const std::string& path, size_t maxBytes) {
  std::string s;
  if (!sdBegin()) return s;
  File f = SD.open(path.c_str());
  if (!f) return s;
  size_t n = std::min((size_t)f.size(), maxBytes);
  s.resize(n);
  n = f.read((uint8_t*)&s[0], n);
  s.resize(n);
  f.close();
  return s;
}
bool sdReadBytes(const std::string& path, std::vector<uint8_t>& buf, size_t maxBytes) {
  if (!sdBegin()) return false;
  File f = SD.open(path.c_str());
  if (!f) return false;
  size_t n = f.size();
  if (n == 0 || n > maxBytes) { f.close(); return false; }
  buf.resize(n);
  bool ok = f.read(buf.data(), n) == n;
  f.close();
  return ok;
}

void boardInfo(std::vector<std::string>& k, std::vector<std::string>& v) {
  char b[48];
  k.push_back("Процессор"); snprintf(b, sizeof b, "%s · %u МГц", ESP.getChipModel(), (unsigned)ESP.getCpuFreqMHz()); v.push_back(b);
  k.push_back("Флеш-память"); snprintf(b, sizeof b, "%u МБ", (unsigned)(ESP.getFlashChipSize() >> 20)); v.push_back(b);
  k.push_back("PSRAM"); snprintf(b, sizeof b, "%u из %u КБ свободно", (unsigned)(ESP.getFreePsram() >> 10), (unsigned)(ESP.getPsramSize() >> 10)); v.push_back(b);
  k.push_back("Свободно ОЗУ"); snprintf(b, sizeof b, "%u КБ", (unsigned)(ESP.getFreeHeap() >> 10)); v.push_back(b);
  uint32_t up = millis() / 1000;
  k.push_back("Работает"); snprintf(b, sizeof b, "%u ч %02u мин %02u с", (unsigned)(up / 3600), (unsigned)(up / 60 % 60), (unsigned)(up % 60)); v.push_back(b);
  // карту здесь не опрашиваем: экран рисуется полосами, и опрос на каждой полосе тормозил настройки
  k.push_back("SD-карта"); if (sdOk) snprintf(b, sizeof b, "%u МБ", (unsigned)sdSizeMB); else snprintf(b, sizeof b, "не найдена"); v.push_back(b);
  k.push_back("Версия прошивки"); v.push_back(FW_VERSION);
}

// ---------- Wi-Fi: приём картинок с телефона ----------
WebServer server(80);
bool serverStarted = false;
void sendJson(int code, const char* body) {
  server.sendHeader("Access-Control-Allow-Origin", "*");
  server.sendHeader("Cache-Control", "no-store");
  server.send(code, "application/json; charset=utf-8", body);
}
String homeSsid, homePass;          // домашняя сеть (сохраняется в памяти платы или /wifi.txt)
bool staUp = false, mdnsUp = false;
uint32_t wifiApplyAt = 0;
std::string jsonStr(const String& s) {
  std::string r = "\"";
  for (size_t i = 0; i < s.length(); i++) { char c = s[i]; if (c == '"' || c == '\\') r += '\\'; if ((uint8_t)c >= 0x20) r += c; }
  return r + "\"";
}
void apiInfo() {
  std::string j = "{\"ok\":true,\"app\":\"school\",\"screen\":true,\"events\":true,\"control\":true,\"wifiset\":true,\"view\":[320,436],\"files\":false,\"card\":false,\"total\":0,\"used\":0,\"home\":" +
                  jsonStr(homeSsid) + ",\"sta\":" + jsonStr(staUp ? WiFi.localIP().toString() : String("")) + ",\"version\":\"" FW_VERSION "\"}";
  sendJson(200, j.c_str());
}
void wifiInfoUpdate() {
  std::string ap = "Сеть платы ESP32-HTML, пароль 12345678, адрес 192.168.4.1.";
  if (!homeSsid.length()) wifiInfo = ap + " В приложении нажмите «Подключиться к плате».";
  else if (staUp) wifiInfo = std::string("Домашняя сеть «") + homeSsid.c_str() + "»: адрес " + WiFi.localIP().toString().c_str() + " (school.local). " + ap;
  else wifiInfo = std::string("Подключаюсь к домашней сети «") + homeSsid.c_str() + "»… " + ap;
}
// Домашняя сеть из приложения: POST /__wifi?ssid=…&pass=… (пустое имя — забыть сеть)
void apiWifi() {
  homeSsid = server.arg("ssid"); homeSsid.trim();
  homePass = server.arg("pass");
  prefs.begin("school", false);
  prefs.putString("wssid", homeSsid);
  prefs.putString("wpass", homePass);
  prefs.end();
  std::string j = "{\"ok\":true,\"home\":" + jsonStr(homeSsid) + "}";
  sendJson(200, j.c_str());
  wifiApplyAt = millis() + 300;  // ответить успеем до переключения
}
void wifiApplyHome() {
  staUp = false;
  if (homeSsid.length()) {
    WiFi.mode(WIFI_AP_STA);  // точка доступа платы остаётся: к плате можно подключиться в любом случае
    WiFi.begin(homeSsid.c_str(), homePass.c_str());
  } else {
    WiFi.disconnect(false);
    WiFi.mode(WIFI_AP);
  }
  wifiInfoUpdate();
}
void handleShowUpload() {
  HTTPUpload& up = server.upload();
  if (up.status == UPLOAD_FILE_START) { castRx.clear(); castRx.reserve(200000); if (server.hasArg("mode")) castMode = server.arg("mode") == "ctl" ? 1 : 0; }
  else if (up.status == UPLOAD_FILE_WRITE) { if (castRx.size() + up.currentSize <= 900000) castRx.insert(castRx.end(), up.buf, up.buf + up.currentSize); }
  else if (up.status == UPLOAD_FILE_END) castReady = !castRx.empty();
}
void wifiEnable(bool on) {
  if (on == wifiOn) return;
  if (!on) {
    server.stop();
    if (mdnsUp) { MDNS.end(); mdnsUp = false; }
    staUp = false;
    WiFi.softAPdisconnect(true);
    WiFi.disconnect(true);
    WiFi.mode(WIFI_OFF);
    wifiOn = false;
    wifiInfo.clear();
    renderContent();
    return;
  }
  wifiOn = true;
  wifiInfo = "Включаю…";
  renderContent();
  prefs.begin("school", true);
  homeSsid = prefs.getString("wssid", "");
  homePass = prefs.getString("wpass", "");
  prefs.end();
  if (!homeSsid.length() && sdBegin()) {
    File cfg = SD.open("/wifi.txt");  // или своя сеть с карты: первая строка — имя, вторая — пароль
    if (cfg) { homeSsid = cfg.readStringUntil('\n'); homeSsid.trim(); homePass = cfg.readStringUntil('\n'); homePass.trim(); cfg.close(); }
  }
  WiFi.mode(homeSsid.length() ? WIFI_AP_STA : WIFI_AP);
  WiFi.softAP("ESP32-HTML", "12345678");
  WiFi.setSleep(false);  // без энергосбережения Wi-Fi: нажатия и кадры доходят без задержек
  wifiApplyHome();
  if (!serverStarted) {
    server.on("/__api/info", HTTP_GET, apiInfo);
    server.on("/__wifi", HTTP_POST, apiWifi);
    server.on("/__events", HTTP_GET, []() {
      bool was = castLinked();
      castPollT = millis();
      if (server.hasArg("mode")) castMode = server.arg("mode") == "ctl" ? 1 : 0;
      std::string j = castTakeEvents();
      sendJson(200, j.c_str());
      if (!was && castOn && !tDown) renderRegion(0, CAST_TOP, drawTab);  // зелёная точка: телефон на связи
    });
    server.on("/__show", HTTP_POST, []() { sendJson(200, "{\"ok\":true}"); }, handleShowUpload);
    server.onNotFound([]() { sendJson(404, "{\"ok\":false,\"error\":\"Эта прошивка принимает только картинки для экрана\"}"); });
    serverStarted = true;
  }
  server.begin();
  renderContent();
}

// ---------- Память настроек ----------
void saveState() {  // калькулятор
  prefs.begin("calc", false);
  prefs.putBool("ms", memSet);
  prefs.putBytes("mv", &memVal, sizeof(Val));
  prefs.putUChar("fmt", fmtMode);
  prefs.end();
}
void loadState() {
  prefs.begin("calc", true);
  memSet = prefs.getBool("ms", false);
  if (prefs.getBytes("mv", &memVal, sizeof(Val)) != sizeof(Val)) memSet = false;
  fmtMode = prefs.getUChar("fmt", 0) % 3;
  prefs.end();
}
bool lastFlip = false;
void saveSettings() {
  prefs.begin("school", false);
  prefs.putUChar("br", setBright);
  prefs.putUChar("dim", setDim);
  prefs.putUChar("th", setTheme);
  prefs.putBool("snd", setSound);
  prefs.putBool("flip", setFlip);
  prefs.end();
  if (setFlip != lastFlip) { lastFlip = setFlip; gfx->setRotation(setFlip ? 2 : 0); renderTabBar(); }
  if (!setSound && audioReady) ampEnable(false);
}
void loadSettings() {
  prefs.begin("school", true);
  setBright = std::max(5, std::min(100, (int)prefs.getUChar("br", 80)));
  setDim = prefs.getUChar("dim", 2) % 4;
  setTheme = prefs.getUChar("th", 0) % 6;
  setSound = prefs.getBool("snd", false);
  setFlip = prefs.getBool("flip", false);
  prefs.end();
  lastFlip = setFlip;
}
void resetAllSettings() {
  setBright = 80; setDim = 2; setTheme = 0; setSound = false; setFlip = false;
  applyTheme(0);
  applyBacklight();
  saveSettings();
  renderEverything();
}

void setup() {
  Serial.begin(115200);
  pinMode(PIN_BOOT, INPUT_PULLUP);
  pinMode(PIN_PWR, INPUT);
  Wire.begin(PIN_SDA, PIN_SCL);
  Wire.setClock(400000);
  resetPanelAndTouch();
  SPI.begin(18, 19, 23);
  if (!gfx->begin(40000000)) Serial.println("gfx->begin() failed!");
  loadSettings();
  gfx->setRotation(setFlip ? 2 : 0);
  gfx->fillScreen(C_BG);
  applyTheme(setTheme);
  if (!allInit()) { Serial.println("Out of memory"); while (true) delay(1000); }
  hv::hasPsram = psramFound();
  hv::imgCacheLimit = hv::hasPsram ? 400 * 1024 : 60 * 1024;
  loadState();
  renderEverything();
  applyBacklight();
  lastActivity = millis();
}

void loop() {
  uint32_t now = millis();
  // кнопки на плате: BOOT — «=» в калькуляторе, в остальных вкладках «назад»; PWR — формат результата
  static bool lastBoot = true, lastPwr = false;
  bool boot = digitalRead(PIN_BOOT), pwr = digitalRead(PIN_PWR);
  if (lastBoot && !boot) {
    lastActivity = now;
    if (dimmed) { dimmed = false; applyBacklight(); }
    else if (curTab == TAB_CALC) { onKey(K_EQ); renderDisplay(); renderSegments(); }
    else goBack();
  }
  if (!lastPwr && pwr && curTab == TAB_CALC) { onKey(K_BULB); renderDisplay(); lastActivity = now; }
  lastBoot = boot;
  lastPwr = pwr;

  // касания
  static int releaseCount = 0;
  static bool wake = false;
  TouchPt t;
  bool down = readTouch(t);
  if (down) {
    releaseCount = 0;
    lastActivity = now;
    if (!tDown && !wake) {
      if (dimmed) { dimmed = false; wake = true; applyBacklight(); }  // первое касание только будит экран
      else touchDown(t.x, t.y);
    } else if (tDown) {
      touchMove(t.x, t.y);
      if (curTab == TAB_CALC && downIdx >= 0 && keys[downIdx].id == K_BS && now >= nextRepeat) {
        onKey(K_BS); renderDisplay(); renderSegments(); nextRepeat = now + 110;
      }
    }
  } else if ((tDown || wake) && ++releaseCount >= 2) {
    wake = false;
    if (tDown) touchUp(tX0, tY0);
  }
  scrollTick();
  if (wifiOn) {
    server.handleClient();
    if (wifiApplyAt && (int32_t)(now - wifiApplyAt) >= 0) { wifiApplyAt = 0; wifiApplyHome(); if (curTab == TAB_SET && !castOn) renderContent(); }
    static uint32_t staCheck = 0;
    if (homeSsid.length() && now - staCheck > 500) {
      staCheck = now;
      bool up = WiFi.status() == WL_CONNECTED;
      if (up != staUp) {
        staUp = up;
        if (up && !mdnsUp && MDNS.begin("school")) { MDNS.addService("http", "tcp", 80); mdnsUp = true; }
        wifiInfoUpdate();
        if ((curTab == TAB_SET || (castOn && !castPx)) && !tDown) renderContent();
      }
    }
  }
  if (castReady && !tDown) {  // пришла картинка с телефона
    castReady = false;
    lastActivity = now;
    if (dimmed) { dimmed = false; applyBacklight(); }
    hv::evictImages(1u << 30);  // память под снимок важнее кэша картинок страницы
    bool justClosed = castClosedT && now - castClosedT < 4000;  // кадр отправили до того, как плата закрыла экран
    bool wasOn = castOn && castPx;
    if (!justClosed && castDecode(castRx.data(), castRx.size())) {
      castOn = true; castClosedT = 0; scrollVel = 0;
      if (wasOn) castRenderDiff(); else renderContent();
    }
    castRx.clear();
    castRx.shrink_to_fit();
  }

  if (castOn && !tDown && castTick(now)) renderRegion(CAST_TOP, CAST_BOT, drawTab);
  {  // телефон перестал забирать нажатия — убрать зелёную точку
    static bool linkedShown = false;
    bool l = castOn && castLinked();
    if (l != linkedShown) { linkedShown = l; if (castOn && !tDown) renderRegion(0, CAST_TOP, drawTab); }
  }
  // автопереход HTML-страниц (<meta http-equiv="refresh">)
  if (curTab == TAB_REF && rScr == R_HTML && !castOn && !tDown && hv::refreshAt && hv::tick()) { htmlSync(); lastActivity = now; renderContent(); }

  // мигание курсора калькулятора
  if (curTab == TAB_CALC && now - lastBlink >= 530) {
    lastBlink = now;
    cursorOn = !cursorOn;
    if (!justEval && !dimmed) renderDisplay();
  }
  // затемнение при простое
  static const uint32_t DIM_MS[4] = { 0, 30000, 60000, 300000 };
  if (!dimmed && setDim && now - lastActivity > DIM_MS[setDim]) { dimmed = true; applyBacklight(); }
  delay(8);
}
#endif
